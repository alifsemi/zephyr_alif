## boards/alif/alif_e8_dk/dts/bindings/mipi-lvds-mux.yaml
```yaml
# Copyright (C) 2025 Alif Semiconductor.
# SPDX-License-Identifier: Apache-2.0

description: |
  This allows to define consumers for the MIPI lines

compatible: "mipi-lvds-mux"

child-binding:
  description: MIPI switch child node
  properties:
    select-gpios:
      type: phandle-array
      required: true
```

## boards/arm/alif_b1_dk/Kconfig.board
```kconfig
# Copyright (c) 2024 Alif Semiconductor
#
# SPDX-License-Identifier: Apache-2.0

config ALIF_B1_DK_BOARD
	bool "Alif Devkit Balletto B1 Dev board"
	depends on SOC_SERIES_BALLETTO_B1

if ALIF_B1_DK_BOARD

config UART_DMA_ENABLE
	bool
endif
```

## boards/arm/alif_b1_dk/Kconfig.defconfig
```kconfig
# Copyright (c) 2024 Alif Semiconductor
#
# SPDX-License-Identifier: Apache-2.0

if ALIF_B1_DK_BOARD

config BOARD
	default "alif_b1_devkit"
endif # ALIF_B1_DK_BOARD

config MAIN_STACK_SIZE
	default 4096

config BT_BUF_ACL_RX_SIZE
	range 251 65535
	default 251
	help
	  Maximum support ACL size of data packets sent from the Controller to
	  the Host. This value does not include the HCI ACL header.
	  In a combined Host and Controller build the buffer sizes in both the
	  Host and the Controller will use this value for buffer sizes, and
	  therefore Controller to Host flow Controller is not needed.
	  In a Host only build with Controller to Host flow control enabled
	  the Host will inform the Controller about the maximum ACL data size it
	  can send by setting this value in the Host Buffer Size command.
	  If Controller to Host flow control is not enabled then the Controller
	  can assume the Host has infinite buffer size so this value should then
	  be set to something that is guaranteed the Controller will not exceed
	  or the data packets will be dropped.
	  In a Controller only build this will determine the maximum ACL size
	  that the Controller will send to the Host.
	  The Host supports reassembling of L2CAP PDUs from ACL data packets,
	  but the maximum supported L2CAP PDU size is limited by the maximum
	  supported ACL size.
	  This means the maximum L2CAP PDU MTU is restricted by the maximum ACL
	  size subtracting the 4 byte header of an L2CAP PDU.
	  When using L2CAP Connection oriented Channels without segmentation
	  then the L2CAP SDU MTU is also restricted by the maximum ACL size
	  subtracting the 4 Byte header of an L2CAP PDU plus the 2 byte header
	  of an L2CAP SDU.

	  Note: Alif Semiconductor's LL stack does not support fragmentation so it
	  mandates the minimum value of 251!

	  An L2CAP PDU is also referred to as an L2CAP basic frame or B-frame.
	  An L2CAP SDU is also referred to as an L2CAP Credit-based frame or
	  K-frame.

config BT_BUF_EVT_RX_COUNT
	default 20 if (BT_MESH && !(BT_BUF_EVT_DISCARDABLE_COUNT > 0))
	default 10
	range 10 255
	help
	  Number of buffers available for incoming HCI events from the
	  Controller.

config BT_BUF_ACL_RX_COUNT
	default 10
	range 6 255
	help
	  Number or incoming ACL data buffers sent from the Controller to the
	  Host.
	  In a combined Host and Controller build the buffers are shared and
	  therefore Controller to Host flow control is not needed.
	  In a Host only build with Controller to Host flow control enabled
	  the Host will inform the Controller about the maximum number of
	  buffers by setting this value in the Host Buffer Size command.
	  When Controller to Host flow control is not enabled the Controller
	  can assume that the Host has infinite amount of buffers.

config BT_BUF_ACL_TX_COUNT
	default 10
	range 6 255
	help
	  Number of outgoing ACL data buffers sent from the Host to the
	  Controller. This determines the maximum amount of data packets the
	  Host can have queued in the Controller before waiting for the
	  to notify the Host that more packets can be queued with the Number of
	  Completed Packets event.
	  The buffers are shared between all of the connections and the Host
	  determines how to divide the buffers between the connections.
	  The Controller will return this value in the HCI LE Read Buffer Size
	  command response.
```

## boards/arm/alif_b1_dk/alif_b1_fpga_rtss_he_ble_defconfig
```kconfig
# Copyright (c) 2024 Alif Semiconductor
#
# SPDX-License-Identifier: Apache-2.0

CONFIG_SOC_B1_FPGA_RTSS_HE=y
CONFIG_SOC_SERIES_BALLETTO_B1=y
CONFIG_CORTEX_M_SYSTICK=y
CONFIG_RUNTIME_NMI=y
CONFIG_ARM_MPU=y
CONFIG_PINCTRL=y
CONFIG_SERIAL=y
CONFIG_UART_INTERRUPT_DRIVEN=y
CONFIG_CONSOLE=y
CONFIG_UART_CONSOLE=y

CONFIG_SYS_CLOCK_HW_CYCLES_PER_SEC=24000000

# Zephyr Kernel Configuration
CONFIG_XIP=y
CONFIG_GPIO=y
CONFIG_GPIO_DW=y
CONFIG_SOC_SUPPORT_ARM_MHUV2=y

# Cache Management
CONFIG_CACHE_MANAGEMENT=y

# LLVM Arm toolchain 16.0.0 does not recognize --gap-fill
CONFIG_BUILD_NO_GAP_FILL=y

CONFIG_UART_NS16550=y
# UART variant of ns16550 that supports auto flow control
CONFIG_UART_NS16550_VARIANT_NS16750=y
# Support break condition
CONFIG_UART_LINE_CTRL=y
CONFIG_UART_NS16550_LINE_CTRL=y


# Enabled temporarily to work with FPGA. When booting from OSPI1 set to 'n'.
CONFIG_INIT_ARCH_HW_AT_BOOT=y

# FPGA uses latest ROM code. Currently version 1.2
CONFIG_ALIF_BLE_ROM_IMAGE_V1_2=y
```

## boards/arm/alif_e1c_dk/alif_e1c_dk_rtss_he_defconfig
```kconfig
# Copyright (c) 2024 Alif Semiconductor
#
# SPDX-License-Identifier: Apache-2.0

CONFIG_SOC_E1C_DK_RTSS_HE=y
CONFIG_SOC_SERIES_ENSEMBLE_E1C=y
CONFIG_CORTEX_M_SYSTICK=y
CONFIG_RUNTIME_NMI=y
CONFIG_ARM_MPU=y
CONFIG_PINCTRL=y
CONFIG_SERIAL=y
CONFIG_FPU=y
CONFIG_FP_HARDABI=y
CONFIG_UART_INTERRUPT_DRIVEN=y
CONFIG_CONSOLE=y
CONFIG_UART_CONSOLE=y
CONFIG_CLOCK_CONTROL=y

# Zephyr Kernel Configuration
CONFIG_XIP=y
CONFIG_GPIO=y
CONFIG_GPIO_DW=y
CONFIG_SOC_SUPPORT_ARM_MHUV2=y

# Cache Management
CONFIG_CACHE_MANAGEMENT=y

# LLVM Arm toolchain 16.0.0 does not recognize --gap-fill
CONFIG_BUILD_NO_GAP_FILL=y

CONFIG_UART_NS16550=y
# UART variant of ns16550 that supports auto flow control
CONFIG_UART_NS16550_VARIANT_NS16750=y

# Use Single FIFO Address mode
CONFIG_FLASH_ADDRESS_IN_SINGLE_FIFO_LOCATION=y

# Set Kernel device Priority levels
CONFIG_KERNEL_INIT_PRIORITY_DEFAULT=0
CONFIG_SE_SERVICE_INIT_PRIORITY=1
```

## boards/arm/alif_e3_dk/alif_e3_dk_rtss_hp_defconfig
```kconfig
# Copyright (c) 2024 Alif Semiconductor
#
# SPDX-License-Identifier: Apache-2.0

CONFIG_SOC_E3_DK_RTSS_HP=y
CONFIG_SOC_SERIES_ENSEMBLE_E3=y
CONFIG_CORTEX_M_SYSTICK=y
CONFIG_RUNTIME_NMI=y
CONFIG_ARM_MPU=y
CONFIG_PINCTRL=y
CONFIG_SERIAL=y
CONFIG_FPU=y
CONFIG_FP_HARDABI=y
CONFIG_UART_INTERRUPT_DRIVEN=y
CONFIG_UART_NS16550=y
# UART variant of ns16550 that supports auto flow control
CONFIG_UART_NS16550_VARIANT_NS16750=y
CONFIG_CONSOLE=y
CONFIG_UART_CONSOLE=y
CONFIG_ARM_ETHOS_U55_256=y

# Zephyr Kernel Configuration
CONFIG_XIP=y
CONFIG_GPIO=y
CONFIG_GPIO_DW=y
CONFIG_SOC_SUPPORT_ARM_MHUV2=y
CONFIG_CLOCK_CONTROL=y

# Cache Management
CONFIG_CACHE_MANAGEMENT=y
```

## drivers/audio/Kconfig.dmic_alif
```kconfig
# Alif PDM driver configuration options

# Copyright (C) 2025 Alif Semiconductor
# SPDX-License-Identifier: Apache-2.0

config ALIF_PDM
	bool "Alif PDM module driver enable"
	default y
	depends on DT_HAS_ALIF_ALIF_PDM_ENABLED
	help
		Enable Alif PDM module driver
if ALIF_PDM

config ALIF_PDM_USE_DMA
	bool "DMA path for Alif PDM transfers"
	depends on DMA
	default n
	help
		Enables the DMA code path for Alif PDM audio capture.

endif # ALIF_PDM
```

## drivers/clock_control/Kconfig.alif
```kconfig
# Copyright (c) 2025 Alif Semiconductor
#
# SPDX-License-Identifier: Apache-2.0

config CLOCK_CONTROL_ALIF
	bool "Alif clock control driver"
	default y
	depends on DT_HAS_ALIF_CLOCKCTRL_ENABLED
	help
	  Enable Alif clock control driver.
```

## drivers/comparator/Kconfig.alif
```kconfig
# Copyright (C) 2024 Alif Semiconductor
# SPDX-License-Identifier: Apache-2.0

config CMP_ALIF
	bool "Alif CMP driver"
	default y
	help
	  Enable driver for Alif CMP
```

## drivers/comparator/Kconfig.alif_comp
```kconfig
# Copyright (C) 2025 Alif Semiconductor
# SPDX-License-Identifier: Apache-2.0

config COMPARATOR_ALIF_COMP
	bool "Alif CMP driver"
	depends on DT_HAS_ALIF_CMP_ENABLED
	default y
	help
	  Enable driver for Alif CMP

config CMP_INT_STATUS_MASK
	int
	default 3 if ENSEMBLE_GEN2
	default 3 if SOC_SERIES_E1C
	default 3 if SOC_SERIES_B1
	default 1
```

## drivers/counter/Kconfig.dw_rtc
```kconfig
# Synopsys DesignWare Counter RTC configuration option

# Copyright (c) 2024 Alif Semiconductor
# SPDX-License-Identifier: Apache-2.0

config COUNTER_RTC_SNPS_DW
	bool "Synopsys Designware RTC driver"
	default y
	depends on DT_HAS_SNPS_DW_APB_RTC_ENABLED
	help
	  Enable counter driver for Designware RTC counter series. Such driver
	  will expose the basic RTC counter device present on the MCU.
```

## drivers/crc/Kconfig
```kconfig
menuconfig CRC_DRV
	bool "CRC drivers"
	help
	  Enable support for CRC Driver

if CRC_DRV

source "drivers/crc/Kconfig.alif"

endif
```

## drivers/crc/Kconfig.alif
```kconfig
# Alif CRC driver configuration options

# Copyright (C) 2024 Alif Semiconductor
# SPDX-License-Identifier: Apache-2.0

config CRC_ALIF
	bool "Alif CRC driver"
	default y
	depends on DT_HAS_ALIF_ALIF_CRC_ENABLED
	help
	  Enable driver for Alif CRC
```

## drivers/dac/Kconfig.alif
```kconfig
# Copyright (C) 2025 Alif Semiconductor
# SPDX-License-Identifier: Apache-2.0

config DAC_ALIF
	bool "Alif DAC driver"
	default y
	depends on DT_HAS_ALIF_DAC_ENABLED
	help
	  Enable DAC module for Alif Boards
```

## drivers/dave2d/Kconfig
```kconfig
# Copyright (c) 2025 Alif Semiconductor
#
# SPDX-License-Identifier: Apache-2.0
#

# D/AVE2D driver configuration

menuconfig DAVE2D
    bool "D/AVE2D support"

if DAVE2D

choice D1_MEM_ALLOC
    prompt "Select memory allocator for Layer 1 D/AVE2D driver"
    default D1_MALLOC_D0LIB

config D1_MALLOC_D0LIB
    bool "Use D/AVE2D Layer 0 memory allocator"

config D1_MALLOC_STDLIB
    bool "Use default malloc() implementation from stdlib"

config D1_MALLOC_CUSTOM
    bool "Use custom dynamic memory allocation implementation"

endchoice

choice D0_MEMORY_MANAGER
    prompt "Select D0 memory manager to use"
    default WITH_MM_FIXED_RANGE
    depends on D1_MALLOC_D0LIB

config WITH_MM_FIXED_RANGE
    bool "Memory management in a fixed range of memory"

config WITH_MM_FIXED_RANGE_FIXED_BLKCNT
    bool "Memory management with controlstructure in a separate addressspace"

config WITH_MM_DYNAMIC
    bool "Dynamic memory managment functions for D/AVE"

endchoice

config D1_DLIST_INDIRECT
    bool "Use DLIST indirect"

endif
```

## drivers/display/Kconfig.cdc200
```kconfig
# Alif CDC200 display driver configuration options

# Copyright (C) 2024 Alif Semiconductor
# SPDX-License-Identifier: Apache-2.0

config CDC200
	bool "CDC200 driver"
	default y
	depends on DT_HAS_TES_CDC_2_1_ENABLED
	help
	  Enable support for CDC200 driver controller.

config FB_USES_DTCM_REGION
	bool "CDC200 uses DTCM region for buffers"
```

## drivers/display/Kconfig.mw405
```kconfig
# Alif FocusLCDs MW-405 display panel configuration options

# Copyright (C) 2024 Alif Semiconductor
# SPDX-License-Identifier: Apache-2.0

config MW405
	bool "Focus-LCD E43GB-I-MW405-C display driver"
	default y
	depends on MIPI_DSI
	depends on DISPLAY
	depends on DT_HAS_FOCUSLCDS_MW405_ENABLED
	help
	  Enable driver for FocusLCDs MW405 display driver.
```

## drivers/dma/Kconfig.dma_pl330
```kconfig
# Copyright 2020 Broadcom
# SPDX-License-Identifier: Apache-2.0

config DMA_PL330
	bool
	prompt "PL330 DMA driver"
	default y
	depends on DT_HAS_ARM_DMA_PL330_ENABLED
	help
	  This option enables support of pl330 DMA Controller.

config DMA_PL330_MAX_BLOCK_COUNT
	int "Maximum scatter-gather block count per channel"
	depends on DMA_PL330
	default 2
	help
	  Number of dma_block_config entries pre-allocated per channel.
	  This is the maximum scatter-gather chain length accepted by
	  dma_config(). Increase if your application needs longer blocks.
```

## drivers/dma/Kconfig.event_router_alif
```kconfig
# Alif Event Router configuration options

# SPDX-FileCopyrightText: Copyright Alif Semiconductor
# SPDX-License-Identifier: Apache-2.0

config EVENT_ROUTER_ALIF
	bool "Alif Event Router (DMA Multiplexer) driver"
	default y
	depends on DMA_PL330
	depends on DT_HAS_ALIF_EVENT_ROUTER_ENABLED
	help
	  Enable support for Alif Event Router, a DMA multiplexer that routes
	  peripheral DMA requests to the ARM DMA-PL330 controller.

	  The Event Router provides:
	  - 32 output channels per instance
	  - Each channel can multiplex from 4 peripheral inputs (dma_group)
	  - 1:1 mapping to PL330 peripheral requests
	  - Configurable hardware handshaking per channel

	  This driver acts as a thin wrapper, delegating actual DMA operations
	  to the DMA-PL330 driver while handling event routing configuration.

	  Additionally provides a control API for non-DMA use cases such as
	  UTIMER loopback where events are routed between peripherals without
	  involving DMA transfers.

if EVENT_ROUTER_ALIF

config EVENT_ROUTER_ALIF_INIT_PRIORITY
	int "Alif Event Router init priority"
	default 41
	help
	  Event Router driver initialization priority. Must be higher than
	  DMA controller initialization priority (CONFIG_DMA_INIT_PRIORITY,
	  typically 40) to ensure the DMA controller is ready before the
	  event router driver attempts to use it.

module = EVENT_ROUTER_ALIF
module-str = event_router_alif
source "subsys/logging/Kconfig.template.log_config"

endif # EVENT_ROUTER_ALIF
```

## drivers/entropy/Kconfig.alif
```kconfig
# Copyright (c) 2024 Alif Semiconductor
#
# SPDX-License-Identifier: Apache-2.0

config ENTROPY_ALIF_RNG
	bool "Gets entropy number through MHUv2 in Alif SoCs"
	depends on ARM_MHUV2 && DT_HAS_ALIF_SECURE_ENCLAVE_TRNG_ENABLED
	default y
	select ENTROPY_HAS_DRIVER
	help
	  This option enables entropy driver which fetches
	  random number through MHUv2 service call from the
	  Secure Enclaue SubSystem (SESS).
```

## drivers/flash/Kconfig.alif
```kconfig
# Copyright (c) 2025 Alif Semiconductor
#
# SPDX-License-Identifier: Apache-2.0
config MRAM_FLASH_ALIF
	bool "MRAM flash driver for Alif SoCs"
	default y
	depends on DT_HAS_ALIF_MRAM_FLASH_CONTROLLER_ENABLED
	select FLASH_HAS_DRIVER_ENABLED
	select FLASH_HAS_PAGE_LAYOUT
	select FLASH_HAS_NO_EXPLICIT_ERASE
	help
	 Enables MRAM flash driver on Alif SoCs.

menuconfig OSPI_FLASH
	bool "OSPI Flash support for Alif SoCs"
	depends on (DT_HAS_MXICY_MX66UW_FLASH_ENABLED || DT_HAS_ISSI_XSPI_FLASH_CONTROLLER_ENABLED)
	default y
	select FLASH_HAS_DRIVER_ENABLED
	select FLASH_HAS_PAGE_LAYOUT
	select EVENTS
	select FLASH_HAS_EXPLICIT_ERASE
	select USE_ALIF_HAL_OSPI
	help
	  Enable OSPI flash support on Alif SoCs.
	  Select the flash vendor below.

config OSPI_FLASH_MX66UW
	bool "Macronix MX66UW (1G/2G)"
	depends on DT_HAS_MXICY_MX66UW_FLASH_ENABLED
	default y
	help
	  Enables Macronix MX66UW flash driver.

config OSPI_FLASH_IS25WX
	bool "ISSI IS25WX (128/256/512)"
	depends on DT_HAS_ISSI_XSPI_FLASH_CONTROLLER_ENABLED
	default y
	help
	  Enables ISSI IS25WX flash driver.

if OSPI_FLASH

config OSPI
	bool "OSPI Controller Enabled"
	default y
	help
	  Indicate OSPI Controller Enabled.

config FLASH_ADDRESS_IN_SINGLE_FIFO_LOCATION
	bool "Flash Setup with Single Address mode"
	default y if SOC_SERIES_E8 || SOC_SERIES_E4 || \
		     SOC_SERIES_E1C || SOC_SERIES_B1
	help
	  Enables Single Address mode while setting up OSPI flash.
	  Required only for specific Alif SoC families.

config FLASH_PREPARE_CMD_LEN
	int "Number of 32-bit buffers for prepare command"
	default 3 if FLASH_ADDRESS_IN_SINGLE_FIFO_LOCATION
	default 5
	help
	  Configure prepare command length.

config ALIF_OSPI_FLASH_XIP
	bool "Enable XiP mode"
	help
	  Enable XiP mode of Flash at initialization.

endif # OSPI_FLASH
```
