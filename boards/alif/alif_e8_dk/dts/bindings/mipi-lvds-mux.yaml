## drivers/flash/Kconfig.mspi
```kconfig
# Copyright (c) 2024 Ambiq Micro Inc. <www.ambiq.com>
# SPDX-License-Identifier: Apache-2.0

menu "MSPI flash device driver"

config FLASH_MSPI
	bool
	select FLASH_HAS_DRIVER_ENABLED
	select MSPI
	help
	  MSPI flash drivers are enabled.

config FLASH_MSPI_EMUL_DEVICE
	bool "MSPI flash device emulator"
	default y
	depends on DT_HAS_ZEPHYR_MSPI_EMUL_FLASH_ENABLED
	select FLASH_MSPI
	select FLASH_HAS_PAGE_LAYOUT
	select FLASH_HAS_EXPLICIT_ERASE

config FLASH_MSPI_ATXP032
	bool "MSPI ATXP032 driver"
	default y
	depends on DT_HAS_MSPI_ATXP032_ENABLED
	select FLASH_MSPI
	select FLASH_HAS_PAGE_LAYOUT
	select FLASH_HAS_EXPLICIT_ERASE
	select FLASH_JESD216
	select MSPI_AMBIQ_AP3 if SOC_SERIES_APOLLO3X

config FLASH_MSPI_IS25XX0XX
	bool "MSPI IS25L/WX064/32/512/1G driver"
	default y
	depends on DT_HAS_IS25XX0XX_ENABLED
	select FLASH_MSPI
	select FLASH_HAS_PAGE_LAYOUT
	select FLASH_HAS_EXPLICIT_ERASE
	select FLASH_JESD216
	select FLASH_JESD216_API

config FLASH_MSPI_IS25XX0XX_INIT_PRIORITY
	int "MSPI IS25L/WX064/032 flash init priority"
	default 75
	depends on FLASH_MSPI_IS25XX0XX
	help
	  Device initialization priority for ISSI MSPI flash. This must be
	  greater than the MSPI controller initialization priority because
	  the flash device is a child of the MSPI controller.

if FLASH_MSPI

config FLASH_MSPI_XIP_READ
	bool "Read MSPI flash through XIP"
	depends on MSPI_XIP
	help
	  Allows MSPI flash drivers to service read requests through the
	  controller XIP mapping when the device XIP configuration is enabled.

endif # FLASH_MSPI

endmenu
```

## drivers/i2c/Kconfig.alif
```kconfig
# Copyright (C) 2024 Alif Semiconductor
# SPDX-License-Identifier: Apache-2.0

config LPI2C_ALIF
	bool "Enable LPI2C for Alif Boards"
	default n
	depends on I2C && DT_HAS_ALIF_LPI2C_ENABLED
	help
	  Enable LPI2C module for Alif Boards
```

## drivers/i2c/Kconfig.gpio_i2c_mux
```kconfig
# Copyright (C) 2025 Alif Semiconductor
# SPDX-License-Identifier: Apache-2.0

config GPIO_I2C_MUX
	bool "GPIO controlled SPDT switch based I2C Muliplexer"
	default y
	depends on I2C && DT_HAS_GPIO_I2C_MUX_ENABLED
	help
	  Enable GPIO controlled SPDT switch based I2C mux.
```

## drivers/i2s/Kconfig.dw
```kconfig
# Copyright (C) 2025 Alif Semiconductor.
# SPDX-License-Identifier: Apache-2.0

# Designware I2S driver configuration options
menuconfig I2S_DW
	bool "Designware I2S controller driver"
	default y
	depends on DT_HAS_SNPS_DESIGNWARE_I2S_ENABLED
	help
	  Enable Designware I2S support.

if I2S_DW

config I2S_DW_RX_BLOCK_COUNT
	int "RX queue length"
	default 10

config I2S_DW_TX_BLOCK_COUNT
	int "TX queue length"
	default 10

endif # I2S_DW
```
