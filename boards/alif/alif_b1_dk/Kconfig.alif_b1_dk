## boards/alif/alif_b1_dk/Kconfig.alif_b1_dk
```kconfig
# Copyright (c) 2025 Alif Semiconductor
#
# SPDX-License-Identifier: Apache-2.0

config BOARD_ALIF_B1_DK
	select SOC_AB1C1F4M51820HH_RTSS_HE if BOARD_ALIF_B1_DK_AB1C1F4M51820HH_RTSS_HE
if BOARD_ALIF_B1_DK

config UART_DMA_ENABLE
	bool
endif
```

## boards/alif/alif_b1_dk/alif_b1_dk_ab1c1f4m51820hh_rtss_he_defconfig
```kconfig
# Copyright (c) 2025 Alif Semiconductor
#
# SPDX-License-Identifier: Apache-2.0
CONFIG_CORTEX_M_SYSTICK=y
CONFIG_XIP=y
CONFIG_RUNTIME_NMI=y
CONFIG_FPU=y
CONFIG_FP_HARDABI=y
CONFIG_SOC_SUPPORT_ARM_MHUV2=y

CONFIG_SERIAL=y
CONFIG_CONSOLE=y
CONFIG_UART_CONSOLE=y
CONFIG_UART_INTERRUPT_DRIVEN=y
CONFIG_UART_NS16550=y
# UART variant of ns16550 that supports auto flow control
CONFIG_UART_NS16550_VARIANT_NS16750=y
CONFIG_GPIO=y
CONFIG_GPIO_DW=y

# Cache Management
CONFIG_CACHE_MANAGEMENT=y
```

## boards/alif/alif_b1_dk/alif_b1_dk_ab1c1f4m51820ph0_rtss_he_defconfig
```kconfig
# Copyright (c) 2025 Alif Semiconductor
#
# SPDX-License-Identifier: Apache-2.0
CONFIG_CORTEX_M_SYSTICK=y
CONFIG_XIP=y
CONFIG_RUNTIME_NMI=y
CONFIG_ARM_MPU=y
CONFIG_PINCTRL=y
CONFIG_FPU=y
CONFIG_FP_HARDABI=y
CONFIG_SOC_SUPPORT_ARM_MHUV2=y

CONFIG_SERIAL=y
CONFIG_CONSOLE=y
CONFIG_UART_CONSOLE=y
CONFIG_UART_INTERRUPT_DRIVEN=y

CONFIG_UART_NS16550=y
# UART variant of ns16550 that supports auto flow control
CONFIG_UART_NS16550_VARIANT_NS16750=y
# Support break condition
CONFIG_UART_LINE_CTRL=y
CONFIG_UART_NS16550_LINE_CTRL=y

CONFIG_GPIO=y
CONFIG_GPIO_DW=y

# Cache Management
CONFIG_CACHE_MANAGEMENT=y

CONFIG_CLOCK_CONTROL=y
CONFIG_SYS_CLOCK_HW_CYCLES_PER_SEC=160000000

# Set Kernel device Priority levels
CONFIG_KERNEL_INIT_PRIORITY_DEFAULT=0
CONFIG_SE_SERVICE_INIT_PRIORITY=1
CONFIG_GPIO_INIT_PRIORITY=40
```

## boards/alif/alif_b1_dk/board.yml
```yaml
board:
  name: alif_b1_dk
  full_name: alif b1 DK
  vendor: alif
  socs:
  - name: ab1c1f4m51820hh0
  - name: ab1c1f4m51820ph0
  - name: ab1c1f1m41820hh0
  - name: ab1c1f1m41820ph0
```

## boards/alif/alif_b1_sk/Kconfig.alif_b1_sk
```kconfig
# Copyright (c) 2026 Alif Semiconductor
#
# SPDX-License-Identifier: Apache-2.0

config BOARD_ALIF_B1_SK
	select SOC_AB1C1F4M51820PH0_RTSS_HE if BOARD_ALIF_B1_SK_AB1C1F4M51820PH0_RTSS_HE

if BOARD_ALIF_B1_SK

config UART_DMA_ENABLE
	bool
endif
```

## boards/alif/alif_b1_sk/board.yml
```yaml
board:
  name: alif_b1_sk
  full_name: alif b1 SK
  vendor: alif
  socs:
  - name: ab1c1f4m51820ph0
```

## boards/alif/alif_e1c_dk/Kconfig.alif_e1c_dk
```kconfig
# Copyright (c) 2025 Alif Semiconductor
#
# SPDX-License-Identifier: Apache-2.0

config BOARD_ALIF_E1C_DK
	select SOC_AE1C1F4051920HH_RTSS_HE if BOARD_ALIF_E1C_DK_AE1C1F4051920HH_RTSS_HE
```

## boards/alif/alif_e1c_dk/board.yml
```yaml
board:
  name: alif_e1c_dk
  full_name: alif e1c DevKit
  vendor: alif
  socs:
  - name: 'ae1c1f4051920hh'
```

## boards/alif/alif_e1c_sk/Kconfig.alif_e1c_sk
```kconfig
# Copyright (c) 2026 Alif Semiconductor
#
# SPDX-License-Identifier: Apache-2.0

config BOARD_ALIF_E1C_SK
	select SOC_AE1C1F4051920HH_RTSS_HE if BOARD_ALIF_E1C_SK_AE1C1F4051920HH_RTSS_HE
```

## boards/alif/alif_e1c_sk/board.yml
```yaml
board:
  name: alif_e1c_sk
  full_name: alif e1c StarterKit
  vendor: alif
  socs:
  - name: 'ae1c1f4051920hh'
```

## boards/alif/alif_e1c_sk/dts/bindings/lpcam-cam-enbuf.yaml
```yaml
# Copyright (C) 2026 Alif Semiconductor.
# SPDX-License-Identifier: Apache-2.0

description: |
  GPIO control for enabling the camera level shifter buffer.
  The CAM_ENBUF signal controls the OE pin of the NXB0108
  level shifter used between the camera sensor and ARD interface.

compatible: "arducam-enbuf"

properties:
  enbuf-gpios:
    type: phandle-array
    required: true
    description: |
      GPIO used to enable the camera buffer level shifter.
      Setting the GPIO active enables the NXB0108 buffer.
```

## boards/alif/alif_e3_dk/Kconfig.alif_e3_dk
```kconfig
# Copyright (c) 2025 Alif Semiconductor
#
# SPDX-License-Identifier: Apache-2.0

config BOARD_ALIF_E3_DK
	select DEPRECATED
	select SOC_AE302F80F55D5XX_RTSS_HE if BOARD_ALIF_E3_DK_AE302F80F55D5XX_RTSS_HE
	select SOC_AE302F80F55D5XX_RTSS_HP if BOARD_ALIF_E3_DK_AE302F80F55D5XX_RTSS_HP
	help
	  alif_e3_dk is deprecated and will be removed in a future release.
	  E3 series SoCs are now supported on the alif_e7_dk board.
	  Please update your build to use one of the following:
	    west build -b alif_e7_dk/ae302f80f55d5xx/rtss_hp
	    west build -b alif_e7_dk/ae302f80f55d5xx/rtss_he
```

## boards/alif/alif_e3_dk/board.yml
```yaml
board:
  name: alif_e3_dk
  full_name: alif e3 DK
  vendor: alif
  socs:
  - name: 'ae302f80f55d5xx'
  - name: 'ae302f80f5582xx'
```

## boards/alif/alif_e4_dk/Kconfig.alif_e4_dk
```kconfig
# Copyright (c) 2025 Alif Semiconductor
#
# SPDX-License-Identifier: Apache-2.0

config BOARD_ALIF_E4_DK
	select DEPRECATED
	select SOC_AE402FA0E5597XX0_RTSS_HE if BOARD_ALIF_E4_DK_AE402FA0E5597XX0_RTSS_HE
	select SOC_AE402FA0E5597XX0_RTSS_HP if BOARD_ALIF_E4_DK_AE402FA0E5597XX0_RTSS_HP
	help
	  alif_e4_dk is deprecated and will be removed in a future release.
	  E4 series SoCs are now supported on the alif_e8_dk board.
	  Please update your build to use one of the following:
	    west build -b alif_e8_dk/ae402fa0e5597xx0/rtss_hp
	    west build -b alif_e8_dk/ae402fa0e5597xx0/rtss_he
```

## boards/alif/alif_e4_dk/board.yml
```yaml
board:
  name: alif_e4_dk
  full_name: alif e4 DK
  vendor: alif
  socs:
  - name: 'ae402fa0e5597xx0'
```

## boards/alif/alif_e5_dk/Kconfig.alif_e5_dk
```kconfig
# Copyright (c) 2026 Alif Semiconductor
#
# SPDX-License-Identifier: Apache-2.0

config BOARD_ALIF_E5_DK
	select SOC_AE512F80F55D5XX_RTSS_HE if BOARD_ALIF_E5_DK_AE512F80F55D5XX_RTSS_HE
	select SOC_AE512F80F55D5XX_RTSS_HP if BOARD_ALIF_E5_DK_AE512F80F55D5XX_RTSS_HP
	select SOC_AE512F80F5582XX_RTSS_HE if BOARD_ALIF_E5_DK_AE512F80F5582XX_RTSS_HE
	select SOC_AE512F80F5582XX_RTSS_HP if BOARD_ALIF_E5_DK_AE512F80F5582XX_RTSS_HP
```

## boards/alif/alif_e5_dk/board.yml
```yaml
board:
  name: alif_e5_dk
  full_name: alif e5 DK
  vendor: alif
  socs:
  - name: 'ae512f80f55d5xx'
  - name: 'ae512f80f5582xx'
```

## boards/alif/alif_e7_ak/board.yml
```yaml
board:
  name: alif_e7_ak
  full_name: alif e7 AppKit
  vendor: alif
  socs:
  - name: 'ae722f80f55d5xx'
```

## boards/alif/alif_e7_dk/Kconfig.alif_e7_dk
```kconfig
# Copyright (c) 2025 Alif Semiconductor
#
# SPDX-License-Identifier: Apache-2.0

config BOARD_ALIF_E7_DK
	select SOC_AE722F80F55D5XX_RTSS_HE if BOARD_ALIF_E7_DK_AE722F80F55D5XX_RTSS_HE
	select SOC_AE722F80F55D5XX_RTSS_HP if BOARD_ALIF_E7_DK_AE722F80F55D5XX_RTSS_HP
```

## boards/alif/alif_e7_dk/alif_e7_dk_ae722f80f55d5xx_apss_defconfig
```kconfig
# Copyright (c) 2025 Alif Semiconductor
#
# SPDX-License-Identifier: Apache-2.0
CONFIG_SYS_CLOCK_HW_CYCLES_PER_SEC=100000000
CONFIG_SYS_CLOCK_TICKS_PER_SEC=1000
CONFIG_SYS_CLOCK_EXISTS=y
CONFIG_XIP=n
CONFIG_ARM_ARCH_TIMER=y
CONFIG_CONSOLE=y
CONFIG_UART_CONSOLE=y
CONFIG_UART_INTERRUPT_DRIVEN=y
CONFIG_SERIAL=y
CONFIG_UART_NS16550=y
```

## boards/alif/alif_e7_dk/alif_e7_dk_ae722f80f55d5xx_rtss_he_defconfig
```kconfig
# Copyright (c) 2025 Alif Semiconductor
#
# SPDX-License-Identifier: Apache-2.0
CONFIG_CORTEX_M_SYSTICK=y
CONFIG_XIP=y
CONFIG_ARM_MPU=y
CONFIG_FPU=y
CONFIG_FP_HARDABI=y

CONFIG_SERIAL=y
CONFIG_CONSOLE=y
CONFIG_UART_CONSOLE=y
CONFIG_UART_INTERRUPT_DRIVEN=y
CONFIG_UART_NS16550=y
# UART variant of ns16550 that supports auto flow control
CONFIG_UART_NS16550_VARIANT_NS16750=y
CONFIG_GPIO=y
CONFIG_GPIO_DW=y

# Cache Management
CONFIG_CACHE_MANAGEMENT=y
```

## boards/alif/alif_e7_dk/board.yml
```yaml
board:
  name: alif_e7_dk
  full_name: alif e7 DK
  vendor: alif
  socs:
  - name: 'ae722f80f55d5xx'
```

## boards/alif/alif_e8_ak/board.yml
```yaml
board:
  name: alif_e8_ak
  full_name: alif e8 ak
  vendor: alif
  socs:
  - name: 'ae822fa0e5597xx0'
```

## boards/alif/alif_e8_dk/Kconfig.alif_e8_dk
```kconfig
# Copyright (c) 2025 Alif Semiconductor
#
# SPDX-License-Identifier: Apache-2.0

config BOARD_ALIF_E8_DK
	select SOC_AE822FA0E5597XX0_RTSS_HE if BOARD_ALIF_E8_DK_AE822FA0E5597XX0_RTSS_HE
	select SOC_AE822FA0E5597XX0_RTSS_HP if BOARD_ALIF_E8_DK_AE822FA0E5597XX0_RTSS_HP
```

## boards/alif/alif_e8_dk/board.yml
```yaml
board:
  name: alif_e8_dk
  full_name: alif e8 DK
  vendor: alif
  socs:
  - name: 'ae822fa0e5597xx0'
  - name: 'ae402fa0e5597xx0'
```
