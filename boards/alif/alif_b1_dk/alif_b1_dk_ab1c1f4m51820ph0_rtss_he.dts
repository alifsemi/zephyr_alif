/* Copyright (c) 2025 Alif Semiconductor
 *
 * SPDX-License-Identifier: Apache-2.0
 */

/dts-v1/;

#include <alif/balletto/b1/ab1c1f4m51820ph0.dtsi>
#include "../common/balletto-pinctrl.dtsi"
#include "alif_b1_dk_ab1c1f4m51820xx0_rtss_he.dtsi"

/ {
	compatible = "arm,alif-b1-dk-ab1c1f4m51820ph0-rtss-he";
	#address-cells = <1>;
	#size-cells = <1>;
};

&ieee802154 {
	status = "okay";
};
