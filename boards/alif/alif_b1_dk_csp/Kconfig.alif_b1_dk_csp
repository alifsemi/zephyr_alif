## boards/alif/alif_b1_dk_csp/Kconfig.alif_b1_dk_csp
```kconfig
# Copyright (c) 2026 Alif Semiconductor
#
# SPDX-License-Identifier: Apache-2.0

config BOARD_ALIF_B1_DK_CSP
	select SOC_AB1C1F4M51820HH0_RTSS_HE if BOARD_ALIF_B1_DK_CSP_AB1C1F4M51820HH0_RTSS_HE

if BOARD_ALIF_B1_DK_CSP

config UART_DMA_ENABLE
	bool
endif
```

## boards/alif/alif_b1_dk_csp/board.yml
```yaml
board:
  name: alif_b1_dk_csp
  full_name: Alif B1 DK CSP HPA
  vendor: alif
  socs:
  - name: ab1c1f4m51820hh0
```

## soc/alif/balletto/common/Kconfig
```kconfig
# Copyright (c) 2025 Alif Semiconductor
#
# SPDX-License-Identifier: Apache-2.0

config RTSS_HE
	bool "RTSS_HE core"
	select CORTEX_M_SYSTICK_RESET_BY_LPM if (PM && CORTEX_M_SYSTICK && \
						 !CORTEX_M_SYSTICK_LPM_TIMER_NONE)
	help
	  Enable RTSS_HE core.

config HAS_ALIF_BLE_802154_LINK_LAYER
	bool
	help
	  Device has BLE and 802154 Link Layers

config HAS_ALIF_BLE_ROM_IMAGE
	bool
	help
	  Device has BLE HOST and LC3 ROM code

if HAS_ALIF_BLE_ROM_IMAGE

# BLE ROM version is hardware-specific and defined in DTS.
# The version is automatically detected from the ble-rom-version property.

DT_SOC_INFO := $(dt_nodelabel_path,soc_info)

config ALIF_BLE_ROM_IMAGE_V1_2
	def_bool $(dt_node_str_prop_equals,$(DT_SOC_INFO),ble-rom-version,1.2) && !ALIF_BLE_ROM_API_EXTERNAL
	help
	  BLE ROM version 1.2 (automatically set from device tree)

# To add support for a new BLE ROM version (e.g., v1.3):
# 1. Add "1.3" to the enum in zephyr/dts/bindings/arm/alif,balletto-soc.yaml
# 2. Add a new config here:
#    config ALIF_BLE_ROM_IMAGE_V1_3
#        def_bool $(dt_node_str_prop_equals,$(DT_SOC_INFO),ble-rom-version,1.3)
# 3. Update CMakeLists.txt in modules/hal/alif/ble/ and modules/hal/alif/lc3/
# 4. Create version-specific subdirectories with ROM symbols

endif

config HAS_ALIF_POWER_MANAGER
	bool
	depends on HAS_ALIF_SE_SERVICES
	help
	  Device has Alif Power Manager services

if BT

config BT_BUF_ACL_RX_SIZE
	range 251 65535
	default 251

config BT_BUF_EVT_RX_COUNT
	default 20 if (BT_MESH && !(BT_BUF_EVT_DISCARDABLE_COUNT > 0))
	default 10
	range 10 255

config BT_BUF_ACL_TX_COUNT
	default 6
	range 6 255

endif # BT

config ALIF_HWSEM_INIT_PRIORITY
	int "HWSEM Init priority"
	depends on ALIF_HWSEM
	default 50
	help
	  Hardware Semaphore driver initialization priority.

config SOC_SUPPORT_ARM_MHUV2
	bool "SoC support communication through Arm MHUv2"
	depends on SOC_FAMILY_ENSEMBLE || SOC_FAMILY_BALLETTO
	select IPM
	select ARM_MHUV2
	help
	  SoC support communication through Arm MHUv2

config SPI_DW_ENABLE
	bool "SPI DW"
	default y
	depends on SPI && DT_HAS_SNPS_DESIGNWARE_SPI_ENABLED
	help
	  Enable Designware SPI driver.
	select SPI_DW

config USE_ALIF_HAL_UTIMER
	bool "UTIMER ll driver access"
	default n
	help
	  Enables UTIMER LL driver on Alif SoCs.

config USE_ALIF_HAL_ANALOG
	bool "Enable Alif HAL Analog support"
	default n
	help
	  Enables access to Alif HAL analog layer(ADC, DAC, CMP)

config USE_ALIF_HAL_OSPI
	bool "OSPI driver located in HAL Module"
	default n
	help
	  Enables OSPI driver on Alif SoCs.

config FLASH_SIZE
	default $(dt_node_reg_size_int,$(dt_nodelabel_path,itcm),0,K) if !XIP

config FLASH_BASE_ADDRESS
	default $(dt_node_reg_addr_hex,$(dt_nodelabel_path,itcm))     if !XIP

if COUNTER_SNPS_DW
config LPTIMER0_OUTPUT_TOGGLE
	bool "LPTimer0 Output Toggle"
	help
	  Enable lptimer 0 output toggle.

config LPTIMER0_EXT_CLK_FREQ
	int "LPTimer0 External clock source Frequency value"
	default 0
	help
	  Provide lptimer 0 clock frequency for external clock source.

config LPTIMER1_OUTPUT_TOGGLE
	bool "LPTimer1 Output Toggle"
	help
	  Enable lptimer 1 output toggle.

config LPTIMER1_EXT_CLK_FREQ
	int "LPTimer1 External clock source Frequency value"
	default 0
	help
	  Provide lptimer 1 clock frequency for external clock source.
endif # COUNTER_SNPS_DW

menuconfig ALIF_PM_LINK_LAYER
	bool "Alif link layer configuration"
	default y if HAS_ALIF_BLE_802154_LINK_LAYER
	depends on HAS_ALIF_POWER_MANAGER
	depends on HAS_ALIF_SE_SERVICES

if ALIF_PM_LINK_LAYER

config ALIF_PM_LE_CODED_PHY_500
	int "LE Coded PHY 500 Kbps selection"
	default 0

config ALIF_PM_DFT_SLAVE_MD
	int "Default MD bit used by slave when sending a data packet on a BLE connection"
	default 0

config ALIF_PM_CH_CLASS_REP_INTV
	int "Channel classification reporting interval (in ms) (0 if not used)"
	default 0

# config ALIF_PM_BD_ADDRESS
# 	string "Local Bd Address"
# 	default {0x01, 0x23, 0x45, 0x67, 0x89, 0xAB}

config ALIF_PM_ACTIVITY_MOVE_CONFIG
	int "Activity Move Configuration (enables/disables activity move for BLE connections and BT (e)SCO links)"
	default 1

config ALIF_PM_SCAN_EXT_ADV
	int "Enable/disable scanning for extended advertising PDUs"
	default 1

config ALIF_PM_RSSI_HIGH_THR
	int "RSSI high threshold"
	default -40

config ALIF_PM_RSSI_LOW_THR
	int "RSSI low threshold"
	default -60

config ALIF_PM_SLEEP_ENABLE
	int "Enable sleep mode"
	default 1

config ALIF_PM_EXT_WAKEUP_ENABLE
	int "Enable External Wakeup"
	default 1

config ALIF_PM_ENABLE_CH_ASSESSMENT
	int "Enable/disable channel assessment for BLE"
	default 1

config ALIF_PM_RSSI_INTERF_THR
	int "RSSI interference threshold"
	default -70

config ALIF_EXT_WAKEUP_TIME
	int "External wakeup time needed (us)"
	default 25000

config ALIF_OSC_WAKEUP_TIME
	int "Oscilator enable wakeup time needed (us)"
	default 25000

config ALIF_RM_WAKEUP_TIME
	int "Radio wakeup time needed (us)"
	default 625

config ALIF_EXT_WARMBOOT_WAKEUP_TIME
	int "Warmboot wakeup time. Time limit between light / deep sleep (us)"
	default 32000

config ALIF_MAX_SLEEP_CLOCK_DRIFT
	int "Max drift of sleep clock in PPM"
	default 250
	range 20 65535

config ALIF_MAX_ACTIVE_CLOCK_DRIFT
	int "Max drift of active clock in PPM"
	default 250
	range 20 255

config ALIF_HPA_MODE
	bool "High Power Amplifier for Alif controller"

config ALIF_TX_MAX
	int
	default 10 if ALIF_HPA_MODE
	default 4

config ALIF_TX_MIN
	int
	default -25 if ALIF_HPA_MODE
	default -31

config ALIF_TX_MAX_POWER
	int "Set maximum allowed TX power in dBm"
	default ALIF_TX_MAX
	range ALIF_TX_MIN ALIF_TX_MAX

config ALIF_EDGE_LIMIT_ON
	bool # "Limit power on edge channels"
	default y if (BOARD_ALIF_B1_DK && !ALIF_HPA_MODE)
	default n

config ALIF_EDGE_LOW_CHANNEL
	int "First channel the edge limit is not applied"
	default 0

config ALIF_EDGE_HIGH_CHANNEL
	int "Last channel the edge limit is not applied"
	default 37 if (BOARD_ALIF_B1_DK && !ALIF_HPA_MODE)
	default 39

config ALIF_EDGE_CHANNEL_POWER_LIMIT
	int "Set maximum allowed TX power in dBm for edges"
	default 2 if (BOARD_ALIF_B1_DK && !ALIF_HPA_MODE)
	default ALIF_TX_MAX_POWER
	range ALIF_TX_MIN ALIF_TX_MAX_POWER

endif # ALIF_PM_LINK_LAYER

rsource "../../common/Kconfig"
```
