## dts/bindings/mtd/issi,is66wvh-mspi.yaml
```yaml
# Copyright (c) 2026 Alif Semiconductor
# SPDX-License-Identifier: Apache-2.0

description: ISSI IS66/67WVH HyperRAM on an MSPI bus

compatible: "issi,is66wvh"

include: mspi-device.yaml

properties:
  size:
    type: int
    required: true
    description: HyperRAM capacity in bytes.

  xip-config:
    required: true
```

## dts/bindings/ospi/snps,designware-ospi.yaml
```yaml
# Copyright (C) 2024 Alif Semiconductor.
# SPDX-License-Identifier: Apache-2.0

description: Synopsys Designware OSPI controller.

compatible: "snps,designware-ospi"

include: [base.yaml, pinctrl-device.yaml]

properties:
  reg:
    required: true

  interrupts:
    required: true

  pinctrl-0:
    required: true

  pinctrl-names:
    required: true

  aes-reg:
    type: array
    description: register space
    required: true

  bus-speed:
    type: int
    required: true
    description: speed

  clock-frequency:
    type: int
    description: Input clock frequency

  cs-pin:
    type: int
    description: slave connected pin
    required: true

  ddr-drive-edge:
    type: int
    description: control the driving edge of TXD in DDR mode
    default: 1

  rx-ds-delay:
    type: int
    description: receive datastrobe delay
    default: 16

  enable-signal-delay:
    type: boolean
    description: |
      Enable/Disable signal delay for higher frequency
      This is used to enable/disable the signal delay for higher frequency operation.
      When enabled, the controller will add a delay to the signals to meet timing requirements.
      When disabled, the controller will not add any delay to the signals.

  txd-delays:
    type: array
    description: |
      Output data lines 0 through 15, in delay taps (0 through 23, approximately 350 ps each).
      Must contain exactly 16 entries.

  rxd-delays:
    type: array
    description: |
      Input data lines 0 through 15, in delay taps (0 through 23, approximately 350 ps each).
      Must contain exactly 16 entries.

  ssi-oe-n-delays:
    type: array
    description: |
      Data output-enable lines 0 through 15, in delay taps (0 through 23, approximately 350 ps each).
      Must contain exactly 16 entries.

  rx-ds-delays:
    type: array
    description: |
      Read strobes 0 and 1, in delay taps (0 through 23, approximately 350 ps each).
      Must contain exactly 2 entries.

  txd-dm-delays:
    type: array
    description: |
      Data masks 0 and 1, in delay taps (0 through 23, approximately 350 ps each).
      Must contain exactly 2 entries.

  dm-oe-n-delays:
    type: array
    description: |
      Data-mask output-enable lines 0 and 1, in delay taps (0 through 23, approximately 350 ps each).
      Must contain exactly 2 entries.

  ss-n-delays:
    type: array
    description: |
      Chip selects 0 and 1, in delay taps (0 through 23, approximately 350 ps each).
      Must contain exactly 2 entries.

  sclk-delay:
    type: int
    description: |
      Serial clock, in delay taps (0 through 23, approximately 350 ps each).

  sclkn-delay:
    type: int
    description: |
      Inverted serial clock, in delay taps (0 through 23, approximately 350 ps each).

  baud2-signal-delay:
    type: int
    description: TX/RX signal delay for higher frequency
    default: 22

  tx-fifo-threshold:
    type: int
    description: transmit fifo threshold
    default: 128

  xip-wait-cycles:
    type: int
    description: waitcycles on XiP transaction
    default: 16

  xip-rxds-vl-en:
    type: boolean
    description: Enable/Disable RXDS Variable Latency on XiP transaction

  xip-base-address:
    type: array
    description: XiP memory address range

  baud2-delay:
    type: int
    description: Enable/disable BAUD2 delay. This needs to be enabled when BAUDR divisor is 2.
                 Enumerated values
                 0 - disable BAUD2 delay
                 1 - enable BAUD2 delay
                 2 - auto sets BAUD2 delay when BAUDR divisor is 2
    default: 2
    enum:
      - 0
      - 1
      - 2
```

## dts/bindings/p_state/alif,rtss-pstate.yaml
```yaml
# SPDX-FileCopyrightText: Copyright Alif Semiconductor
# SPDX-License-Identifier: Apache-2.0

description: |
  Alif RTSS performance state (P-state).

  Each child of /performance-states overlays only the properties it sets
  onto the compile-time aipm_run_default run profile. cpu_freq_pstate_set()
  sends that composed run_profile_t to the Secure Enclave.

  Properties use the same names and values as alif,aipm-run children.
  Omit a property to keep aipm_run_default's value. Memory-block, gating,
  ioflex, and aon-clk stay with the run default unless added later.

  Example:

    performance-states {
            pstate_0: pstate_0 {
                    compatible = "alif,rtss-pstate";
                    load-threshold = <0>;
                    cpu-clk-freq = <ALIF_CLOCK_FREQ_160MHZ>;
            };
            pstate_1: pstate_1 {
                    compatible = "alif,rtss-pstate";
                    load-threshold = <0>;
                    cpu-clk-freq = <ALIF_CLOCK_FREQ_80MHZ>;
            };
    };

compatible: "alif,rtss-pstate"

include: "zephyr,pstate.yaml"

properties:
  cpu-clk-freq:
    type: int
    required: true
    description: |
      CPU clock frequency (run_profile_t.cpu_clk_freq).
      Use ALIF_CLOCK_FREQ_* constants from
      dt-bindings/misc/alif_aipm_common.h.

  clk-src:
    type: string
    enum:
      - "hfrc"
      - "hfxo"
      - "pll"
    description: |
      High-frequency run clock source (run_profile_t.run_clk_src).
        "hfrc" - CLK_SRC_HFRC
        "hfxo" - CLK_SRC_HFXO
        "pll"  - CLK_SRC_PLL

  scaled-clk-freq:
    type: int
    description: |
      Scaled clock frequency (run_profile_t.scaled_clk_freq).
      Use ALIF_SCALED_FREQ_* constants from
      dt-bindings/misc/alif_aipm_common.h.

  dcdc-voltage:
    type: int
    description: |
      DCDC output voltage in millivolts (run_profile_t.dcdc_voltage).
      Valid values: 800, 825, 850.

  dcdc-mode:
    type: string
    enum:
      - "off"
      - "pfm-auto"
      - "pfm-forced"
      - "pwm"
    description: |
      DCDC operating mode (run_profile_t.dcdc_mode).
        "off"        - DCDC_MODE_OFF
        "pfm-auto"   - DCDC_MODE_PFM_AUTO
        "pfm-forced" - DCDC_MODE_PFM_FORCED
        "pwm"        - DCDC_MODE_PWM

  aipm-power-domains:
    type: int
    description: |
      Power domain bitmask (run_profile_t.power_domains).
      Use ALIF_PD_*_MASK constants from
      dt-bindings/misc/alif_aipm_common.h.
```

## dts/bindings/timer/alif,utimer.yaml
```yaml
# Copyright (c) 2024 Alif Semiconductor
#
# SPDX-License-Identifier: Apache-2.0

description: Alif Universal Timer

compatible: "alif,utimer"

include: [base.yaml]

properties:
  reg:
    required: true

  reg-names:
    required: true

  timer-id:
    type: int
    description: |
      Channel number for each channel

  counter-direction:
    type: int
    required: true
    description: |
      Sets timer counter direction.

      Use constants defined in dt-bindings/timer/alif-utimer.h.

      * ALIF_UTIMER_COUNTER_DIRECTION_UP           - used as up counter.
      * ALIF_UTIMER_COUNTER_DIRECTION_DOWN         - used as down counter.
      * ALIF_UTIMER_COUNTER_DIRECTION_TRIANGLE     - used as triangle counter.

  dma-trig:
    type: boolean
    description: |
      Use this UTIMER as a DMA request source (UTn_T0 driver-A output).
      On Ensemble/Balletto, EVTRTR maps UT0_T0 compare events to
      DMA0_REQ (see SoC HRM DMA request / Event Router tables, e.g.
      Table 12-29 on E7/E8). The driver output rising edge at compare
      match (COMPARE_CTRL HIGH_AT_COMP_MATCH + COMPARE_TRIG_EN) is the
      handshake; CHAN_INTERRUPT may latch but CPU IRQ stays off.
      DMA_REQ is held low between alarms; cancel_alarm re-arms the
      line. Use counter_set_channel_alarm() with a NULL callback
      (CPU alarm callbacks are not supported in this mode). Both
      compare channels are intended for DMA request use when enabled.
      After counter_set_channel_alarm() the channel stays busy (dma_armed)
      until counter_cancel_channel_alarm(), even after the compare match
      and DMA transfer complete.       Application flow: dma_config, cancel_alarm() (re-arm REQ low),
      counter_set_channel_alarm(NULL), dma_start (PL330 must wait before
      the compare rising edge), wait for DMA completion, then cancel_alarm()
      before the next period. Avoid relative ticks==0 (driver schedules only
      the minimum lead time). A second set_channel_alarm
      without cancel returns -EBUSY. Requires counter-direction up. Alarm
      and top callbacks are not invoked in this mode.

  dmas:
    type: phandle-array
    description: |
      Overlay DMA mux. This driver does not start DMA.
      Cell 0 is the event router with ALIF_DMA_ENCODE(channel, group,
      handshake). Cell 1 is the peripheral request number.
      dmas = <&evtrtrN ALIF_DMA_ENCODE(channel, group, handshake) periph>;

  dma-names:
    type: string-array
    description: Names for the dmas entries.
```

## dts/bindings/timer/arm,armv7-timer-mem.yaml
```yaml
# SPDX-FileCopyrightText: Copyright Alif Semiconductor
# SPDX-License-Identifier: Apache-2.0

description: |
  ARM memory-mapped Generic Timer (CNTControl / CNTRead / CNTCTL).

  Parent node for system-timer frames. Each CNTBaseN child is an
  arm,armv7-timer-mem-frame counter device.

  Expected reg-names are "control", "read", and "ctl". The counter
  driver uses "control" for CNTCR and "ctl" for CNTACR. "read" is
  reserved for later use.

compatible: "arm,armv7-timer-mem"

include: base.yaml

properties:
  reg:
    required: true

  reg-names:
    required: true

  clocks:
    required: true
    description: Clock that increments the system counter.
```

## dts/bindings/usb/zephyr,uvc-device.yaml
```yaml
# Copyright (c) 2025 tinyVision.ai Inc.
# Copyright (C) 2026 Alif Semiconductor.
# SPDX-License-Identifier: Apache-2.0

description: |
  USB Video Class (UVC) device instance.

  Each UVC instance added to the USB Device Controller (UDC) node will be visible
  as a new camera from the host point of view.

compatible: "zephyr,uvc-device"

include: base.yaml
```

## dts/bindings/video/ovti,ov5647.yaml
```yaml
# SPDX-FileCopyrightText: Copyright Alif Semiconductor
# SPDX-License-Identifier: Apache-2.0

description: OmniVision OV5647 MIPI video sensor

compatible: "ovti,ov5647"

include: [base.yaml, pinctrl-device.yaml, i2c-device.yaml]

properties:
  reset-gpios:
    type: phandle-array
    description: |
      The RESETn pin is asserted to cause a hard reset of the sensor.
      The sensor receives this as an active-low signal.

child-binding:
  child-binding:
    include: video-interfaces.yaml
```

## samples/subsys/fs/littlefs/Kconfig
```kconfig
# Copyright (c) 2019 Peter Bigot Consulting, LLC
# SPDX-License-Identifier: Apache-2.0

mainmenu "littlefs sample"

config APP_WIPE_STORAGE
	bool "Option to clear the flash area before mounting"
	help
	  Use this to force an existing file system to be created.

choice
	prompt "Storage backend type used by the application"
	default APP_LITTLEFS_STORAGE_FLASH
	help
	  Specify the type of storage backend.

config APP_LITTLEFS_STORAGE_FLASH
	bool "Use flash memory backend"

config APP_LITTLEFS_STORAGE_BLK_SDMMC
	bool "Use block device (e.g. SD MMC) backend"
endchoice

config APP_LITTLEFS_BLOCK_SIZE
	int "LittleFS block size override"
	default 0
	depends on APP_LITTLEFS_STORAGE_FLASH
	help
	  Set an explicit LittleFS block size in bytes. A value of zero lets
	  LittleFS derive the block size from the flash page layout.

source "Kconfig.zephyr"
```

## soc/alif/common/Kconfig
```kconfig
# Copyright (c) 2026 Alif Semiconductor
#
# SPDX-License-Identifier: Apache-2.0

config ALIF_CPU_FREQ_PSTATE
	bool "RTSS cpu_freq_pstate_set hook"
	depends on RTSS_HE || RTSS_HP
	select HAS_CPU_FREQ
	select SYSTEM_CLOCK_HW_CYCLES_PER_SEC_RUNTIME_UPDATE
	select PM_DEVICE
	help
	  Implement cpu_freq_pstate_set() for Alif RTSS. Each P-state
	  overlays aipm_run_default and is sent to the Secure Enclave.
	  Off by default until the hook is stable; enable from prj.conf.

	  The hook is not IRQ-safe (device PM, SE service). Do not set
	  CONFIG_CPU_FREQ; the governor calls cpu_freq_pstate_set() from
	  a timer ISR. The SoC file build-asserts if both are on. Drop
	  that assert when a workqueue owns the governor and any manual
	  P-states.
```

## subsys/usb/device_next/class/Kconfig.uac2
```kconfig
# Copyright (c) 2022 Nordic Semiconductor ASA
#
# SPDX-License-Identifier: Apache-2.0

config USBD_AUDIO2_CLASS
	bool "USB Audio 2 class support [EXPERIMENTAL]"
	help
	  USB Audio 2 device class support.

if USBD_AUDIO2_CLASS

module = USBD_UAC2
module-str = usbd uac2
source "subsys/logging/Kconfig.template.log_config"

config USBD_UAC2_ISO_IN_DEPTH
	int "Queued isochronous IN packets"
	default 2
	range 1 8
	help
	  How many microphone packets may be armed at once. High-Speed
	  sends one packet every 125 us, so 8 packets cover one millisecond
	  when the host polls every microframe. Full-Speed keeps 2.

config USBD_UAC2_ISO_OUT_DEPTH
	int "Queued isochronous OUT packets"
	default 4
	range 1 16
	help
	  How many headphone packets may be armed at once.

endif
```
