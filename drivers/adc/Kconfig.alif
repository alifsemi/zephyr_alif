## drivers/adc/Kconfig.alif
```kconfig
# Copyright (C) 2024 Alif Semiconductor
# SPDX-License-Identifier: Apache-2.0

config ADC_ALIF
	bool "Alif ADC Driver"
	depends on DT_HAS_ALIF_ADC_ENABLED
	default y
	help
	  Enable ADC Module

config ADC_ALIF_DMA
	bool "Alif ADC DMA support"
	depends on ADC_ALIF
	depends on DMA
	default n
	help
	  Enables DMA support for the Alif ADC driver.
	  Even though the code path is enabled by this,
	  DMA is only used if configured in the DTS.

config ADC_ALIF_UTIMER_TRIGGER
	bool "Alif ADC UTIMER hardware trigger support"
	depends on ADC_ALIF
	select USE_ALIF_HAL_UTIMER
	default n
	help
	  Use an Alif UTIMER instance to drive the ADC's external
	  trigger input, removing the CPU START write from periodic
	  conversions. Combine with ADC_ALIF_DMA for CPU-free sample
	  transfers. The UTIMER instance,
	  channel, period and ADC_START_SRC mux value are supplied
	  by the DTS via the alif,utimer-trigger phandle and the
	  alif,utimer-driver / alif,utimer-period / alif,ext-trigger-src
	  properties. The code path is only enabled when both this
	  option is set and the DTS properties are present.
```

## drivers/counter/Kconfig.alif
```kconfig
# Copyright (c) 2025 Alif Semiconductor
#
# SPDX-License-Identifier: Apache-2.0

config COUNTER_ALIF_UTIMER
	bool "ALIF Universal Timer Counter driver"
	default y
	depends on DT_HAS_ALIF_UTIMER_COUNTER_ENABLED
	select USE_ALIF_HAL_UTIMER
	help
	  Enable ALIF UTIMER counter driver.

config COUNTER_ALIF_UTIMER_DMA
	bool "Alif UTIMER DMA trigger"
	depends on COUNTER_ALIF_UTIMER && DMA
	help
	  Treat selected UTIMER instances as DMA request sources (UTn_Tx
	  driver output, typically UT0_T0 for compare channel 0). Per HRM,
	  the Event Router connects these lines to PL330 DMA_REQ inputs.
	  The driver holds the request low, drives it high at compare match
	  (COMPARE_TRIG_EN), leaves CPU IRQ disabled, and re-arms on
	  cancel_alarm. The application may EOI CHAN_INTERRUPT after DMA.
	  Mux (DMA instance, group, request) comes from the overlay dmas
	  property. Alarm callbacks are not supported; pass NULL and
	  re-arm with cancel_alarm() after each trigger. The channel
	  returns -EBUSY until cancel_alarm() clears dma_armed, including
	  after the compare match fires.

choice COUNTER_ALIF_UTIMER_DMA_REARM
	prompt "UTIMER DMA re-arm: driver A high to low between alarms"
	depends on COUNTER_ALIF_UTIMER_DMA
	default COUNTER_ALIF_UTIMER_DMA_REARM_FORCE_LOW

config COUNTER_ALIF_UTIMER_DMA_REARM_FORCE_LOW
	bool "Force-low dummy compare (creates falling edge after alarm)"
	help
	  After each alarm compare (driver high), run a near-term
	  LOW_AT_COMP_MATCH compare to pull driver A low, then arm the
	  next HIGH_AT_COMP_MATCH. Validated for repeated 2s/4s/8s DMA.

config COUNTER_ALIF_UTIMER_DMA_REARM_IDLE_LOW
	bool "Idle driver low only (DRIVER_EN=0, no dummy compare)"
	help
	  On cancel_alarm: disable driver with DISABLE_VAL low. Tests
	  whether that high-to-low is enough without force-low compare.

endchoice

config COUNTER_ALIF_UTIMER_DMA_HW_CLEAR_ENABLE
	bool "Enable DMA_CLEAR (SRC_A_1 fall) with selected re-arm"
	depends on COUNTER_ALIF_UTIMER_DMA
	default n
	help
	  Programs DMA_CLEAR_SRC_A_1=0x4 (DRIVE_A_FALLING_B_0) and sets
	  COMPARE_CTRL DMA_CLEAR_EN. Combine with FORCE_LOW or IDLE_LOW
	  for a 2x2 dependency test:

	  - force-low + CLEAR=n  (baseline, expect PASS loop)
	  - force-low + CLEAR=y  (is CLEAR redundant if force-low falls?)
	  - idle-low  + CLEAR=n  (fall without dummy compare?)
	  - idle-low  + CLEAR=y  (prior failed case on E8)

	  DMA_CLEAR clears the DMA request on programmed driver edges;
	  it does not replace a rising edge for the next transfer.
```

## drivers/counter/Kconfig.arm_timer_mem
```kconfig
# SPDX-FileCopyrightText: Copyright Alif Semiconductor
# SPDX-License-Identifier: Apache-2.0

config COUNTER_ARM_TIMER_MEM
	bool "ARM memory-mapped Generic Timer driver"
	default y
	depends on DT_HAS_ARM_ARMV7_TIMER_MEM_FRAME_ENABLED
	depends on CLOCK_CONTROL
	help
	  Enable the Zephyr counter driver for ARM memory-mapped Generic
	  Timer frames (CNTBaseN).
```

## drivers/counter/Kconfig.dw
```kconfig
# Synopsys DesignWare Timer configuration option

# Copyright (c) 2023, Intel Corporation.
# SPDX-License-Identifier: Apache-2.0

config COUNTER_SNPS_DW
	bool "Synopsys DesignWare Timer Driver"
	default y
	depends on DT_HAS_SNPS_DW_TIMERS_ENABLED
	help
	  Enable Timer driver

config COUNTER_DW_DMA
	bool "DesignWare timer DMA trigger"
	depends on COUNTER_SNPS_DW && DMA
	help
	  Treat selected timer instances as DMA request sources: unmask the
	  timeout, do not enable the CPU IRQ, and do not EOI. TIMER_INTR_MASK
	  gates LPTIMERn_DMA_REQ. The caller EOI and re-arms. Mux (DMA
	  instance, group, request) comes from the overlay dmas property.
```

## drivers/gpio/Kconfig.dw
```kconfig
# DesignWare GPIO configuration options

# Copyright (c) 2016 Intel Corporation
# SPDX-License-Identifier: Apache-2.0

config GPIO_DW
	bool "Designware GPIO"
	default y
	depends on DT_HAS_SNPS_DESIGNWARE_GPIO_ENABLED
	help
	  Enable driver for Designware GPIO

config GPIO_DW_DMA
	bool "DesignWare GPIO pin DMA trigger"
	depends on GPIO_DW && DMA
	help
	  Treat selected pins as DMA request sources: keep INTMASK set and
	  do not EOI them in the GPIO ISR. Same programming for every
	  DesignWare port that has GPIOx_n_DMA_REQ (GPIO16 on Ensemble
	  Eagle is not a special case in this driver). Which DMA instance,
	  event-router group, and request number come from the application
	  overlay, not from this driver.
```

## drivers/memc/Kconfig.alif
```kconfig
# Copyright (c) 2025 Alif Semiconductor
#
# SPDX-License-Identifier: Apache-2.0

config MEMC_OSPI_ALIF
	bool "ALIF OSPI Memory controller"
	default y
	depends on DT_HAS_SNPS_DESIGNWARE_OSPI_ENABLED
	help
	  Enable OSPI Memory Controller.

if MEMC_OSPI_ALIF

config MEMC_ALIF_OSPI_APS512XXN
	bool "ALIF OSPI AP-Memory PSRAM driver"
	default y
	depends on DT_HAS_ALIF_APMEMORY_APS512XXN_ENABLED
	help
	  Enable support for the AP-Memory APS512XXN PSRAM device on Alif platforms.

config MEMC_ALIF_HSPI_S80KS2564
	bool "ALIF Hex-SPI Infineon HyperRAM driver"
	default y
	depends on DT_HAS_ALIF_INFINEON_S80KS2564_ENABLED
	help
	  Enable support for the Infineon S80K2564 hyperRAM device on Alif platforms.

config MEMC_ALIF_OSPI_IS66_HYPERRAM
	bool "ALIF OSPI ISSI HyperRAM driver"
	default y
	depends on DT_HAS_ISSI_IS66WVHXX_ENABLED
	help
	  Enable support for the ISSI IS66WVH64M8EALL/BLL HyperRAM device on Alif platforms.
endif
```

## drivers/memc/Kconfig.mspi
```kconfig
# Copyright (c) 2024, Ambiq Micro Inc. <www.ambiq.com>
# SPDX-License-Identifier: Apache-2.0

menu "MSPI MEMC device driver"

config MEMC_MSPI
	bool
	select MSPI
	help
	  MSPI MEMC drivers are enabled.

config MEMC_MSPI_APS6404L
	bool "MSPI AP Memory APS6404L pSRAM driver"
	default y
	depends on DT_HAS_APS6404L_ENABLED
	depends on $(dt_compat_on_bus,$(DT_COMPAT_APS6404L),mspi)
	select MEMC_MSPI
	select MSPI_AMBIQ_CONTROLLER if SOC_FAMILY_AMBIQ

config MEMC_MSPI_APS_Z8
	bool "MSPI AP Memory gen Z8 pSRAM driver"
	default y
	depends on DT_HAS_APS_Z8_ENABLED
	depends on $(dt_compat_on_bus,$(DT_COMPAT_APS_Z8),mspi)
	select MEMC_MSPI
	select MSPI_AMBIQ_CONTROLLER if SOC_FAMILY_AMBIQ

config MEMC_MSPI_IS66WV
	bool "MSPI ISSI IS66WV pSRAM driver"
	default y
	depends on DT_HAS_IS66WV_ENABLED
	depends on $(dt_compat_on_bus,$(DT_COMPAT_IS66WV),mspi)
	select MEMC_MSPI
	select MSPI_AMBIQ_CONTROLLER if SOC_FAMILY_AMBIQ

config MEMC_MSPI_IS66WVH
	bool "MSPI ISSI IS66WVH HyperRAM driver"
	default y
	depends on DT_HAS_ISSI_IS66WVH_ENABLED
	depends on $(dt_compat_on_bus,$(DT_COMPAT_ISSI_IS66WVH),mspi)
	select MEMC_MSPI
	help
	  Enable memory-mapped ISSI IS66/67WVH HyperRAM devices connected
	  to a HyperBus-capable MSPI controller. MSPI_XIP must be enabled
	  because this driver accesses the device through a memory-mapped
	  read/write window.

endmenu
```

## dts/bindings/counter/arm,armv7-timer-mem-frame.yaml
```yaml
# SPDX-FileCopyrightText: Copyright Alif Semiconductor
# SPDX-License-Identifier: Apache-2.0

description: |
  ARM memory-mapped Generic Timer frame (CNTBaseN).

  Must be a child of an arm,armv7-timer-mem node. Provides the Zephyr
  counter API for one physical compare/IRQ (CNTP_*).

compatible: "arm,armv7-timer-mem-frame"

include: base.yaml

properties:
  reg:
    required: true

  interrupts:
    required: true

  frame-number:
    type: int
    required: true
    enum: [0, 1, 2, 3, 4, 5, 6, 7]
    description: Timer frame index N in CNTBaseN (0-7).
```

## dts/bindings/counter/snps,dw-timers.yaml
```yaml
# Copyright (c) 2022-2023, Intel Corporation
# SPDX-License-Identifier: Apache-2.0

description: |
    Synopsys Designware timer driver

compatible: "snps,dw-timers"

include: [base.yaml, reset-device.yaml]

properties:
  reg:
    required: true

  clock-frequency:
    type: int
    description: clock frequency information for Timer

  dma-trig:
    type: boolean
    description: |
      Use this timer as a DMA request source (LPTIMERn_DMA_REQ).
      Unmasks the timeout so the pending output can raise the request.
      CPU IRQ is not enabled. The ISR does not EOI; the caller must
      EOI and re-arm (counter_set_top_value() with no callback).
      Omit this property for the CPU alarm IRQ path.
      Requires CONFIG_COUNTER_DW_DMA in Zephyr Kconfig.

  dmas:
    type: phandle-array
    description: |
      Optional Alif overlay: EVTRTR / PL330 mux metadata for applications.
      Not read by counter_dw_timer.c (this driver does not call dma_config
      or program the event router). Applications use DT_DMAS_CTLR() and
      DT_DMAS_CELL_*() with the DMA subsystem (e.g. sdk-alif counter_dma-trig).
      Example: dmas = <&evtrtrN ALIF_DMA_ENCODE(channel, group, handshake) periph>;

  dma-names:
    type: string-array
    description: |
      Optional labels for dmas entries (application use only).
```

## dts/bindings/flash_controller/mxicy,mx66uw-flash.yaml
```yaml
# Copyright (C) 2026 Alif Semiconductor.
# SPDX-License-Identifier: Apache-2.0

description: Macronix MX66UWXXXX flash memory

compatible: "mxicy,mx66uw-flash"

include: flash-controller.yaml

properties:
  erase-value:
    type: int
    description: value that flash memory contains after erase
    required: true
    default: 0xff

  num-of-sector:
    type: int
    description: available sectors in the connected NOR Flash
    required: true

  page-size:
    type: int
    description: page size
    required: true

  sector-size:
    type: int
    description: number of bytes in each sector
    required: true

  write-block-size:
    type: int
    description: minimum number of bytes for read and write
    required: true

  def-wait-cycle:
    type: int
    required: true
    enum: [6, 8, 10, 12, 14, 16, 18, 20]
    description: |
      Flash read dummy clocks.
      Maximum supported clock frequency for Octal STR and DTR operation:
        6 clocks: 66 MHz
        8 clocks: 84 MHz
        10 clocks: 104 MHz
        12 clocks: 133 MHz
        14 clocks: 155 MHz
        16 clocks: 166 MHz
        18 clocks: 173 MHz
        20 clocks: 200 MHz

  read-wait-cycle:
    type: int
    description: number of wait cycles before sampling data depends on the bus speed
    required: true
```

## dts/bindings/i2s/snps,designware-i2s.yaml
```yaml
# Copyright (c) 2025 Alif Semiconductor
# SPDX-License-Identifier: Apache-2.0

description: Synopsys DesignWare I2S node

compatible: "snps,designware-i2s"

include: [base.yaml,pinctrl-device.yaml]

properties:
  reg:
    required: true

  interrupts:
    required: true

  dmas:
    description: |
      Optional TX and/or RX DMA channel specifiers. If provided, DMA will be
      used for data transfer instead of interrupt-driven FIFO access.
      Requires CONFIG_I2S_DW_USE_DMA to be enabled.
      If both TX and RX channels are specified they must use the same DMA
      controller; the driver stores a single dma_dev pointer.

  dma-names:
    description: |
      DMA channel names. Must be "txdma" for transmit and/or "rxdma" for receive.

  tx-fifo-watermark:
    type: int
    default: 8
    description: |
      TX FIFO trigger level (0-15). An interrupt is generated when the number
      of entries in the TX FIFO is at or below this value. Default is 8
      (half of the 16-entry FIFO depth).

  rx-fifo-watermark:
    type: int
    default: 8
    description: |
      RX FIFO trigger level (0-15). An interrupt is generated when the number
      of entries in the RX FIFO is at or above this value. Default is 8
      (half of the 16-entry FIFO depth).
```

## dts/bindings/mspi/alif,mspi-controller.yaml
```yaml
# Copyright (c) 2026 Alif Semiconductor
# SPDX-License-Identifier: Apache-2.0

description: Alif MSPI controller with Synopsys DesignWare SSI core

compatible: "alif,mspi-controller"

include: "snps,designware-ssi.yaml"

properties:
  reg-names:
    type: string-array
    required: true
    description: |
      Register and memory region names. The core region contains the
      DesignWare SSI registers, the xip region is the memory-mapped XiP
      window, and the aes region contains the Alif AES wrapper registers.

  ddr-drive-edge:
    type: int
    default: 1
    description: TXD drive edge setting for DDR operation.

  rx-ds-delay:
    type: int
    default: 16
    description: Receive data strobe delay.

  baud2-delay:
    type: int
    default: 2
    enum:
      - 0
      - 1
      - 2
    description: BAUD2 delay control used by the Alif OSPI/MSPI wrapper.

  xip-wait-cycles:
    type: int
    default: 16
    description: Wait cycles for XiP transactions.

  xip-rxds-vl-en:
    type: boolean
    description: Enable RXDS variable latency on XiP transactions.

  xip-ser-support:
    type: boolean
    description: |
      Controller implements the XIP slave-enable register. When present,
      the driver may select an XIP target through the XIPSER register.

  memmap-write-support:
    type: boolean
    description: Controller supports memory-mapped write/XiP write registers.
```

## dts/bindings/mtd/alif,infineon-s80ks2564.yaml
```yaml
# Copyright (c) 2025 Alif Semiconductor
#
# SPDX-License-Identifier: Apache-2.0

description: Infineon S80KS2564 HyperRAM on ALIF Hex-SPI(DW-SSI) bus

compatible: "alif,infineon-s80ks2564"

include: base.yaml

properties:
  size:
    type: int
    description: |
      The RAM size in bytes.

  latency:
    type: int
    required: true
    description: |
      The RAM wait cycle.

  reset-gpios:
    type: phandle-array
    description: |
      The RESETn pin to be toggled to reset memory.
```

## dts/bindings/mtd/infineon,s80ks-mspi.yaml
```yaml
# Copyright (c) 2026 Alif Semiconductor
# SPDX-License-Identifier: Apache-2.0

description: Infineon S80KS HyperRAM on an MSPI bus

compatible: "infineon,s80ks"

include: mspi-device.yaml

properties:
  size:
    type: int
    required: true
    description: HyperRAM capacity in bytes.

  initial-latency:
    type: int
    default: 3
    enum:
      - 3
      - 4
      - 5
      - 6
      - 7
    description: Initial read latency in clock cycles programmed into CR0.

  fixed-latency:
    type: boolean
    description: Use fixed two-times initial latency instead of variable latency.

  hybrid-burst:
    type: boolean
    description: Continue linearly after the first wrapped burst.

  burst-length:
    type: int
    default: 32
    enum:
      - 16
      - 32
      - 64
      - 128
    description: Wrapped burst length in bytes programmed into CR0.

  drive-strength-ohms:
    type: int
    default: 34
    enum:
      - 19
      - 22
      - 27
      - 34
      - 46
      - 67
      - 115
    description: Output impedance in ohms programmed into CR0.

  xip-config:
    required: true
```
