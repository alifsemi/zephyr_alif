## drivers/ieee802154/Kconfig.alif
```kconfig
# Alif 802.15.4 RF driver configuration options

# Copyright (c) 2023 Alif Semiconductor
# SPDX-License-Identifier: Apache-2.0


menuconfig IEEE802154_ALIF
	bool "Alif IEEE 802.15.4 Driver"
	default y
	depends on NETWORKING
	depends on DT_HAS_ALIF_AHI_IEEE802154_ENABLED
	select IEEE802154_ALIF_SUPPORT

if IEEE802154_ALIF

config IEEE802154_ALIF_INIT_PRIO
	int "Alif IEEE 802.15.4 initialization priority"
	default 80
	help
	  Set the driver initialization priority number.

config IEEE802154_ALIF_MAC154_CCA_MODE
	int "Transmission CCA mode (0 = ED, 1 = CS, 2 = ED or CS, 3 = ED and CS)"
	default 1
	help
	  CCA mode used in transmissions. ED = Energy Detection, CS = Carrier Sense

config IEEE802154_ALIF_CCA_TICKS
	int "CCA measurement count"
	default 4
	help
	  Energy measurement count in energy detection over which average energy is measured in 128us ticks.

config IEEE802154_ALIF_CCA_THRESHOLD
	int "CCA threshold in Energy detection mode"
	default -60
	help
	  energy detection measumerement in dBm over which the channel is considered busy.

config IEEE802154_ALIF_POWER_LEVEL
	int "Default power level of transmitter"
	default 0
	help
	  Transmitter default power level in dBm.

config IEEE802154_ALIF_CLOCK_ACCURACY
	int "Timer accuracy (ppm)"
	default 10
	help
	  Timer accuracy of the 802.15.4 system is dependent on the clock selection of the system.

config IEEE802154_ALIF_RX_BUFFERS
	int "Amount of RX buffers allocated for received packets"
	default 5
	help
	  Amount of RX buffers available in reception for parallel packet processing.

config IEEE802154_ALIF_RX_TASK_STACK_SIZE
	int "RX stack size"
	default 768
	help
	  Stack size of the reception task handling received packets from the RF.

endif
```

## drivers/ipm/Kconfig.alif
```kconfig
# Copyright (c) 2024 Alif Semiconductor
#
# SPDX-License-Identifier: Apache-2.0
config ALIF_HWSEM
	bool "Hardware Semaphore driver on Alif SoCs"
	depends on SOC_FAMILY_ENSEMBLE
	help
	  Enable Hardware Semaphore (HWSEM) driver on Alif SoCs.
```

## drivers/mdio/Kconfig.dwmac
```kconfig
# Synopsys DesignWare MDIO driver configuration options
# Copyright (C) 2025 Alif Semiconductor
# SPDX-License-Identifier: Apache-2.0

config MDIO_DWMAC
	bool "Synopsys DesignWare MDIO driver"
	default y
	depends on DT_HAS_SNPS_DESIGNWARE_MDIO_ENABLED
	help
	  Enable the Synopsys DesignWare (DWMAC) MDIO interface driver.
```

## drivers/mdio/Kconfig.mdio_alif
```kconfig
# Alif MDIO driver configuration options
# Copyright (C) 2025 Alif Semiconductor
# SPDX-License-Identifier: Apache-2.0

config MDIO_ALIF
	bool "Alif MDIO Driver Support"
	default y
	depends on DT_HAS_ALIF_MDIO_ENABLED
	help
		Enable Alif MDIO Driver.
```

## drivers/mipi_dphy/Kconfig
```kconfig
# MIPI-DPHY configuration options.

# Copyright (C) 2024 Alif Semiconductor
# SPDX-License-Identifier: Apache-2.0

menuconfig MIPI_DPHY
	bool "MIPI-DPHY Host Controllers"
	select EXPERIMENTAL
	help
	  Add support for MIPI-DPHY host controllers for DSI and CSI clients.

if MIPI_DPHY

module = MIPI_DPHY
module-str = mipi_dphy
source "subsys/logging/Kconfig.template.log_config"

config MIPI_DPHY_INIT_PRIORITY
	int "Initialization priority"
	default 40
	help
	  MIPI-DPHY Host Controllers initialization priority.

source "drivers/mipi_dphy/Kconfig.dw"

endif
```

## drivers/mipi_dphy/Kconfig.dw
```kconfig
# Alif MIPI-DPHY driver configuration options

# Copyright (C) 2024 Alif Semiconductor
# SPDX-License-Identifier: Apache-2.0

config MIPI_DPHY_DW
	bool "MIPI-DPHY Host Controller for Alif"
	default y
	depends on DT_HAS_SNPS_DESIGNWARE_DPHY_ENABLED
	help
	  Enable Alif MIPI DPHY Host controller driver

if MIPI_DPHY_DW

config MIPI_DPHY_INIT_PRIORITY
	int "Initialization priority"
	default 39
	help
	  MIPI-DPHY Host Controllers initialization priority.

endif
```

## drivers/mipi_dsi/Kconfig.dw
```kconfig
# Alif MIPI-DSI driver configuration options

# Copyright (C) 2024 Alif Semiconductor
# SPDX-License-Identifier: Apache-2.0

config MIPI_DSI_DW
	bool "MIPI-DSI Host Controller for Alif"
	default y
	depends on DT_HAS_SNPS_DESIGNWARE_DSI_ENABLED
	select MIPI_DPHY
	help
	  Enable Alif MIPI DSI Host controller driver
```

## drivers/pinctrl/Kconfig.alif
```kconfig
# Copyright (c) 2025 Alif Semiconductor
#
# SPDX-License-Identifier: Apache-2.0

config PINCTRL_ALIF
	bool "Alif SoC pin controller driver"
	depends on SOC_FAMILY_ENSEMBLE || SOC_FAMILY_BALLETTO
	default y
	help
	  Enable pin controller for Alif Ensemble DevKits.
```

## drivers/power_domain/Kconfig
```kconfig
# Copyright (c) 2022, CSIRO.
# SPDX-License-Identifier: Apache-2.0

menuconfig POWER_DOMAIN
	bool "Power domain drivers"
	help
	  Include drivers for power domains in system config

if POWER_DOMAIN

module = POWER_DOMAIN
module-str = power_domain
source "subsys/logging/Kconfig.template.log_config"

config POWER_DOMAIN_INIT_PRIORITY
	int "Power domain init priority"
	default 75
	help
	  Power domain initialization priority.

config POWER_DOMAIN_GPIO
	bool "GPIO controlled power domain"
	default y
	depends on DT_HAS_POWER_DOMAIN_GPIO_ENABLED
	depends on GPIO
	depends on PM_DEVICE || !PM_DEVICE_POWER_DOMAIN
	depends on TIMEOUT_64BIT
	select DEVICE_DEPS

if POWER_DOMAIN_GPIO

config POWER_DOMAIN_GPIO_INIT_PRIORITY
	int "GPIO power domain init priority"
	default POWER_DOMAIN_INIT_PRIORITY
	help
	  GPIO power domain initialization priority.

endif #POWER_DOMAIN_GPIO_MONITOR

config POWER_DOMAIN_INTEL_ADSP
	bool "Use Intel ADSP power gating mechanisms"
	default y
	depends on DT_HAS_INTEL_ADSP_POWER_DOMAIN_ENABLED
	select DEVICE_DEPS
	help
	  Include Intel ADSP power domain control mechanisms

if POWER_DOMAIN_INTEL_ADSP

config POWER_DOMAIN_INTEL_ADSP_INIT_PRIORITY
	int "Intel ADSP power domain init priority"
	default KERNEL_INIT_PRIORITY_DEFAULT
	help
	  Intel ADSP power domain initialization priority.

endif #POWER_DOMAIN_INTEL_ADSP

config POWER_DOMAIN_GPIO_MONITOR
	bool "GPIO monitor for sensing power on rail"
	default y
	depends on DT_HAS_POWER_DOMAIN_GPIO_MONITOR_ENABLED
	depends on GPIO
	depends on PM_DEVICE
	select DEVICE_DEPS

if POWER_DOMAIN_GPIO_MONITOR

config POWER_DOMAIN_GPIO_MONITOR_INIT_PRIORITY
	int "GPIO monitor power domain init priority"
	default POWER_DOMAIN_INIT_PRIORITY
	help
	  GPIO monitor power domain initialization priority.

endif #POWER_DOMAIN_GPIO_MONITOR

config POWER_DOMAIN_NXP_SCU
	bool "NXP SCU-managed PD driver"
	default y
	depends on DT_HAS_NXP_SCU_PD_ENABLED
	help
	  Enable support for NXPs SCU-managed power domain driver.

if POWER_DOMAIN_NXP_SCU

config POWER_DOMAIN_NXP_SCU_INIT_PRIORITY
	int "NXP SCU-managed PD driver init priority"
	default 10
	help
	  NXP SCU-managed PD driver initialization priority.

endif #POWER_DOMAIN_NXP_SCU

config POWER_DOMAIN_SOC_PM_STATE
	bool "SoC PM state power domain"
	default y
	depends on DT_HAS_POWER_DOMAIN_SOC_STATE_CHANGE_ENABLED
	select DEVICE_DEPS
	help
	  Generic power domain control to turn on/off devices when the
	  PM subsystem transitions in and out certain power states.

config POWER_DOMAIN_ALIF
	bool "Alif SoC power domain driver"
	default y
	depends on DT_HAS_ALIF_POWER_DOMAIN_ENABLED
	depends on SOC_FAMILY_ENSEMBLE || SOC_FAMILY_BALLETTO
	select DEVICE_DEPS
	select PM_DEVICE
	help
	  Power domain driver for Alif Semiconductor SoCs (Ensemble and Balletto families).
	  This driver manages power domains (PD_SYST, PD_SSE700_AON, etc.) through SE
	  Services aiPM interface. It provides reference counting for power domain requests,
	  integrates with PM subsystem for S2RAM/SOFT_OFF transitions, and ensures proper
	  power domain state management across sleep/wake cycles. Uses Zephyr's PM device
	  framework to automatically manage peripherals on power domains.

	  Note: This automatically enables PM_DEVICE, which in turn enables
	  PM_DEVICE_POWER_DOMAIN (default y), allowing peripherals to use the
	  power-domains device tree property.

if POWER_DOMAIN_ALIF

config POWER_DOMAIN_ALIF_INIT_PRIORITY
	int "Alif power domain init priority"
	default 47
	help
	  Alif power domain initialization priority. Must be initialized at PRE_KERNEL_1
	  level after MHU driver (priority 40) and SE services (priority 45), but before
	  peripheral drivers (which default to priority 50 at PRE_KERNEL_1).

	  Initialization order:
	    Priority 40: MHU driver (CONFIG_KERNEL_INIT_PRIORITY_DEFAULT)
	    Priority 45: SE services (CONFIG_SE_SERVICE_INIT_PRIORITY)
	    Priority 47: Power domain driver (this config)
	    Priority 50: Peripherals (CONFIG_SERIAL_INIT_PRIORITY, etc.)

endif #POWER_DOMAIN_ALIF

endif
```

## drivers/pwm/Kconfig.alif
```kconfig
# Copyright (c) 2024 Alif Semiconductor
#
# SPDX-License-Identifier: Apache-2.0

config PWM_ALIF_UTIMER
	bool "ALIF Universal Timer PWM driver"
	default y
	depends on DT_HAS_ALIF_PWM_ENABLED
	select USE_ALIF_HAL_UTIMER
	help
	  Enable utimer based pwm driver.
```

## drivers/sdhc/Kconfig.dwc
```kconfig
# SPDX-FileCopyrightText: Copyright Alif Semiconductor
# SPDX-License-Identifier: Apache-2.0

config SDHC_DWC
	bool "Synopsys DesignWare Core SDHC driver"
	default y
	depends on DT_HAS_SNPS_DWC_SDHC_ENABLED
	select SDHC_SUPPORTS_NATIVE_MODE
	select EVENTS
	help
	  Enable Synopsys DesignWare Core SDHC driver.

if SDHC_DWC

config SDHC_BUFFER_ALIGNMENT
	int "SDHC buffer alignment"
	default 512

config SDHC_DESCRIPTOR_SECTION
	string "Linker section for SDHC DMA descriptors"
	default ""
	help
	  Linker section for SDHC driver data including DMA descriptors.
	  Leave empty to use the default data section. SoC defconfigs
	  may override this to place descriptors in a specific region
	  (e.g. non-secure memory).

config SDHC_DWC_SDMA
	bool "Use SDMA mode"
	help
	  Use Single-operation DMA (SDMA) for data transfers. SDMA uses
	  the SDMA System Address register and requires handling DMA
	  boundary interrupts for transfers crossing 4 KB pages.

config SDHC_DWC_ADMA
	bool "Use ADMA2 mode"
	default y
	depends on !SDHC_DWC_SDMA
	help
	  Use Advanced DMA 2 (ADMA2) for data transfers. ADMA2 uses a
	  descriptor table that allows scatter-gather transfers without
	  boundary interrupt handling. This is the recommended DMA mode.

config SDHC_DWC_ADMA_MAX_DESC
	int "SDHC DWC ADMA Maximum Descriptor count"
	depends on SDHC_DWC_ADMA
	default 32
	help
	  SDHC DWC ADMA Maximum Descriptor count.

config SDHC_DWC_DMA_ADDR_TRANSLATE
	bool "Enable CPU-to-bus DMA address translation"
	help
	  Enable this on platforms where CPU-local memory addresses differ
	  from the bus addresses seen by the DMA engine. When enabled the
	  driver calls a SoC-provided translation function before
	  programming DMA descriptor and buffer addresses. Leave disabled
	  on platforms where CPU and DMA share the same address map.

endif # SDHC_DWC
```

## drivers/sensor/qdec_alif/Kconfig
```kconfig
# Copyright (c) 2025 Alif Semiconductor
#
# SPDX-License-Identifier: Apache-2.0

config QDEC_ALIF
	bool "ALIF QDEC driver"
	default y
	depends on DT_HAS_ALIF_QDEC_ENABLED
	select USE_ALIF_HAL_UTIMER
	help
	  ALIF Quadrature Decoder driver.
```

## drivers/spi/Kconfig.dw
```kconfig
# DesignWare SPI driver configuration options

# Copyright (c) 2015-2016 Intel Corporation
# Copyright (c) 2023 Meta Platforms
# Copyright (c) 2024 Alif Semiconductor
# SPDX-License-Identifier: Apache-2.0

menuconfig SPI_DW
	bool "DesignWare SPI controller driver"
	default y
	depends on DT_HAS_SNPS_DESIGNWARE_SPI_ENABLED
	select PINCTRL if $(dt_compat_any_has_prop,$(DT_COMPAT_SNPS_DESIGNWARE_SPI),pinctrl-0)
	help
	  Enable support for DesignWare SPI controllers.

if SPI_DW

config SPI_DW_ACCESS_WORD_ONLY
	bool "DesignWare SPI only allows word access"
	help
	  In some case, e.g. ARC HS Development kit, the peripheral space of
	  DesignWare SPI only allows word access, byte access will raise
	  exception.

config SPI_DW_USE_DMA
	bool "DMA path for transfers"
	default n
	help
	  Eventhough the code path will be enabled by this, dma will be enabled
	  based on the dts.

config SPI_DW_HSSI
	bool "DesignWare SPI HSSI variant"
	help
	  Use register layout compatible with the SPI DW HSSI variant of the
	  peripheral.

endif # SPI_DW
```

## drivers/usb/udc/Kconfig.dwc3
```kconfig
# Copyright (c) 2025 Alif semiconductor
# SPDX-License-Identifier: Apache-2.0

config UDC_DWC3
	bool "DWC3 USB device controller driver"
	default y
	depends on DT_HAS_SNPS_DWC3_ENABLED
	help
	  DWC3 USB device controller driver.

config UDC_DWC3_DMA
	bool "DWC3 USB DMA support"
	default y
	depends on UDC_DWC3
	help
	  Enable DMA if DWC3 USB controller supports Internal DMA.

config UDC_DWC3_ALIF
	bool "UDC DWC3 Alif support"
	default y
	depends on UDC_DWC3
	depends on SOC_FAMILY_ENSEMBLE || SOC_FAMILY_BALLETTO
	help
	  Enable support for the Synopsys DesignWare DWC3 on Alif platforms.

config UDC_DWC3_STACK_SIZE
	int "UDC DWC3 driver internal thread stack size"
	depends on UDC_DWC3
	default 512
	help
	  DWC3 driver internal thread stack size.

config UDC_DWC3_THREAD_PRIORITY
	int "UDC DWC3 driver thread priority"
	depends on UDC_DWC3
	default 8
	help
	  DWC3 driver thread priority.

config UDC_DWC3_MAX_QMESSAGES
	int "DWC3 UDC driver maximum number of ISR event messages"
	range 4 64
	default 8
	help
	  Maximum number of messages for handling of DWC3 USBD ISR events.
```

## drivers/video/Kconfig.alif
```kconfig
# Alif Camera controller driver configuration options

# Copyright (C) 2024 Alif Semiconductor
# SPDX-License-Identifier: Apache-2.0

config VIDEO_ALIF_CAM
	bool "Camera Parallel Interface (CPI) controller driver"
	default y
	depends on DT_HAS_ALIF_CAM_ENABLED

if VIDEO_ALIF_CAM

config VIDEO_ALIF_CAM_INIT_PRIORITY
	int "CPI Video initialization priority"
	default 60
	help
	 System initialization priority for Alif Camera Driver.
	 The default initialization priority for video devices is 60.

config VIDEO_ALIF_CAM_EXTENDED
	bool "CPI has extended registers and Ports."
	help
	 CPI has extended registers and ports to forward video
	 signals to ISP and dump the frame to memory.

endif #VIDEO_ALIF_CAM
```

## drivers/video/Kconfig.arx3a0
```kconfig
# Alif ARX3A0 CMOS sensor driver configuration options

# Copyright (C) 2024 Alif Semiconductor
# SPDX-License-Identifier: Apache-2.0

config VIDEO_ARX3A0
	bool "Onsemi ARX3A0 CMOS video sensor"
	select I2C
	depends on DT_HAS_ONNN_ARX3A0_ENABLED
	default y
	help
	  Enable driver for ARX3A0 CMOS digital image sensor device.
```

## drivers/video/Kconfig.dw
```kconfig
# Alif MIPI-CSI2 bus controller driver configuration options

# Copyright (C) 2024 Alif Semiconductor
# SPDX-License-Identifier: Apache-2.0

config VIDEO_MIPI_CSI2_DW
	bool "MIPI CSI-2 Host Controller for Alif"
	default y
	select MIPI_DPHY
	depends on DT_HAS_SNPS_DESIGNWARE_DPHY_ENABLED
	depends on DT_HAS_SNPS_DESIGNWARE_CSI_ENABLED
	help
	  Enable Alif MIPI CSI2 Host controller driver

if VIDEO_MIPI_CSI2_DW

config VIDEO_MIPI_CSI2_DW_INIT_PRIORITY
	int "Initialization priority"
	default 41
	help
	  MIPI CSI-2 Host Controllers initialization priority.

endif
```

## drivers/video/Kconfig.isp_vsi
```kconfig
# Alif ISP controller driver configuration options

# Copyright (C) 2025 Alif Semiconductor
# SPDX-License-Identifier: Apache-2.0

config VIDEO_ISP_VSI
	bool "ISP controller driver for Verisilicon ISP Pico"
	default y
	depends on DT_HAS_VSI_ISP_PICO_ENABLED
```
