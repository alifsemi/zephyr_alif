## drivers/video/Kconfig.jpeg_hantro_vc9000e
```kconfig
# Copyright (c) 2026 Alif Semiconductor
# SPDX-License-Identifier: Apache-2.0

config VIDEO_JPEG_HANTRO_VC9000E
	bool "VeriSilicon Hantro VC9000E JPEG Hardware Encoder"
	default y
	depends on DT_HAS_VERISILICON_HANTRO_VC9000E_JPEG_ENABLED
	help
	  Enable support for VeriSilicon Hantro VC9000E JPEG hardware encoder.
	  Supports JPEG/MJPEG encoding with YUV420 input formats,
	  hardware-accelerated compression up to 2MP @ 200 FPS.

if VIDEO_JPEG_HANTRO_VC9000E

config VIDEO_JPEG_HANTRO_VC9000E_HEADER_SIZE
	int "JPEG header buffer size"
	default 623
	help
	  Size of JPEG header in bytes. The hardware encoder generates
	  the compressed data, but the header is generated in software.

config VIDEO_JPEG_HANTRO_VC9000E_MAX_WIDTH
	int "Maximum JPEG image width"
	default 16384
	help
	  Maximum supported image width in pixels.

config VIDEO_JPEG_HANTRO_VC9000E_MAX_HEIGHT
	int "Maximum JPEG image height"
	default 16384
	help
	  Maximum supported image height in pixels.

config VIDEO_JPEG_HANTRO_VC9000E_MIN_SIZE
	int "Minimum JPEG image dimension"
	default 32
	help
	  Minimum supported image width/height in pixels.

endif # VIDEO_JPEG_HANTRO_VC9000E
```

## drivers/video/Kconfig.ov5675
```kconfig
# OmniVision OV5675 MIPI sensor driver configuration options
# SPDX-FileCopyrightText: Copyright Alif Semiconductor
# SPDX-License-Identifier: Apache-2.0

config VIDEO_OV5675
	bool "OmniVision OV5675 MIPI video sensor"
	select I2C
	depends on DT_HAS_OVTI_OV5675_ENABLED
	default y
	help
	  Enable driver for OV5675 MIPI digital image sensor device.
```

## dts/bindings/adc/alif,adc.yaml
```yaml
# Copyright (C) 2025 Alif Semiconductor
# SPDX-License-Identifier: Apache-2.0

description: Alif ADC

include: [base.yaml, pinctrl-device.yaml]

compatible: "alif,adc"

properties:

  sample-width:
    type: int
    default : 16
    description: Rate at which the analog samples is sampled
    enum: [2, 3, 4, 5, 6, 7, 8, 9, 10, 11, 12, 13, 14, 15, 16,
           17, 18, 19, 20, 21, 22, 23, 24, 25, 26, 27, 28, 29,
           30, 31, 32]

  clock_div:
    type: int
    default: 2
    description: Clock divisor applied to the input clock
    enum: [2, 3, 4, 5, 6, 7, 8, 9, 10, 11, 12, 13, 14, 15, 16]

  avg_sample_num:
    type: int
    default: 256
    description: Number of sample input need to be sampled and must be in power of 2
    enum: [1, 2, 4, 8, 16, 32, 64, 128, 256]

  shift_n_bits:
    type: int
    default: 0
    description: number of bits to shift before loading it to the sample output register

  shift_direction:
    type: string
    description: shift left or right before loading it to the sample output register
    required: true
    enum:
      - "LEFT_SHIFT"
      - "RIGHT_SHIFT"

  comparator_threshold_a:
    type: int
    default: 0
    description: set comparator a threshold value

  comparator_threshold_b:
    type: int
    default: 0
    description: set comparator b threshold value

  comparator_threshold_comparison:
    type: string
    description: set comparator threshold comparison mode
    enum:
      - "ABOVE_THRESHOLD_A_AND_B"
      - "BELOW_THRESHOLD_A_AND_B"
      - "BETWEEN_AND_OUTSIDE_THRESHOLD_A_AND_B"

  comparator_bias:
    type: string
    description: set conversion sampling rate for adc12
    enum:
      - "0.5_MS/s"
      - "1_MS/s"
      - "2.5_MS/s"
      - "5_MS/s"

  driver_instance:
    type: string
    description: Operating channel
    required: true
    enum:
      -  "ADC_INSTANCE_ADC24_0"
      -  "ADC_INSTANCE_ADC12_0"
      -  "ADC_INSTANCE_ADC12_1"
      -  "ADC_INSTANCE_ADC12_2"

  interrupt_en:
    type: int
    description: Enable required interrupts
    required: true

  pga_enable:
    type: boolean
    description: set this when working with differential to set the gain

  pga_gain:
    type: string
    default: "ADC_PGA_GAIN_0_DB"
    description: select the gain for the Peripheral in differential mode
    enum:
      -  "ADC_PGA_GAIN_0_DB"
      -  "ADC_PGA_GAIN_6_DB"
      -  "ADC_PGA_GAIN_12_DB"
      -  "ADC_PGA_GAIN_18_DB"
      -  "ADC_PGA_GAIN_24_DB"
      -  "ADC_PGA_GAIN_30_DB"
      -  "ADC_PGA_GAIN_36_DB"
      -  "ADC_PGA_GAIN_42_DB"

  adc_channel_scan:
    type: string
    description: select for scanning single channel or multiple channel
    required: true
    enum:
      -  "MULTIPLE_CHANNEL_SCAN"
      -  "SINGLE_CHANNEL_SCAN"

  adc_conversion_mode:
    type: string
    description: adc operate in single shot or continuous conversion
    required: true
    enum:
      -  "CONTINUOUS_CONVERSION"
      -  "SINGLE_SHOT_CONVERSION"

  adc24_output_rate:
    type: string
    description: setting the sampling rate of adc24
    enum:
      -  "1KS/s"
      -  "2KS/s"
      -  "4KS/s"
      -  "8KS/s"
      -  "16KS/s"
  adc24_bias:
    type: string
    description: Bias setting for adc24
    enum:
      -  "5uA"
      -  "6.25uA"
      -  "7.5uA"
      -  "8.75uA"
```

## dts/bindings/arm/alif,balletto-soc.yaml
```yaml
# Copyright (c) 2025 Alif Semiconductor
#
# SPDX-License-Identifier: Apache-2.0

description: Alif Balletto SoC

compatible: "alif,balletto-soc"

properties:
  ble-rom-version:
    type: string
    required: true
    description: BLE ROM version embedded in the hardware
    enum:
      - "1.2"
```

## dts/bindings/arm/alif,dtcm.yaml
```yaml
# Copyright (c) 2025 Alif Semiconductor
#
# SPDX-License-Identifier: Apache-2.0
description: Alif SoC DTCM (Data Tightly Coupled Memory)

compatible: "alif,dtcm"

include: [base.yaml, "zephyr,memory-region.yaml"]

properties:
  reg:
    required: true
  global_base:
    required: true
    type: int
    description: Global base address for the DTCM
```

## dts/bindings/arm/alif,itcm.yaml
```yaml
# Copyright (c) 2025 Alif Semiconductor
#
# SPDX-License-Identifier: Apache-2.0
description: Alif SoC ITCM (Instruction Tightly Coupled Memory)

compatible: "alif,itcm"

include: [base.yaml, "zephyr,memory-region.yaml"]

properties:
  reg:
    required: true
  global_base:
    required: true
    type: int
    description: Global base address for the ITCM
```

## dts/bindings/audio/alif,alif-pdm.yaml
```yaml
# Copyright (C) 2025 Alif Semiconductor
# SPDX-License-Identifier: Apache-2.0

description: Alif Pulse Density Module

compatible: "alif,alif-pdm"

include: [base.yaml, pinctrl-device.yaml]

properties:
  reg:
    required: true

  interrupts:
    required: true

  fifo_watermark:
    type: int
    required: true
    description: Fifo watermark threshold value
    enum:
      - 0
      - 1
      - 2
      - 3
      - 4
      - 5
      - 6
      - 7

  bypass_iir_filter:
    type: int
    required: true
    description: Bypass IIR filter
    enum:
      - 0
      - 1
```
