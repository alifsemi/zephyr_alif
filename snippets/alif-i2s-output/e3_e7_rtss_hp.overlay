/*
 * SPDX-FileCopyrightText: Copyright Alif Semiconductor
 * SPDX-License-Identifier: Apache-2.0
 */

/*
 * I2S_1 => Speaker Output
 */

&i2s1 {
	status = "okay";
};

/ {
	aliases {
		i2s-tx = &i2s1;
	};
};
