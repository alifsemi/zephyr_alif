/*
 * Copyright (c) 2025 Alif Semiconductor.
 * SPDX-License-Identifier: Apache-2.0
 */

&mram_storage {
	partitions {
		storage_partition: partition@3A0000 {
			label = "storage";
			reg = <0x003A0000 DT_SIZE_K(16)>;
		};
	};
};
