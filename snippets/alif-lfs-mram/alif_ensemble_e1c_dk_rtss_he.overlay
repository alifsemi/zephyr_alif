/*
 * Copyright (c) 2025 Alif Semiconductor.
 * SPDX-License-Identifier: Apache-2.0
 */

/* increased "storage" for the demo app. */
/delete-node/ &storage_partition;

&mram_storage {
	partitions {
		/* 16 KB storage area */
		storage_partition: partition@1C4000 {
			label = "storage";
			reg = <0x001C4000 DT_SIZE_K(16)>;
		};
	};
};
