/*
 * Copyright (c) 2025 Alif Semiconductor.
 * SPDX-License-Identifier: Apache-2.0
 */

&mram_storage {
	partitions {
		storage_partition: partition@1A0000 {
			label = "storage";
			reg = <0x001A0000 DT_SIZE_K(16)>;
		};
	};
};
