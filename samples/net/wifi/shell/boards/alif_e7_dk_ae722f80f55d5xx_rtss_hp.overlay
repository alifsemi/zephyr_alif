/*
 * Copyright (c) 2025 Alif Semiconductor.
 * SPDX-License-Identifier: Apache-2.0
 */

ns: &ns {
	reg = <0x20028000 DT_SIZE_K(96)>;
	status = "okay";
};

&gpio3 {
	status = "okay";
};


sdhc: &sdhc {
	compatible = "snps,dwc-sdhc";
	status = "okay";
	max-bus-freq = <25000000U>;

	airoc-wifi {
		compatible = "infineon,airoc-wifi";
		status = "okay";

		/* Wi-Fi control gpios */
	/*	wifi-reg-on-gpios    = <&gpio14 7 GPIO_ACTIVE_HIGH>; */
	/*	wifi-host-wake-gpios = <&gpio0 1 GPIO_ACTIVE_LOW>; */
	/*	wifi-dev-wake-gpios  = <&gpio0 0 GPIO_ACTIVE_LOW>; */
	};
};

