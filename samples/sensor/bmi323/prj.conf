## CMakeLists.txt
```
#
# Copyright (c) 2025 Alif Semiconductor
#
# SPDX-License-Identifier: Apache-2.0
#

cmake_minimum_required(VERSION 3.20.0)
find_package(Zephyr REQUIRED HINTS $ENV{ZEPHYR_BASE})
project(bmi323_test)

FILE(GLOB app_sources src/*.c)
target_sources(app PRIVATE ${app_sources})
```

## sample.yaml
```
#
# Copyright (c) 2025 Alif Semiconductor
#
# SPDX-License-Identifier: Apache-2.0
#

sample:
  name: BMI323 Sensor Sample
tests:
  sample.sensor.bmi323:
    tags: i3c sensors
    depends_on: i3c
```

## prj.conf
```kconfig
#
# Copyright (c) 2025 Alif Semiconductor
#
# SPDX-License-Identifier: Apache-2.0
#

CONFIG_I3C=y
CONFIG_I3C_INIT_RSTACT=y
CONFIG_I3C_USE_IBI=n
CONFIG_SENSOR=y
CONFIG_CLOCK_CONTROL=y
CONFIG_LOG=y
CONFIG_LOG_BUFFER_SIZE=8192
CONFIG_FPU=y
```

## src/main.c
```c
/*
 * Copyright (C) 2024 Alif Semiconductor.
 * SPDX-License-Identifier: Apache-2.0
 */

#include <zephyr/kernel.h>
#include <zephyr/device.h>
#include <zephyr/drivers/sensor.h>
#include <stdio.h>

int main(void)
{
	const struct device *const dev = DEVICE_DT_GET_ONE(bosch_bmi323);
	struct sensor_value acc[3], gyr[3];
	struct sensor_value full_scale, sampling_freq, feat_mask;

	if (!device_is_ready(dev)) {
		printf("Device %s is not ready\n", dev->name);
		return 0;
	}

	printf("Device %p name is %s\n", dev, dev->name);

	/* Setting scale in G, due to loss of precision if the SI unit m/s^2
	 * is used
	 */
	full_scale.val1 = 2;            /* G */
	full_scale.val2 = 0;
	sampling_freq.val1 = 100;       /* Hz. Performance mode */
	sampling_freq.val2 = 0;
	feat_mask.val1 = 1;          /* High performance mode */
	feat_mask.val2 = 0;

	sensor_attr_set(dev, SENSOR_CHAN_ACCEL_XYZ, SENSOR_ATTR_FULL_SCALE,
			&full_scale);
	sensor_attr_set(dev, SENSOR_CHAN_ACCEL_XYZ, SENSOR_ATTR_FEATURE_MASK,
			&feat_mask);
	/* Set sampling frequency last as this also sets the appropriate
	 * power mode. If already sampling, change to 0.0Hz before changing
	 * other attributes
	 */
	sensor_attr_set(dev, SENSOR_CHAN_ACCEL_XYZ,
			SENSOR_ATTR_SAMPLING_FREQUENCY,
			&sampling_freq);


	/* Setting scale in degrees/s to match the sensor scale */
	full_scale.val1 = 500;          /* dps */
	full_scale.val2 = 0;
	sampling_freq.val1 = 100;       /* Hz. Performance mode */
	sampling_freq.val2 = 0;
	feat_mask.val1 = 1;          /* High performance mode */
	feat_mask.val2 = 0;

	sensor_attr_set(dev, SENSOR_CHAN_GYRO_XYZ, SENSOR_ATTR_FULL_SCALE,
			&full_scale);
	sensor_attr_set(dev, SENSOR_CHAN_GYRO_XYZ, SENSOR_ATTR_FEATURE_MASK,
			&feat_mask);
	/* Set sampling frequency last as this also sets the appropriate
	 * power mode. If already sampling, change sampling frequency to
	 * 0.0Hz before changing other attributes
	 */
	sensor_attr_set(dev, SENSOR_CHAN_GYRO_XYZ,
			SENSOR_ATTR_SAMPLING_FREQUENCY,
			&sampling_freq);

	while (1) {
		/* 100ms period, 100Hz Sampling frequency */
		k_sleep(K_MSEC(100));

		sensor_sample_fetch(dev);

		sensor_channel_get(dev, SENSOR_CHAN_ACCEL_XYZ, acc);
		sensor_channel_get(dev, SENSOR_CHAN_GYRO_XYZ, gyr);

		printf("Accel AX: %f; AY: %f; AZ: %f g"
			"\t Gyro GX: %f; GY: %f; GZ: %f deg/s\n",
			sensor_value_to_double(&acc[0]),
			sensor_value_to_double(&acc[1]),
			sensor_value_to_double(&acc[2]),
			sensor_value_to_double(&gyr[0]),
			sensor_value_to_double(&gyr[1]),
			sensor_value_to_double(&gyr[2]));
	}
	return 0;
}
```
