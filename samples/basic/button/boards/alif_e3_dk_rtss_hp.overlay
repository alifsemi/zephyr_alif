/*
 * SPDX-License-Identifier: Apache-2.0
 *
 * Copyright (c) 2025 Alif Semiconductor
 */

/* for "buttons" node lpgpio_4(P15_4),
 *  enable receiver and software pull-up.
 */

&pinctrl_lpgpio {
	group0 {
		pinmux = < PIN_P15_4__LPGPIO >;
		read-enable = < 0x1 >;
		driver-state-control = <1>;
	};
};

&lpgpio{
	status = "okay";
};
