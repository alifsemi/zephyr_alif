/* Copyright (c) 2025 Alif Semiconductor
 *
 * SPDX-License-Identifier: Apache-2.0
 */

/* for "buttons" node gpio5_7, enable software pull-up */
&pinctrl_gpio5 {
	group0 {
		pinmux = <PIN_P5_0__GPIO>,
			 <PIN_P5_1__GPIO>,
			 <PIN_P5_2__GPIO>,
			 <PIN_P5_3__GPIO>,
			 <PIN_P5_4__GPIO>,
			 <PIN_P5_5__GPIO>,
			 <PIN_P5_6__GPIO>,
			 <PIN_P5_7__GPIO>;
		read_enable = <0x1>;
	};

	group1 {
		pinmux = <PIN_P5_7__GPIO>;
		driver_state_control = <1>;
	};
};
