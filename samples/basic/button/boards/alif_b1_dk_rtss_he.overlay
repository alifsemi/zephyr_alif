/* Copyright (C) 2025 Alif Semiconductor - All Rights Reserved.
 * Use, distribution and modification of this code is permitted under the
 * terms stated in the Alif Semiconductor Software License Agreement
 *
 * You should have received a copy of the Alif Semiconductor Software
 * License Agreement with this file. If not, please write to:
 * contact@alifsemi.com, or visit: https://alifsemi.com/license
 */


/* for "buttons" node gpio5_7, enable software pull-up */
&pinctrl_gpio5 {
	group0 {
		pinmux = < PIN_P5_7__GPIO >;
		read_enable = < 0x1 >;
		driver_state_control = <1>;
	};
};

&gpio5{
	status = "okay";
};
