/* Copyright (c) 2025 Alif Semiconductor
 *
 * SPDX-License-Identifier: Apache-2.0
 */

/*
 * Enabling lp-utimer for the sample application
 */

/ {
	aliases {
		timer = &lputimer0;
	};
};

&lputimer0 {
	status = "okay";

	counter {
		status = "okay";
	};
};
