/* Copyright (c) 2025 Alif Semiconductor
 *
 * SPDX-License-Identifier: Apache-2.0
 */

/*
 * Enabling utimer for the sample application
 */

/ {
	aliases {
		timer = &utimer0;
	};
};

&utimer0 {
	status = "okay";

	counter {
		status = "okay";
	};
};
