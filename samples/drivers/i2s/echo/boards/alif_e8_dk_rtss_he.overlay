/*
 * Copyright (c) 2025 Alif Semiconductor.
 * SPDX-License-Identifier: Apache-2.0
 */

/*
 * I2S_3        => Speaker Output
 * I2S_4(LPI2S) => Mic Input
 */

i2s_tx: &i2s3 {
	status = "okay";
};

i2s_rx: &i2s4 {
	status = "okay";
};

