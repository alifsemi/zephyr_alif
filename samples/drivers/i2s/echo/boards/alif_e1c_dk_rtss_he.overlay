/*
 * Copyright (c) 2025 Alif Semiconductor.
 * SPDX-License-Identifier: Apache-2.0
 */

/*
 * I2S_0 => Speaker Output
 * I2S_4 => Mic Input (lpi2s)
 */

i2s_tx: &i2s0 {
	status = "okay";
};

i2s_rx: &i2s4 {
	status = "okay";
};

