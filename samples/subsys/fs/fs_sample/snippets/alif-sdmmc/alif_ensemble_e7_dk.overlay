/*
 * Copyright (c) 2026 Alif Semiconductor.
 * SPDX-License-Identifier: Apache-2.0
 */

ns: &ns {
	status = "okay";
};

/* GPIO3 is needed for SDHC card-detect */
&gpio3 {
	status = "okay";
};

sdhc: &sdhc {
	status = "okay";

	mmc {
		status = "okay";
		disk-name = "SD";
	};
};
