/* Copyright (c) 2026 Alif Semiconductor
 *
 * SPDX-License-Identifier: Apache-2.0
 */

#include "alif/ensemble/common/e3_e5_e7.dtsi"

&sram0 {
	reg = <0x02000000 DT_SIZE_K(4096)>;
};

&sram1 {
	reg = <0x08000000 DT_SIZE_K(2560)>;
};

&mram_flash {
	reg = <0x80000000 DT_SIZE_K(5632)>;
};

&mram_storage {
	reg = <0x80000000 DT_SIZE_K(5632)>;
};
