## dts/bindings/video/ovti,ov5675.yaml
```yaml
# SPDX-FileCopyrightText: Copyright Alif Semiconductor
# SPDX-License-Identifier: Apache-2.0

description: OmniVision OV5675 MIPI video sensor

compatible: "ovti,ov5675"

include: [base.yaml, pinctrl-device.yaml, i2c-device.yaml]

properties:
  reset-gpios:
    type: phandle-array
    description: |
      The RESETn pin is asserted to cause a hard reset of the sensor.
      The sensor receives this as an active-low signal.

  power-gpios:
    type: phandle-array
    description: |
      The Power pin is asserted to enable the supply voltages needed by
      the sensor. The sensor receives this as an active-high signal.

child-binding:
  child-binding:
    include: video-interfaces.yaml
```

## dts/bindings/video/snps,designware-csi.yaml
```yaml
# Copyright (C) 2024 Alif Semiconductor
# SPDX-License-Identifier: Apache-2.0

description: MIPI CSI-2 controller IP used by Alif SoC.

compatible: "snps,designware-csi"

include: base.yaml

properties:
  interrupts:
    required: true

  data-lanes1:
    type: int
    default: 2
    description:
      Number of data lanes for PHY-1
    enum: [1, 2]

  data-lanes2:
    type: int
    default: 2
    description:
      Number of data lanes for PHY-2
    enum: [1, 2]

  phy-if:
    type: phandle-array
    required: true
    specifier-space: dphy
    description:
      Handle to the PHY interface.

  ipi-mode:
    type: string
    required: false
    default: "Camera"
    description: |
      Video mode transmission type.
    enum: ["Camera", "Controller"]

  csi-vsa:
    type: int
    required: false
    description: |
      The Vertical Synchronism Active time in Horizontal lines.

  csi-vbp:
    type: int
    required: false
    description: |
      The Vertical back porch time in Horizontal lines.

  csi-vfp:
    type: int
    required: false
    description: |
      The Vertical front porch time in Horizontal lines.

  csi-vact:
    type: int
    required: false
    description: |
      The vertical active period time in number of Horizontal lines.

  csi-hsa:
    type: int
    required: false
    description: |
      The Horizontal Synchronism Active time in PIXCLK.

  csi-hbp:
    type: int
    required: false
    description: |
      The Horizontal back porch time in PIXCLK.

  csi-hsd:
    type: int
    required: false
    description: |
      The Horizontal synch porch time in PIXCLK.

  csi-hact:
    type: int
    required: false
    description: |
      The Horizontal active time in PIXCLK.

  rx-ddr-clk1:
    type: int
    required: false
    default: 400000000
    description: |
      The value of RX DDR Lane Clock coming from CMOS sensor to RX D-PHY and
      to MIPI-CSI IP as RXBYTECLKHS. This is the clock value from DPHY ID 0.

  rx-ddr-clk2:
    type: int
    required: false
    default: 400000000
    description: |
      The value of RX DDR Lane Clock coming from CMOS sensor to RX D-PHY and
      to MIPI-CSI IP as RXBYTECLKHS. This is the clock value from DPHY ID 1.

child-binding:
  child-binding:
    child-binding:
      include: video-interfaces.yaml
      properties:
        reg:
          type: int
          enum:
            - 0 # Selfie Camera EP
            - 1 # Standard Camera EP
            - 2 # CPI EP
          description: Endpoints to Selfie and Standard can be used.
            Only one of these EPs are supported by CSI to transfer data to CPI.
            Though, multiple cameras can be configured simultaneously.
```

## dts/bindings/video/verisilicon,hantro-vc9000e-jpeg.yaml
```yaml
# Copyright (c) 2026 Alif Semiconductor
# SPDX-License-Identifier: Apache-2.0

description: VeriSilicon Hantro VC9000E JPEG Hardware Encoder

compatible: "verisilicon,hantro-vc9000e-jpeg"

include: base.yaml

properties:
  reg:
    required: true

  interrupts:
    required: true

  quality-factor:
    type: int
    default: 75
    description: Default JPEG quality factor (1-100)

  max-burst-length:
    type: int
    default: 64
    description: Maximum AXI burst length for DMA transfers

  axi-wr-outstanding:
    type: int
    default: 64
    description: Maximum AXI write outstanding transactions

  axi-rd-outstanding:
    type: int
    default: 64
    description: Maximum AXI read outstanding transactions
```

## dts/bindings/video/vsi,isp-pico.yaml
```yaml
# Copyright (C) 2024 Alif Semiconductor
# SPDX-License-Identifier: Apache-2.0

description: ALIF ISP Interface

compatible: "vsi,isp-pico"

include: base.yaml

properties:
  reg:
    required: true

  interrupts:
    required: true

  tpg-bayer-pattern:
    type: string
    required: false
    default: "GBRG"
    description: |
      Specifies the Bayer format output from TPG.
    enum:
      - "RGGB"
      - "GRBG"
      - "GBRG"
      - "BGGR"

  tpg-image-idx:
    type: string
    required: false
    default: "Disabled"
    enum:
      - "3x3-Color-Block"
      - "Color-Bar"
      - "Gray-Bar"
      - "Highlighted-grid"
      - "Random-Generator"
      - "Disabled"

  tpg-pix-width:
    type: int
    required: false
    enum:
      - 0 # 8-bit
      - 1 # 10-bit
      - 2 # 12-bit

  isp-subsampling:
    type: string
    required: false
    default: "Co-sited"
    description: |
      Specifies for the YUV422 if the Cb and Cr channels are sampled with
      Y0Cb0Cr0 Y1 - Cosited
      Y0Cb0 Y1Cr1 - Interleaved
      Y0Cb(0 + 1)/2 Y1Cr(0 + 1)/2 - Non-cosited
    enum:
      - "Co-sited"
      - "Interleaved"
      - "Non-cosited"

  fieldsel:
    type: string
    required: false
    default: "both"
    description: |
      Specifies if the field selection should be done on Even fields (Even lines)/
      Odd fields (Odd lines) or both fields (both Even and Odd lines).
    enum:
      - "both"
      - "even"
      - "odd"

  crop-x0:
    type: int
    default: 0
    description: |
      specify the left coordinate at the start of ROI.

  crop-y0:
    type: int
    default: 0
    description: |
      specify the top coordinate at the start of ROI.

child-binding:
  child-binding:
      include: video-interfaces.yaml
```

## modules/Kconfig.alif
```kconfig
# Copyright (C) 2024 Alif Semiconductor - All Rights Reserved.
# Use, distribution and modification of this code is permitted under the
# terms stated in the Alif Semiconductor Software License Agreement
#
# You should have received a copy of the Alif Semiconductor Software
# License Agreement with this file. If not, please write to:
# contact@alifsemi.com, or visit: https://alifsemi.com/license

config ZEPHYR_HAL_ALIF_MODULE
	bool

config HAS_ALIF_SE_SERVICES
	bool "Alif HAL drivers support"
	depends on SOC_FAMILY_ENSEMBLE || SOC_FAMILY_BALLETTO

config IEEE802154_ALIF_SUPPORT
	bool "include 802.15.4 support"
	depends on HAS_ALIF_BLE_802154_LINK_LAYER
	help
	  This option enables Alif Semiconductor's 802.15.4 HW adaptation.

if IEEE802154_ALIF_SUPPORT

config IEEE802154_ALIF_TX_ENCRYPT
	bool "IEEE 802.15.4 TX packet handler and encryption"
	depends on MBEDTLS
	default n if OPENTHREAD_THREAD_VERSION_1_1
	default y
	help
	  This option is enables Alif Semiconductor's 802.15.4 Tx packet handler for encryption.

endif
```

## samples/drivers/counter/alarm/boards/alif_rtc.conf
```kconfig
# Copyright (c) 2025 Alif Semiconductor
#
# SPDX-License-Identifier: Apache-2.0

CONFIG_COUNTER_RTC_SNPS_DW=y
```

## samples/drivers/counter/alarm/boards/alif_utimer.conf
```kconfig
# Copyright (c) 2024 Alif Semiconductor
#
# SPDX-License-Identifier: Apache-2.0

CONFIG_COUNTER_SNPS_DW=n
CONFIG_COUNTER_RTC_SNPS_DW=n
CONFIG_COUNTER_ALIF_UTIMER=y
```

## samples/net/dhcpv4_client/boards/alif_e3_dk_rtss_hp.conf
```kconfig
CONFIG_SOC_FAMILY_ENSEMBLE=y
CONFIG_NET_L2_ETHERNET=y
CONFIG_NET_L2_ETHERNET_MGMT=y
CONFIG_ETH_DRIVER=y
CONFIG_ETH_DWMAC=y
CONFIG_PHY_REALTEK_RTL8201FR=y
CONFIG_MDIO=y
CONFIG_INIT_STACKS=n
CONFIG_NET_NATIVE=y
CONFIG_DNS_RESOLVER=y
```

## samples/net/sockets/echo_server/boards/alif-cdc-ncm-common.conf
```kconfig
# Copyright (c) 2026 Alif Semiconductor
#
# SPDX-License-Identifier: Apache-2.0

# Common CDC NCM configuration for Alif boards

# Enable USB device stack (device_next)
CONFIG_USB_DEVICE_STACK_NEXT=y

# Enable DWC3 USB driver
CONFIG_UDC_DWC3=y
CONFIG_UDC_DWC3_ALIF=y

# Enable CDC NCM class
CONFIG_USBD_CDC_NCM_CLASS=y
CONFIG_USBD_CDC_NCM_MAX_DGRAM_PER_NTB=2

# Enable Ethernet L2
CONFIG_NET_L2_ETHERNET=y

# Sample USB device configuration
CONFIG_SAMPLE_USBD_PID=0x0001
CONFIG_SAMPLE_USBD_PRODUCT="Alif CDC NCM Ethernet"
CONFIG_SAMPLE_USBD_MANUFACTURER="Alif Semiconductor"

# Logging for debugging
CONFIG_LOG=y
CONFIG_USBD_CDC_NCM_LOG_LEVEL_INF=y
CONFIG_UDC_DRIVER_LOG_LEVEL_INF=y

# Increase stack size for USB operations
CONFIG_SYSTEM_WORKQUEUE_STACK_SIZE=4096
CONFIG_MAIN_STACK_SIZE=4096

# Network configuration for USB NCM (static IP for testing)
CONFIG_NET_CONFIG_SETTINGS=y
CONFIG_NET_CONFIG_MY_IPV4_ADDR="192.168.7.2"
CONFIG_NET_CONFIG_PEER_IPV4_ADDR="192.168.7.1"
CONFIG_NET_CONFIG_AUTO_INIT=y
CONFIG_NET_CONFIG_NEED_IPV4=y

# Increase network buffer counts for USB NCM
CONFIG_NET_PKT_RX_COUNT=32
CONFIG_NET_PKT_TX_COUNT=32
CONFIG_NET_BUF_RX_COUNT=64
CONFIG_NET_BUF_TX_COUNT=64
CONFIG_NET_IF_UNICAST_IPV4_ADDR_COUNT=2
```

## samples/net/wifi/shell/boards/alif_e8_dk_ae822fa0e5597xx0_rtss_hp.conf
```kconfig
# Debug
CONFIG_LOG_PRINTK=y
CONFIG_HW_STACK_PROTECTION=y
CONFIG_DEBUG_THREAD_INFO=y
CONFIG_NO_OPTIMIZATIONS=y

# Serial
CONFIG_SERIAL=y
CONFIG_GPIO=y
CONFIG_UART_CONSOLE=y
CONFIG_UART_INTERRUPT_DRIVEN=y
CONFIG_SHELL_BACKEND_SERIAL_RX_RING_BUFFER_SIZE=128
CONFIG_EARLY_CONSOLE=y

# Stack sizes
CONFIG_MAIN_STACK_SIZE=5120
CONFIG_SHELL_STACK_SIZE=5120
CONFIG_NET_TX_STACK_SIZE=5120
CONFIG_NET_RX_STACK_SIZE=5120
CONFIG_NET_MGMT_EVENT_STACK_SIZE=2048
CONFIG_SYSTEM_WORKQUEUE_STACK_SIZE=5120
CONFIG_NET_SOCKETS_SERVICE_STACK_SIZE=2048
CONFIG_NET_TCP_WORKQ_STACK_SIZE=4096

# Network overrides for WiFi offload
CONFIG_NET_IPV6=n
CONFIG_NET_DHCPV4=y
CONFIG_NET_PKT_RX_COUNT=10
CONFIG_NET_PKT_TX_COUNT=10
CONFIG_NET_BUF_RX_COUNT=20
CONFIG_NET_BUF_TX_COUNT=20
CONFIG_NET_BUF_DATA_SIZE=1024
CONFIG_NET_MAX_CONTEXTS=10
CONFIG_NET_MAX_CONN=16
CONFIG_NET_TCP_MAX_RECV_WINDOW_SIZE=32768
CONFIG_NET_TCP_MAX_SEND_WINDOW_SIZE=32768
CONFIG_NET_OFFLOAD=y
CONFIG_WIFI_OFFLOAD=y
CONFIG_ZVFS_POLL_MAX=16

CONFIG_DNS_RESOLVER=y
CONFIG_DNS_RESOLVER_MAX_SERVERS=2
CONFIG_NET_L2_WIFI_SHELL=y

# Wi-Fi
CONFIG_WIFI=y
CONFIG_WIFI_AIROC=y
# Default: 2FY(CYW55500), For 1YN module please enable 43439 configs
# and disable CYW55500 config.
CONFIG_CYW55500=y
#CONFIG_CYW43439=y
#CONFIG_CYW43439_MURATA_1YN=y
CONFIG_HEAP_MEM_POOL_SIZE=65536
CONFIG_KERNEL_MEM_POOL=y

# SDIO
CONFIG_SDIO_STACK=y

# SDHC
CONFIG_SD_UHS_PROTOCOL=y
CONFIG_SDHC_RSP_136_HAS_CRC=y
CONFIG_PLATFORM_SPECIFIC_INIT=y
CONFIG_SDHC_DWC=y
CONFIG_SDHC_INIT_PRIORITY=80

# Regulator (for SD power)
CONFIG_REGULATOR=y
```

## samples/net/zperf/boards/alif_e8_ak_ae822fa0e5597xx0_rtss_hp.conf
```kconfig
# Debug
CONFIG_LOG_PRINTK=y
CONFIG_HW_STACK_PROTECTION=y
CONFIG_DEBUG_THREAD_INFO=y
CONFIG_NO_OPTIMIZATIONS=y

# Serial
CONFIG_SERIAL=y
CONFIG_GPIO=y
CONFIG_UART_CONSOLE=y
CONFIG_UART_INTERRUPT_DRIVEN=y
CONFIG_SHELL_BACKEND_SERIAL_RX_RING_BUFFER_SIZE=128
CONFIG_EARLY_CONSOLE=y

# Stack sizes
CONFIG_MAIN_STACK_SIZE=5120
CONFIG_SHELL_STACK_SIZE=5120
CONFIG_NET_TX_STACK_SIZE=5120
CONFIG_NET_RX_STACK_SIZE=5120
CONFIG_NET_MGMT_EVENT_STACK_SIZE=2048
CONFIG_SYSTEM_WORKQUEUE_STACK_SIZE=5120
CONFIG_NET_SOCKETS_SERVICE_STACK_SIZE=2048
CONFIG_NET_TCP_WORKQ_STACK_SIZE=4096

# Network overrides for WiFi offload
CONFIG_NET_IPV6=n
CONFIG_NET_DHCPV4=y
CONFIG_NET_PKT_RX_COUNT=40
CONFIG_NET_PKT_TX_COUNT=40
CONFIG_NET_BUF_RX_COUNT=80
CONFIG_NET_BUF_TX_COUNT=80
CONFIG_NET_BUF_DATA_SIZE=1024
CONFIG_NET_MAX_CONTEXTS=10
CONFIG_NET_MAX_CONN=16
CONFIG_NET_TCP_MAX_RECV_WINDOW_SIZE=32768
CONFIG_NET_TCP_MAX_SEND_WINDOW_SIZE=32768
CONFIG_NET_OFFLOAD=y
CONFIG_WIFI_OFFLOAD=y
CONFIG_ZVFS_POLL_MAX=16

CONFIG_DNS_RESOLVER=y
CONFIG_DNS_RESOLVER_MAX_SERVERS=2
CONFIG_NET_L2_WIFI_SHELL=y

# Wi-Fi
CONFIG_WIFI=y
CONFIG_WIFI_AIROC=y
CONFIG_CYW55500=y
CONFIG_HEAP_MEM_POOL_SIZE=65536
CONFIG_KERNEL_MEM_POOL=y

# SDIO
CONFIG_SDIO_STACK=y

# SDHC
CONFIG_SD_UHS_PROTOCOL=y
CONFIG_SDHC_RSP_136_HAS_CRC=y
CONFIG_PLATFORM_SPECIFIC_INIT=y
CONFIG_SDHC_DWC=y
CONFIG_SDHC_INIT_PRIORITY=1
```

## samples/subsys/fs/fs_sample/boards/alif_b1_dk_ab1c1f4m51820ph0_rtss_he.conf
```kconfig
CONFIG_DEBUG=y
CONFIG_LOG_MODE_IMMEDIATE=y
CONFIG_NO_OPTIMIZATIONS=y
CONFIG_MAIN_STACK_SIZE=4096
CONFIG_LOG_PRINTK=y

#FATFS
CONFIG_FS_SAMPLE_CREATE_SOME_ENTRIES=y
CONFIG_FS_FATFS_WINDOW_ALIGNMENT=512
CONFIG_FS_FATFS_LFN=y
CONFIG_FS_LOG_LEVEL_ERR=y
CONFIG_FS_LOG_LEVEL_INF=y

#SDHC LOG
CONFIG_SDHC_LOG_LEVEL_INF=y
CONFIG_SDHC_LOG_LEVEL_ERR=y

#SDHC DMA
CONFIG_SDHC_RSP_136_HAS_CRC=y
CONFIG_INTEL_EMMC_HOST=y
CONFIG_INTEL_EMMC_HOST_DMA=y
CONFIG_INTEL_EMMC_HOST_ADMA=y
```

## samples/subsys/fs/fs_sample/boards/alif_e7_dk_rtss_he.conf
```kconfig
CONFIG_MAIN_STACK_SIZE=4096
CONFIG_LOG_PRINTK=y

#FATFS
CONFIG_FS_SAMPLE_CREATE_SOME_ENTRIES=y
CONFIG_FS_FATFS_WINDOW_ALIGNMENT=512
CONFIG_FS_FATFS_LFN=y
CONFIG_FS_LOG_LEVEL_ERR=y
CONFIG_FS_LOG_LEVEL_INF=y

#SDHC LOG
CONFIG_SDHC_LOG_LEVEL_INF=y
CONFIG_SDHC_LOG_LEVEL_ERR=y

#SDHC DMA
CONFIG_SDHC_RSP_136_HAS_CRC=y
CONFIG_INTEL_EMMC_HOST=y
CONFIG_INTEL_EMMC_HOST_DMA=y
CONFIG_INTEL_EMMC_HOST_ADMA=y

CONFIG_PLATFORM_SPECIFIC_INIT=y
```

## samples/subsys/input/input_dump/boards/alif_e3_dk_rtss_hp.conf
```kconfig
CONFIG_INPUT_SHELL_KBD_MATRIX_STATE=n
CONFIG_INPUT_GPIO_KEYS=n

CONFIG_STDOUT_CONSOLE=y
CONFIG_I2C_TARGET=y
CONFIG_I2C=y
CONFIG_I2C_DW_CLOCK_SPEED=100

CONFIG_INPUT_GT911_INTERRUPT=y
```

## samples/subsys/usb/mass/boards/alif_msc_sd.conf
```kconfig
#SD card App support
CONFIG_APP_MSC_STORAGE_SDCARD=y

# FILE system support
CONFIG_DISK_ACCESS=y
CONFIG_FILE_SYSTEM=y
CONFIG_FAT_FILESYSTEM_ELM=y

#FATFS
#CONFIG_FS_SAMPLE_CREATE_SOME_ENTRIES=y
CONFIG_FS_FATFS_WINDOW_ALIGNMENT=512
CONFIG_FS_FATFS_LFN=y
CONFIG_FS_LOG_LEVEL_INF=y

#SDHC LOG
CONFIG_SDHC_LOG_LEVEL_INF=y

#SDHC DMA
CONFIG_SDHC_RSP_136_HAS_CRC=y
CONFIG_INTEL_EMMC_HOST=y
CONFIG_INTEL_EMMC_HOST_DMA=y
CONFIG_INTEL_EMMC_HOST_ADMA=y
```

## soc/alif/balletto/Kconfig.defconfig
```kconfig
# Copyright (c) 2025 Alif Semiconductor
#
# SPDX-License-Identifier: Apache-2.0

if SOC_FAMILY_BALLETTO

# Disable null pointer exception detection by default for Balletto B1.
# The Alif BLE ROM patcher dereferences address 0x00000000 (ITCM base)
# when no patch is present (__ble_patch_info_start weak symbol resolves to NULL).
# Enabling MPU-based null pointer detection would trap this access and cause a fault.
choice NULL_POINTER_EXCEPTION_DETECTION
	default NULL_POINTER_EXCEPTION_DETECTION_NONE
endchoice

config ROM_START_OFFSET
	default 0x800 if BOOTLOADER_MCUBOOT

rsource "*/Kconfig.defconfig"

endif # SOC_FAMILY_BALLETTO

config SD_BUFFER_SECTION
	string "Alif Non Secure Section Name for card internal buffer"
	default ".alif_ns"

config SDHC_DESCRIPTOR_SECTION
	string "Alif Non Secure Section Name for SDHC Descriptor"
	default ".alif_ns"

config I2C_DW_IC_CLK_FREQ_OPTIMIZATION
	default y if I2C_DW
```

## soc/alif/balletto/Kconfig.soc
```kconfig
# Copyright (c) 2025 Alif Semiconductor
#
# SPDX-License-Identifier: Apache-2.0

config SOC_FAMILY
	default "balletto" if SOC_FAMILY_BALLETTO

config NONSECURE0_REGION
	string
	default "NON-SECURE0" if $(dt_nodelabel_enabled,ns)
	help
		Provide config name for Non-Secure0 region if
		ns node defined in the device tree.

config OSPI0_XIP_REGION
	string
	default "ospi0" if $(dt_nodelabel_enabled,ospi0)
	help
		Configure OSPI0 XIP memory mapped region name

rsource "*/Kconfig.soc"
```

## soc/alif/balletto/b1/Kconfig
```kconfig
# Copyright (c) 2025 Alif Semiconductor
#
# SPDX-License-Identifier: Apache-2.0

config SOC_AB1C1F4M51820HH0_RTSS_HE
	select RTSS_HE

config SOC_AB1C1F4M51820PH0_RTSS_HE
	select RTSS_HE

config SOC_AB1C1F1M41820HH0_RTSS_HE
	select RTSS_HE

config SOC_AB1C1F1M41820PH0_RTSS_HE
	select RTSS_HE
```
