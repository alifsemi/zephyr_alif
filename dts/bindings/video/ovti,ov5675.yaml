## soc/alif/balletto/b1/Kconfig.defconfig.ab1c1f4m51820ph0_rtss_he
```kconfig
# Copyright (c) 2025 Alif Semiconductor
#
# SPDX-License-Identifier: Apache-2.0

if SOC_AB1C1F4M51820PH0_RTSS_HE

config NUM_IRQS
	default 480

config SYS_CLOCK_HW_CYCLES_PER_SEC
	default 160000000

endif # SOC_AB1C1F4M51820PH0_RTSS_HE
```

## soc/alif/balletto/b1/Kconfig.soc
```kconfig
# Copyright (c) 2025 Alif Semiconductor
#
# SPDX-License-Identifier: Apache-2.0

config SOC_SERIES_B1
	bool
	select SOC_FAMILY_BALLETTO

config SOC_SERIES
	default "b1" if SOC_SERIES_B1

config SOC_AB1C1F4M51820HH0
	bool
	select SOC_SERIES_B1
	help
	  Alif Balletto B1 CSP

config SOC_AB1C1F4M51820HH0_RTSS_HE
	bool
	select SOC_AB1C1F4M51820HH0

config SOC_AB1C1F4M51820PH0
	bool
	select SOC_SERIES_B1
	help
	  Alif Balletto B1 BGA

config SOC_AB1C1F4M51820PH0_RTSS_HE
	bool
	select SOC_AB1C1F4M51820PH0

config SOC_AB1C1F1M41820HH0
	bool
	select SOC_SERIES_B1
	help
	  Alif Balletto B1 CSP

config SOC_AB1C1F1M41820HH0_RTSS_HE
	bool
	select SOC_AB1C1F1M41820HH0

config SOC_AB1C1F1M41820PH0
	bool
	select SOC_SERIES_B1
	help
	  Alif Balletto B1 BGA

config SOC_AB1C1F1M41820PH0_RTSS_HE
	bool
	select SOC_AB1C1F1M41820PH0

config SOC
	default "ab1c1f4m51820hh0" if SOC_AB1C1F4M51820HH0
	default "ab1c1f4m51820ph0" if SOC_AB1C1F4M51820PH0
	default "ab1c1f1m41820hh0" if SOC_AB1C1F1M41820HH0
	default "ab1c1f1m41820ph0" if SOC_AB1C1F1M41820PH0
```

## soc/alif/balletto/common/Kconfig
```kconfig
# Copyright (c) 2025 Alif Semiconductor
#
# SPDX-License-Identifier: Apache-2.0

config RTSS_HE
	bool "RTSS_HE core"
	help
	  Enable RTSS_HE core.

config HAS_ALIF_BLE_802154_LINK_LAYER
	bool
	help
	  Device has BLE and 802154 Link Layers

config HAS_ALIF_BLE_ROM_IMAGE
	bool
	help
	  Device has BLE HOST and LC3 ROM code

if HAS_ALIF_BLE_ROM_IMAGE

# BLE ROM version is hardware-specific and defined in DTS.
# The version is automatically detected from the ble-rom-version property.

DT_SOC_INFO := $(dt_nodelabel_path,soc_info)

config ALIF_BLE_ROM_IMAGE_V1_2
	def_bool $(dt_node_str_prop_equals,$(DT_SOC_INFO),ble-rom-version,1.2)
	help
	  BLE ROM version 1.2 (automatically set from device tree)

# To add support for a new BLE ROM version (e.g., v1.3):
# 1. Add "1.3" to the enum in zephyr/dts/bindings/arm/alif,balletto-soc.yaml
# 2. Add a new config here:
#    config ALIF_BLE_ROM_IMAGE_V1_3
#        def_bool $(dt_node_str_prop_equals,$(DT_SOC_INFO),ble-rom-version,1.3)
# 3. Update CMakeLists.txt in modules/hal/alif/ble/ and modules/hal/alif/lc3/
# 4. Create version-specific subdirectories with ROM symbols

endif

config HAS_ALIF_POWER_MANAGER
	bool
	depends on HAS_ALIF_SE_SERVICES
	help
	  Device has Alif Power Manager services

if BT

config BT_BUF_ACL_RX_SIZE
	range 251 65535
	default 251

config BT_BUF_EVT_RX_COUNT
	default 20 if (BT_MESH && !(BT_BUF_EVT_DISCARDABLE_COUNT > 0))
	default 10
	range 10 255

config BT_BUF_ACL_TX_COUNT
	default 6
	range 6 255

endif # BT

config ALIF_HWSEM_INIT_PRIORITY
	int "HWSEM Init priority"
	depends on ALIF_HWSEM
	default 50
	help
	  Hardware Semaphore driver initialization priority.

config SOC_SUPPORT_ARM_MHUV2
	bool "SoC support communication through Arm MHUv2"
	depends on SOC_FAMILY_ENSEMBLE || SOC_FAMILY_BALLETTO
	select IPM
	select ARM_MHUV2
	help
	  SoC support communication through Arm MHUv2

config SPI_DW_ENABLE
	bool "SPI DW"
	default y
	depends on SPI
	help
	  Enable Designware SPI driver.
	select SPI_DW

config USE_ALIF_HAL_UTIMER
	bool "UTIMER ll driver access"
	default n
	help
	  Enables UTIMER LL driver on Alif SoCs.

config USE_ALIF_HAL_ANALOG
	bool "Enable Alif HAL Analog support"
	default n
	help
	  Enables access to Alif HAL analog layer(ADC, DAC, CMP)

config USE_ALIF_HAL_OSPI
	bool "OSPI driver located in HAL Module"
	default n
	help
	  Enables OSPI driver on Alif SoCs.

config FLASH_SIZE
	default $(dt_node_reg_size_int,$(dt_nodelabel_path,itcm),0,K) if !XIP

config FLASH_BASE_ADDRESS
	default $(dt_node_reg_addr_hex,$(dt_nodelabel_path,itcm))     if !XIP

if COUNTER_SNPS_DW
config LPTIMER0_OUTPUT_TOGGLE
	bool "LPTimer0 Output Toggle"
	help
	  Enable lptimer 0 output toggle.

config LPTIMER0_EXT_CLK_FREQ
	int "LPTimer0 External clock source Frequency value"
	default 0
	help
	  Provide lptimer 0 clock frequency for external clock source.

config LPTIMER1_OUTPUT_TOGGLE
	bool "LPTimer1 Output Toggle"
	help
	  Enable lptimer 1 output toggle.

config LPTIMER1_EXT_CLK_FREQ
	int "LPTimer1 External clock source Frequency value"
	default 0
	help
	  Provide lptimer 1 clock frequency for external clock source.
endif # COUNTER_SNPS_DW
```

## soc/alif/ensemble/Kconfig
```kconfig
# Copyright (c) 2025 Alif Semiconductor
#
# SPDX-License-Identifier: Apache-2.0

config SOC_FAMILY_ENSEMBLE
	bool "Alif Ensemble family of SoC"


if SOC_FAMILY_ENSEMBLE

config RTSS_HE
	select ARM
	select ARMV8_M_DSP
	select ARMV8_1_M_MVEI
	select ARMV8_1_M_MVEF
	select CPU_CORTEX_M55
	select CPU_CORTEX_M_HAS_SYSTICK
	select CPU_HAS_ARM_MPU
	select CPU_HAS_ARM_SAU
	select CPU_HAS_FPU
	select CPU_HAS_CUSTOM_FIXED_SOC_MPU_REGIONS
	select SOC_RESET_HOOK
	select BUILTIN_STACK_GUARD
	select PINCTRL
	select CLOCK_CONTROL
	select HAS_ALIF_SE_SERVICES

config RTSS_HP
	select ARM
	select ARMV8_M_DSP
	select ARMV8_1_M_MVEI
	select ARMV8_1_M_MVEF
	select CPU_CORTEX_M55
	select CPU_CORTEX_M_HAS_SYSTICK
	select CPU_HAS_ARM_MPU
	select CPU_HAS_ARM_SAU
	select CPU_HAS_FPU
	select CPU_HAS_CUSTOM_FIXED_SOC_MPU_REGIONS
	select SOC_RESET_HOOK
	select BUILTIN_STACK_GUARD
	select PINCTRL
	select CLOCK_CONTROL
	select HAS_ALIF_SE_SERVICES

config APSS
	select ARM
	select CPU_CORTEX_A32
	select GIC_V2
	select PINCTRL
	select CLOCK_CONTROL

config ENSEMBLE_GEN2
	bool

rsource "*/Kconfig"

endif # SOC_FAMILY_ENSEMBLE
```

## soc/alif/ensemble/Kconfig.defconfig
```kconfig
# Copyright (c) 2025 Alif Semiconductor
#
# SPDX-License-Identifier: Apache-2.0

if SOC_FAMILY_ENSEMBLE
rsource "*/Kconfig.defconfig"
endif # SOC_FAMILY_ENSEMBLE

config SD_BUFFER_SIZE
	default 4096 if SDIO_STACK && SDIO_USE_INTERNAL_BUFFER
	default 512

config SD_BUFFER_SECTION
	string "Alif Non Secure Section Name for card internal buffer"
	default ".alif_ns"

config SDHC_DESCRIPTOR_SECTION
	string "Alif Non Secure Section Name for SDHC Descriptor"
	default ".alif_ns"

config SDHC_DWC_DMA_ADDR_TRANSLATE
	default y

config SDIO_USE_INTERNAL_BUFFER
	default y

config I2C_DW_IC_CLK_FREQ_OPTIMIZATION
	default y if I2C_DW
```

## soc/alif/ensemble/Kconfig.soc
```kconfig
# Copyright (c) 2025 Alif Semiconductor
#
# SPDX-License-Identifier: Apache-2.0

config SOC_FAMILY
	default "ensemble" if SOC_FAMILY_ENSEMBLE

config NONSECURE0_REGION
	string
	default "NON-SECURE0" if $(dt_nodelabel_enabled,ns)
	help
	    Provide config Non-Secure region

choice SYSTEM_HEAP_LOCATION
	prompt "System heap location"
	default SYSTEM_HEAP_ZEPHYR_DEFAULT if SOC_FAMILY_ENSEMBLE
	help
		Select the SRAM region to place the system heap for Ensemble SoCs.
		If no option is selected, the system heap will be placed in the default
		location.

config SYSTEM_HEAP_ZEPHYR_DEFAULT
	bool "Use Zephyr default system heap location"
	help
		For Ensemble SoCs. If enabled, the system heap will be placed
		in the default location instead of the specified SRAM region.

config SYSTEM_HEAP_SRAM0
	bool "Move system heap to SRAM0"

config SYSTEM_HEAP_SRAM1
	bool "Move system heap to SRAM1"

endchoice

config OSPI0_XIP_REGION
	string
	default "ospi0" if $(dt_nodelabel_enabled,ospi0)
	help
		Configure OSPI0 XIP memory mapped region name

config OSPI1_XIP_REGION
	string
	default "ospi1" if $(dt_nodelabel_enabled,ospi1)
	help
		Configure OSPI1 XIP memory mapped region name


rsource "*/Kconfig.soc"
```
