## dts/bindings/ipm/alif,hwsem.yaml
```yaml
# Copyright (c) 2024 Alif Semiconductor
#
# SPDX-License-Identifier: Apache-2.0

description: Hardware Semaphore for Alif SoCs

compatible: "alif,hwsem"

include: base.yaml

properties:
    reg:
      required: true

    interrupts:
      required: true
```

## dts/bindings/ipm/alif,secure-enclave-services.yaml
```yaml
# Copyright (C) 2024 Alif Semiconductor - All Rights Reserved.
# Use, distribution and modification of this code is permitted under the
# terms stated in the Alif Semiconductor Software License Agreement
#
# You should have received a copy of the Alif Semiconductor Software
# License Agreement with this file. If not, please write to:
# contact@alifsemi.com, or visit: https://alifsemi.com/license
description: Secure Enclave services through Arm MHUv2 on Alif SoCs

compatible: "alif,secure-enclave-services"

properties:
  status:
    type: string
    description: indicates the operational status of a device
    enum:
      - "ok" # Deprecated form
      - "okay"
      - "disabled"
      - "reserved"
      - "fail"
  compatible:
    type: string-array
    required: true
    description: compatible strings
  mhuv2-send-node:
    type: phandle
    required: true
    description: Arm MHUv2 sender node used for SE services.
  mhuv2-recv-node:
    type: phandle
    required: true
    description: Arm MHUv2 recevier node used for SE services.
```

## dts/bindings/mdio/alif,mdio.yaml
```yaml
# Copyright (C) 2025 Alif Semiconductor
# SPDX-License-Identifier: Apache-2.0

description: Alif MDIO Features

compatible: "alif,mdio"

include: mdio-controller.yaml
```

## dts/bindings/mdio/snps,designware-mdio.yaml
```yaml
# Copyright (C) 2025 Alif Semiconductor
# SPDX-License-Identifier: Apache-2.0

description: Synopsys DesignWare MDIO Controller

compatible: "snps,designware-mdio"

include: mdio-controller.yaml
```

## dts/bindings/mhu/arm,mhuv2.yaml
```yaml
# Copyright (c) 2024 Alif Semiconductor
#
# SPDX-License-Identifier: Apache-2.0

description: ARM MHUv2 (Message Handling Unit v2)

compatible: "arm,mhuv2"

include: base.yaml

properties:
    reg:
      required: true

    interrupts:
      required: true

    interrupt-names:
      required: true
      description: |
        interrupt-names should be either 'tx' for sender interrupt or
        'rx' for receiver interrupt.
```

## dts/bindings/mipi-dphy/snps,designware-dphy.yaml
```yaml
# Copyright (C) 2024 Alif Semiconductor
# SPDX-License-Identifier: Apache-2.0

description: |
  ALIF Devkit MIPI D-PHY from Synopsis.

compatible: "snps,designware-dphy"

include: base.yaml

properties:
  ref-frequency:
    type: int
    default: 38400000
    description: Reference Frequency for D-PLL.

  cfg-clk-frequency:
    type: int
    default: 25000000
    description: Configuration clock frequency for D-PHY.

  "#dphy-cells":
    type: int
    required: true
    const: 1
    description: Provides the cell ID of DPHY to be used.

dphy-cells:
  - id
```

## dts/bindings/mipi-dsi/snps,designware-dsi.yaml
```yaml
# Copyright (C) 2024 Alif Semiconductor
# SPDX-License-Identifier: Apache-2.0

description: Designware MIPI DSI

compatible: "snps,designware-dsi"

include: mipi-dsi-host.yaml

properties:
  interrupts:
    required: true

  cdc-if:
    type: phandle
    required: true
    description: Instance of CDC200 peripheral

  phy-if:
    type: phandle-array
    required: true
    specifier-space: dphy
    description:
      Handle to the PHY interface.

  eotp-lp-tx-en:
    type: boolean
    description:
      Automatically insert an EoTp short packet at the end of LP transmission.

  eotp-rx-en:
    type: boolean
    description:
      Enable reception of an EoTp short packet at the end of LPDT reception
      from peripheral.

  ecc-recv-en:
    type: boolean
    description:
      DSI controller should support ECC reception, error correction and
      reporting.

  crc-recv-en:
    type: boolean
    description:
      DSI controller should support CRC reception and error reporting.

  frame-ack-en:
    type: boolean
    description:
      DSI controller should request Peripheral ACK at the end of frames.

  dpi-colorm-active:
    type: int
    required: true
    description:
      Color-Mode command pulse polarity.
      If dpicolorm is active low, use 0,
      otherwise use 1.
    enum:
      - 0
      - 1

  dpi-shutdn-active:
    type: int
    required: true
    description:
      Shutdown command pulse polarity.
      If dpishutdn is active low, use 0,
      otherwise use 1.
    enum:
      - 0
      - 1

  vid-pkt-size:
    type: int
    default: 0
    description:
      Video packet size in MIPI Video mode pixel stream in bytes. The product of
      number of chunks and video packet size should be active line width.

  dpi-video-pattern-gen:
    type: string
    required: false
    enum:
      - "vertical-color-bar"
      - "horizontal-color-bar"
      - "vertical-bit-error-rate"
    description:
      Video pattern generator for testing MIPI-DSI without DPI inputs.

  panel-max-lane-bandwidth:
    type: int
    default: 500000000
    description:
      The lane bandwidth that a panel supports. All the calculations for DPHY
      PLL should be limited to half of the above value for a panel.
```

## dts/bindings/misc/alif,aipm-off.yaml
```yaml
# SPDX-FileCopyrightText: Copyright Alif Semiconductor
# SPDX-License-Identifier: Apache-2.0

description: |
  Alif AIPM off-profile node.

  Contains child off-profile nodes — one per PM state/substate the system
  can enter.  Each child maps to an off_profile_t sent to the SE just before
  the CPU is power-gated.

  The parent node carries vtor-address: the vector-table base address the SE
  uses to resume the CPU after wakeup.  All children in one node belong to
  one image, so vtor-address is the same for every state.  SoC DTSI defaults:
    - RTSS-HE, E1C, B1: 0x80000000  (MRAM boot)
    - RTSS-HP:          0x80200000  (MRAM boot)
  Override in a board overlay for MRAM or SRAM-relocation boot.

  At build time, se_service.c uses DT_FOREACH_CHILD_STATUS_OKAY to generate a
  compile-time lookup table (aipm_off_profiles[]).  At runtime, matching is by
  (pm-state, pm-substate) in the state_entry PM notifier, just before the CPU
  enters the low-power state.

  wakeup-events and ewic-cfg default to 0 in SoC DTSIs and must be set in a
  board overlay to enable wakeup sources.  The node itself is status = "disabled"
  in SoC DTSIs; a board overlay sets status = "okay" to activate it.


compatible: "alif,aipm-off"

properties:
  vtor-address:
    type: int
    required: true
    description: |
      Vector table base address (off_profile_t.vtor_address).
      The SE uses this to resume CPU execution after wakeup.
      Must match the active VTOR at the time of entry:
        0x00000000   — TCM boot (RTSS-HE, E1C, B1)
        0x80200000   — MRAM boot (RTSS-HP default)
        0x80000000   — MRAM boot (RTSS-HE default)
      Override in a board overlay if the vector table is relocated to SRAM.

child-binding:
  description: |
    Off profile for a specific PM state/substate, mapping to off_profile_t.
    pm-state is required — every child must target an explicit state.
    Set status = "disabled" to exclude this child from the compiled table.

  properties:
    pm-state:
      type: int
      required: true
      description: |
        Zephyr pm_state enum value this off profile applies to.
        Values: 3=SUSPEND_TO_RAM, 5=SOFT_OFF.

    pm-substate:
      type: int
      default: 0
      description: Substate index within pm-state. Default 0.

    aipm-power-domains:
      type: int
      description: |
        Power domain bitmask (off_profile_t.power_domains).
        Domains kept powered during sleep.
        Use ALIF_PD_*_MASK constants from
        dt-bindings/misc/alif_aipm_common.h.

    dcdc-voltage:
      type: int
      description: |
        DCDC output voltage (off_profile_t.dcdc_voltage).
        Valid values: 800, 825, 850.

    dcdc-mode:
      type: string
      enum:
        - "off"
        - "pfm-auto"
        - "pfm-forced"
        - "pwm"
      description: |
        DCDC operating mode (off_profile_t.dcdc_mode).
          "off"        - DCDC_MODE_OFF  (typical for sleep)
          "pfm-auto"   - DCDC_MODE_PFM_AUTO
          "pfm-forced" - DCDC_MODE_PFM_FORCED
          "pwm"        - DCDC_MODE_PWM

    aon-clk-src:
      type: string
      enum:
        - "lfrc"
        - "lfxo"
      description: |
        Always-on low-frequency clock source (off_profile_t.aon_clk_src).
          "lfrc" - CLK_SRC_LFRC
          "lfxo" - CLK_SRC_LFXO (default; more accurate)

    stby-clk-src:
      type: string
      enum:
        - "hfrc"
        - "hfxo"
        - "pll"
      description: |
        High-frequency standby clock source (off_profile_t.stby_clk_src).
        Used by the SE in SoC standby mode.
          "hfrc" - CLK_SRC_HFRC (default)
          "hfxo" - CLK_SRC_HFXO
          "pll"  - CLK_SRC_PLL

    stby-clk-freq:
      type: int
      description: |
        Scaled standby clock frequency (off_profile_t.stby_clk_freq).
        Use ALIF_SCALED_FREQ_RC_STDBY_* constants from
        dt-bindings/misc/alif_aipm_common.h.
        Default ALIF_SCALED_FREQ_RC_STDBY_76_8_MHZ (= 8) when omitted.

    memory-blocks:
      type: int
      description: |
        Memory block retention bitmask (off_profile_t.memory_blocks).
        Memories kept powered and retained during sleep.
        Defaults to 0 (no retention) if omitted.
        Use ALIF_*_MASK constants from the per-SoC header:
          alif_aipm_ensemble.h        — base Ensemble (E1/E3/E5/E7)
          alif_aipm_ensemble_gen2.h   — Ensemble Gen2 (E4/E6/E8)
          alif_aipm_ensemble_e1c.h    — Ensemble E1C
          alif_aipm_balletto_b1.h     — Balletto B1

    ip-clock-gating:
      type: int
      default: 0
      description: |
        IP clock-gate bitmask (off_profile_t.ip_clock_gating).
        Use ALIF_IP_CLK_GATE_*_MASK from dt-bindings/misc/alif_aipm_common.h.

    phy-pwr-gating:
      type: int
      default: 0
      description: |
        PHY power-gate bitmask (off_profile_t.phy_pwr_gating).
        Use ALIF_PHY_GATE_*_MASK from dt-bindings/misc/alif_aipm_common.h.

    vdd-ioflex:
      type: int
      default: 1
      description: |
        IOFLEX voltage level (off_profile_t.vdd_ioflex_3V3 = ioflex_mode_t).
        Use ALIF_IOFLEX_LEVEL_* constants from dt-bindings/misc/alif_aipm_common.h.
          ALIF_IOFLEX_LEVEL_3V3 = 0  (3.3 V GPIOs)
          ALIF_IOFLEX_LEVEL_1V8 = 1  (1.8 V GPIOs, default)

    wakeup-events:
      type: int
      default: 0
      description: |
        Wakeup event bitmask (off_profile_t.wakeup_events).
        0 = no wakeup sources (default in SoC DTSI; set in board overlay).
        Use ALIF_WE_* constants from dt-bindings/misc/alif_aipm_common.h.

    ewic-cfg:
      type: int
      default: 0
      description: |
        EWIC (External Wakeup Interrupt Controller) configuration bitmask
        (off_profile_t.ewic_cfg).
        0 = no EWIC sources (default in SoC DTSI; set in board overlay).
        Use ALIF_EWIC_* constants from the per-SoC header.
```
