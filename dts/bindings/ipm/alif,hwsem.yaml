## dts/bindings/misc/alif,aipm-run.yaml
```yaml
# SPDX-FileCopyrightText: Copyright Alif Semiconductor
# SPDX-License-Identifier: Apache-2.0

description: |
  Alif AIPM run-profile node.

  Contains child run-profile nodes — one per PM state/substate combination.
  One child without a pm-state property is the cold-boot default and the
  universal fallback for any PM state not explicitly covered by another child.

  At build time, se_service.c uses DT_FOREACH_CHILD_STATUS_OKAY to generate a
  compile-time lookup table (aipm_profiles[]). At runtime, the matching child
  is selected by (pm-state, pm-substate); the default child is used as fallback.

  Timing guarantees:
    Cold boot  — profile is applied at the end of se_service_mhuv2_nodes_init(),
                 which runs at PRE_KERNEL_1, CONFIG_SE_SERVICE_INIT_PRIORITY
                 (default 45).  Power domains declared in aipm-power-domains are
                 active from that point onward.  Drivers or SYS_INIT callbacks
                 that require a power domain (e.g. SYSTOP for peripheral register
                 access) must run at PRE_KERNEL_1 priority > 45.

    PM resume  — profile is applied in the pre_device_resume PM notifier, which
                 fires before pm_resume_devices().  Apps registering their own
                 pre_device_resume notifier must register after se_service
                 (i.e. at a later SYS_INIT priority) so that the run profile —
                 and thus any required power domains — is already active when
                 their notifier runs.

  Child nodes with status = "disabled" are excluded from the compiled table.
  Set status = "disabled" on a DTSI-defined child in a board overlay to suppress
  it and replace it with a custom child in the same overlay.

compatible: "alif,aipm-run"

child-binding:
  description: |
    Run profile for a specific PM state/substate, mapping to run_profile_t.
    A child without pm-state is the cold-boot default / universal fallback.
    Set status = "disabled" to exclude this child from the compiled table.

  properties:
    pm-state:
      type: int
      description: |
        Zephyr pm_state enum value this profile targets on resume.
        Omit entirely for the cold-boot default / universal fallback node.
        Values: 0=ACTIVE, 1=RUNTIME_IDLE, 2=SUSPEND_TO_IDLE,
                3=SUSPEND_TO_RAM, 4=SUSPEND_TO_DISK, 5=SOFT_OFF.

    pm-substate:
      type: int
      default: 0
      description: Substate index within pm-state. Default 0.

    aipm-power-domains:
      type: int
      description: |
        Power domain bitmask (run_profile_t.power_domains).
        Use ALIF_PD_*_MASK constants from
        dt-bindings/misc/alif_aipm_common.h.

    dcdc-voltage:
      type: int
      description: |
        DCDC output voltage in millivolts (run_profile_t.dcdc_voltage).
        Valid values: 800, 825, 850.

    dcdc-mode:
      type: string
      enum:
        - "off"
        - "pfm-auto"
        - "pfm-forced"
        - "pwm"
      description: |
        DCDC operating mode (run_profile_t.dcdc_mode).
          "off"        - DCDC_MODE_OFF
          "pfm-auto"   - DCDC_MODE_PFM_AUTO
          "pfm-forced" - DCDC_MODE_PFM_FORCED
          "pwm"        - DCDC_MODE_PWM

    aon-clk-src:
      type: string
      enum:
        - "lfrc"
        - "lfxo"
      description: |
        Always-on low-frequency clock source (run_profile_t.aon_clk_src).
          "lfrc" - CLK_SRC_LFRC
          "lfxo" - CLK_SRC_LFXO

    clk-src:
      type: string
      enum:
        - "hfrc"
        - "hfxo"
        - "pll"
      description: |
        High-frequency run clock source (run_profile_t.run_clk_src).
          "hfrc" - CLK_SRC_HFRC
          "hfxo" - CLK_SRC_HFXO
          "pll"  - CLK_SRC_PLL

    cpu-clk-freq:
      type: int
      required: true
      description: |
        CPU clock frequency (run_profile_t.cpu_clk_freq).
        Use ALIF_CLOCK_FREQ_* constants from
        dt-bindings/misc/alif_aipm_common.h.

    scaled-clk-freq:
      type: int
      default: 0
      description: |
        Scaled clock frequency (run_profile_t.scaled_clk_freq).
        Use ALIF_SCALED_FREQ_* constants from dt-bindings/misc/alif_aipm_common.h.
        Default 0 = ALIF_SCALED_FREQ_RC_ACTIVE_76_8_MHZ (no explicit scaling override).

    memory-blocks:
      type: int
      description: |
        Memory block retention bitmask (run_profile_t.memory_blocks).
        Use ALIF_*_MASK constants from the per-SoC header:
          alif_aipm_ensemble.h        — base Ensemble (E1/E3/E5/E7)
          alif_aipm_ensemble_gen2.h   — Ensemble Gen2 (E4/E6/E8)
          alif_aipm_ensemble_e1c.h    — Ensemble E1C
          alif_aipm_balletto_b1.h     — Balletto B1

    ip-clock-gating:
      type: int
      default: 0
      description: |
        IP clock-gate bitmask (run_profile_t.ip_clock_gating).
        0 = all IPs gated.
        Use ALIF_IP_CLK_GATE_*_MASK constants from dt-bindings/misc/alif_aipm_common.h.

    phy-pwr-gating:
      type: int
      default: 0
      description: |
        PHY power-gate bitmask (run_profile_t.phy_pwr_gating).
        0 = all PHYs gated.
        Use ALIF_PHY_GATE_*_MASK constants from dt-bindings/misc/alif_aipm_common.h.

    vdd-ioflex:
      type: int
      default: 1
      description: |
        IOFLEX voltage level (run_profile_t.vdd_ioflex_3V3 = ioflex_mode_t).
        Use ALIF_IOFLEX_LEVEL_* constants from dt-bindings/misc/alif_aipm_common.h.
          ALIF_IOFLEX_LEVEL_3V3 = 0  (3.3 V GPIOs)
          ALIF_IOFLEX_LEVEL_1V8 = 1  (1.8 V GPIOs, default)
        Note: the enum ordering is counter-intuitive (3V3 = 0); always use
        the named constants rather than a raw integer.
```

## dts/bindings/mtd/alif,apmemory-aps512xxn.yaml
```yaml
# Copyright (c) 2025 Alif Semiconductor
#
# SPDX-License-Identifier: Apache-2.0

description: AP-Memory PSRAM on ALIF Hex-SPI(DW-SSI) bus

compatible: "alif,apmemory-aps512xxn"

include: base.yaml

properties:
  size:
    type: int
    required: true
    description: |
      The RAM size in bytes.

  x16-data-transfer-mode:
    type: boolean
    description: |
      Enable 16 Data lines transfer mode. This is only available for Data Transfer.
      Default is 8 Data lines transfer mode.

  latency-code:
    type: int
    enum:
      - 3
      - 4
      - 5
      - 6
      - 7
    required: true
    description: |
       The RAM wait cycle value for read/write operations depends on the operating frequency
       of the OSPI interface. The latency value should be selected according to the input clock
       frequency to ensure reliable operation.
       | Latency code | Max CLK (MHz) |
       | ------------ | ------------- |
       | 3            | 66            |
       | 4            | 109           |
       | 5            | 133           |
       | 6            | 166           |
       | 7            | 200           |
```

## dts/bindings/mtd/issi,wvh64m8eall.yaml
```yaml
# Copyright (c) 2026 Alif Semiconductor
#
# SPDX-License-Identifier: Apache-2.0

description: ISSI IS66/67WVH64M8EALL/BLL HyperRAM on ALIF OSPI bus

compatible: "issi,wvh64m8eall"

include: base.yaml

properties:
  size:
    type: int
    required: true
    description: |
      The RAM size in bytes.
```

## dts/bindings/pinctrl/alif,pinctrl.yaml
```yaml
# Copyright (c) 2025 Alif Semiconductor
#
# SPDX-License-Identifier: Apache-2.0
description: |
    Alif Devkit pin controller is a node responsible for controlling
    function of the selected pin, pin properties, such as routing
    UART4 RX_B and UART4 TX_B on pins 12_1 and 12_2 respectively and
    settings output drive strength to any one of 2mA, 4mA, 8mA, and 12mA.

    The Devkit pin controller has the 'pinctrl' node label in SoC's
    devicetree, that can be referenced and modified as below:

    &pinctrl {
          /* all modifications go here */
    };

    All device pin configurations should be placed in child nodes of the
    'pinctrl' node, as shown in this example:

    /* To avoid lengthly board.dts file due to addition of
     * pinctrl contents all contents specific to pinctrl
     * can be placed in board-pinctrl.dtsi file (e.g., ensemble-pinctrl.dtsi)
     * in your board directory and include in board.dts, or a devicetree
     * overlay in your application. */

    /* include pre-defined combinations for the SoC variant used by the board
     * */
    #include <dt-bindings/pinctrl/ensemble-pinctrl.h>

    &pinctrl {
      /* configuration for the uart4 "default" state */
      pinctrl_uart4: pinctrl_uart4 {
        /* group 0 */
        group0 {
          /* configure pins P12_1 and P12_2 as UART4 RX and UART4 TX */
          pinmux = < PIN_P12_1__UART4_RX_B >,
                   < PIN_P12_2__UART4_TX_B >;
          /* enable read on pins P12_1 and P12_2 */
          read_enable = < 0x1 >;
        };
      };
      pinctrl_i3c: pinctrl_i3c {
        /* group 0 */
        group0 {
          /* configure pin P7_6 I3C_SDA */
          pinmux = < PIN_P7_6__I3C_SDA_D >;
          /* enable schimtt trigger and drive strength to 4mA on pin P7_6 */
          schmitt_enable = < 0x1 >;
          drive_strength = < 0x4 >;
        };
        /* group 1 */
        group1 {
          /* configure pin P7_7 as I3C_SCL */
          pinmux = < PIN_P7_7__I3C_SCL_D >;
          /* set drive strength to 2mA on pin P7_7 */
          drive_strength = < 0x2 >;
        };
      };
    };

    The 'pinctrl_uart4' child node encodes the pin configurations for a
    particular state of a device; in this case, the default (that is, active)
    state. Similarly, for 'pinctrl_i3c' child node.

    As shown, pin configurations are organized in groups within each
    child node. Each group can specify a list of pin function selections
    in the 'pinmux' property.

    A group can specify shared pin properties common to all the specified
    pins in a group, such as 'read_enable' property in group 0 of
    'pinctrl_uart4' node or separate pin properties for each pin in a group
    such as 'schmitt_enable' in group 0, and 'drive_strength' in both
    group 0 and 1 of 'pinctrl_i3c' node.
    List of supported standard pin properties are below:
    - read_enable: read selection. 0 for disable and 1 for enable.
    - schmitt_enable:  schmitt trigger selection.
                       0 for disable and 1 for enable.
    - slew_rate: slew rate speed. 0 for slow and 1 for fast.
    - driver_state_control: driver disabled state control.
                            Two bits feild can be:
                            0 0 for High Z
                            0 1 for Pull up
                            1 0 for Pull down
                            1 1 for Bus repeater
    - driver_strength: output drive strength.
                            Two bits feild can be:
                            0 0 for 2mA
                            0 1 for 4mA
                            1 0 for 8mA
                            1 1 for 12mA
    - driver: driver selection. 0 for Push pull and 1 for open drain.

    To link pin configurations with a device, use a pinctrl-N property for some
    number N, like this example you could place in your board's DTS file:

       #include "board-pinctrl.dtsi"

       &uart4 {
             pinctrl-0 = <&pinctrl_uart4>;
             pinctrl-names = "default";
       };

       &i3c {
             pinctrl-0 = <&pinctrl_i3c>;
             pinctrl-names = "default";
       };

compatible: "alif,pinctrl"

include: base.yaml

properties:
  reg:
    required: true

child-binding:
  description: Definitions for a pinctrl state.
  child-binding:
    include:
      - name: pincfg-node.yaml
        property-allowlist:
          - bias-disable
          - bias-pull-down
          - bias-pull-up
          - read-enable
          - input-schmitt-enable
          - drive-strength
          - slew-rate

    properties:
      pinmux:
        required: true
        type: array
        description: |
          An array of pins sharing the same group properties. Each
          element of the array is an integer constructed from the
          pin number and the alternative function of the pin.
      read_enable:
        type: int
        enum:
           - 0
           - 1
        default: 1
        description: |
          Option to enable read.
          0 - disable
          1 - enable
      schmitt_enable:
        type: int
        enum:
           - 0
           - 1
        default: 1
        description: |
          Option to enable schmitt trigger.
          0 - disable
          1 - enable
      slew_rate:
        type: int
        enum:
          - 0
          - 1
        default: 0
        description: |
          Pin output slew rate.
          0 - slow slew rate when pin is configured as output
          1 - fast slew rate when pin is configured as output
      driver_state_control:
        type: int
        enum:
          - 0
          - 1
          - 2
          - 3
        default: 0
        description: |
          Driver disabled state control.
          0 - High Z
          1 - Pull up
          0 - Pull down
          1 - Bus repeater
      drive_strength:
        type: int
        enum:
          - 2
          - 4
          - 8
          - 12
        default: 4
        description: |
          The output drive strength of a pin, in mA.
          The default value is 4mA.
      driver:
        type: int
        enum:
          - 0
          - 1
        default: 0
        description: |
          Pin output slew rate.
          0 - push-pull
          1 - open drain
```

## dts/bindings/power-domain/alif,power-domain.yaml
```yaml
# Copyright (c) 2025 Alif Semiconductor
#
# SPDX-License-Identifier: Apache-2.0

description: |
  Alif Semiconductor individual power domain device

  Each power domain is a separate device that manages one specific Alif power domain
  (SYST, SSE700_AON, etc.) through SE Services aiPM interface.

  This design allows Zephyr's PM framework to automatically handle power domains
  through runtime PM (pm_device_runtime_get/put) or system PM (suspend/resume).

  Example usage in board DTS:

    #include <zephyr/dt-bindings/power-domain/alif_power_domain.h>

    pd_syst: power-domain-syst {
        compatible = "alif,power-domain";
        domain-id = <ALIF_PD_SYST>;
        #power-domain-cells = <0>;
    };

    pd_sse700_aon: power-domain-sse700-aon {
        compatible = "alif,power-domain";
        domain-id = <ALIF_PD_SSE700_AON>;
        #power-domain-cells = <0>;
    };

    &uart0 {
        power-domains = <&pd_syst>;
    };

compatible: "alif,power-domain"

include: power-domain.yaml

properties:
  domain-id:
    type: int
    required: true
    description: |
      Alif power domain ID (0-9) from alif_power_domain.h:
        ALIF_PD_VBAT_AON      = 0
        ALIF_PD_SRAM_CTRL_AON = 1
        ALIF_PD_SSE700_AON    = 2
        ALIF_PD_RTSS_HE       = 3
        ALIF_PD_SRAMS         = 4
        ALIF_PD_SESS          = 5
        ALIF_PD_SYST          = 6
        ALIF_PD_RTSS_HP       = 7
        ALIF_PD_DBSS          = 8
        ALIF_PD_APPS          = 9

  "#power-domain-cells":
    const: 0
```

## dts/bindings/pwm/alif,pwm.yaml
```yaml
# Copyright (c) 2024 Alif Semiconductor
#
# SPDX-License-Identifier: Apache-2.0

description: Alif UTIMER in PWM mode

compatible: "alif,pwm"

include: [pwm-controller.yaml, base.yaml, pinctrl-device.yaml]

properties:
  "#pwm-cells":
    const: 3
    description: |
      Number of items to expect in a PWM
      - channel
      - period to set in ns
      - flags for PWM

pwm-cells:
  - channel
  - period
  - flags
```
