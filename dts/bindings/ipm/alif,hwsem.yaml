## dts/bindings/rng/alif,secure-enclave-trng.yaml
```yaml
# Copyright (c) 2024 Alif Semiconductor
#
# SPDX-License-Identifier: Apache-2.0
description: Entropy random number driver for Alif SoCs

compatible: "alif,secure-enclave-trng"

properties:
  status:
    type: string
    description: indicates the operational status of a device
    enum:
      - "ok" # Deprecated form
      - "okay"
      - "disabled"
      - "reserved"
      - "fail"
  compatible:
    type: string-array
    required: true
    description: compatible strings
```

## dts/bindings/sdhc/intel,emmc-host.yaml
```yaml
# Copyright (c) 2023 Intel Corporation
# SPDX-License-Identifier: Apache-2.0

description: eMMC host controller

compatible: "intel,emmc-host"

include: [sdhc.yaml, pcie-device.yaml, pinctrl-device.yaml]

properties:
  cd-gpios:
    type: phandle-array
    description: |
      Card detect pin.
      This pin is active-low when a card is inserted,
      high when a card is absent. The property value should ensure
      the flags properly describe the signal that is presented
      to the driver.
```

## dts/bindings/sdhc/snps,dwc-sdhc.yaml
```yaml
# SPDX-FileCopyrightText: Copyright Alif Semiconductor
# SPDX-License-Identifier: Apache-2.0

description: Synopsys DesignWare Core SD Host Controller

compatible: "snps,dwc-sdhc"

include: [sdhc.yaml, pinctrl-device.yaml]

properties:
  reg:
    required: true
  interrupts:
    required: true
    description: |
      At least one interrupt is required:
        - "sdmmc": main SDMMC interrupt (command/transfer/error/card detect)
        - "sdmmc_wakeup": Card Insert/Remove/SDIO card wakeup interrupt (optional)
  interrupt-names:
    required: true
  pinctrl-0:
    required: true
  pinctrl-names:
    required: true
  cd-gpios:
    type: phandle-array
    description: |
      Card detect pin.
      This pin is active-low when a card is inserted,
      high when a card is absent. The property value should ensure
      the flags properly describe the signal that is presented
      to the driver.
  bus-width:
    type: int
    default: 4
    description: |
      Data bus width supported by the board wiring.
      Valid values are 1, 4, or 8. Default is 4.
  no-1-8-v:
    type: boolean
    description: |
      If present, the board does not support 1.8V signaling
      even if the controller hardware is capable of it.
  reset-gpios:
    type: phandle-array
    description: |
      Hardware reset pin for the SD card slot.
      Active-high to trigger a card reset.
```

## dts/bindings/sensor/alif,qdec.yaml
```yaml
# Copyright (c) 2025 Alif Semiconductor
#
# SPDX-License-Identifier: Apache-2.0

description: ALIF UTIMER Quadrature Decoder

compatible: "alif,qdec"

include: [base.yaml, pinctrl-device.yaml]

properties:
  pinctrl-0:
    required: true

  pinctrl-names:
    required: true

  counts-per-revolution:
    type: int
    required: true
    description: |
         Number of counts for one complete revolution.

  input-filter-enable:
    type: boolean
    description: |
         Enable filter function for input signals.

  filter-prescaler:
    type: int
    description: |
         Value to sample input signals periodically before entering
         filter taps (range: 0-63).

  filter-taps:
    type: int
    description: |
         Number of filter taps (range: 0-15).
```

## dts/bindings/serial/ns16550.yaml
```yaml
description: ns16550 UART

compatible: "ns16550"

include: [uart-controller.yaml, pcie-device.yaml, pinctrl-device.yaml, reset-device.yaml]

properties:
  reg-shift:
    type: int
    required: true
    description: quantity to shift the register offsets by

  pcp:
    type: int
    description: custom clock (PRV_CLOCK_PARAMS, if supported)

  dlf:
    type: int
    description: divisor latch fraction (DLF, if supported)

  fifo-size:
    type: int
    description: Size of FIFO

  io-mapped:
    type: boolean
    description: specify registers are IO mapped or memory mapped

  software-reset:
    type: boolean
    description: If present, the driver will perform a software reset on the UART
      instance during initialization using the Software Reset Register (SRR) available
      in some implementations of the Synopsys DesignWare UART. Use this property only
      for UARTs that have the SRR.

  rts-ctrl:
    type: boolean
    description: Support RTS signal controlled by SW
```

## dts/bindings/spi/snps,designware-spi.yaml
```yaml
# Copyright (c) 2018 Synopsys, Inc. All rights reserved.
# Copyright (c) 2023 Meta Platforms All rights reserved.
# Copyright (c) 2024 Alif Semiconductor
# SPDX-License-Identifier: Apache-2.0

description: Synopsys DesignWare SPI node

compatible: "snps,designware-spi"

include: [spi-controller.yaml, pinctrl-device.yaml]

properties:
  reg:
    required: true

  interrupts:
    required: true

  dwc-ssi:
    type: boolean
    description: |
      Enable this flag for DWC_ssi only. For SPI devices on apb
      like DW_apb_ssi, disable this flag. Using this flag for the
      combined single driver to differentiate DW-apb-ssi and
      DWC-ssi IPs

  aux-reg:
    type: boolean
    description: |
      This value is used for auxiliary register access. For
      other platform, this value should be default 0.

  fifo-depth:
    type: int
    description: |
      RX/TX FIFO depth. Corresponds to the SSI_TX_FIFO_DEPTH
      and SSI_RX_FIFO_DEPTH of the DesignWare Synchronous
      Serial Interface. Depth ranges from 2-256.

  serial-target:
    type: boolean
    description: |
      True if it is a Serial Target. False if it is a Serial
      Master. Corresponds to SSI_IS_MASTER of the Designware
      Synchronous Serial Interface.

  max-xfer-size:
    type: int
    description: |
      Maximum transfer size. Corresponds to SPI_MAX_XFER_SIZE
      of the DesignWare Synchronous Serial Interface. Only
      values of 16 and 32 are supported.
    enum:
      - 16
      - 32

  rx-delay:
    type: int
    description: |
      The number of SPI_CLK cycles that are delayed before the
      actual sample of the RxD input occurs.

  slv-slct-toggle:
    type: boolean
    description: |
      Enable or Disable the chip select line toggle between
      consecutive data frames.
```

## dts/bindings/usb/snps,dwc3.yaml
```yaml
# Copyright (c) 2025 Alif Semiconductor
#
# SPDX-License-Identifier: Apache-2.0

description: DesignWare USB DWC3 controller

compatible: "snps,dwc3"

include: [usb-controller.yaml]

bus: usb

properties:
  reg:
    required: true

  interrupts:
    required: true


  num-in-eps:
    type: int
    required: true
    description: |
      Number of configured IN endpoints including control endpoint.

  num-out-eps:
    type: int
    required: true
    description: |
      Number of configured OUT endpoints including control endpoint.
```

## dts/bindings/video/alif,cam.yaml
```yaml
# Copyright (C) 2024 Alif Semiconductor
# SPDX-License-Identifier: Apache-2.0

description: ALIF Camera Parallel Interface

compatible: "alif,cam"

include: [base.yaml, pinctrl-device.yaml]

properties:
  reg:
    required: true

  interrupts:
    required: true

  clocks:
    required: true

  clock-names:
    required: true

  sensor:
    required: true
    type: phandle
    description: phandle of connected sensor device

  csi-bus-if:
    required: false
    type: phandle
    description: phandle to connected MIPI CSI-2 bus device.

  lp-cam:
    type: boolean
    description: Signifies if the current CPI IP is LPCPI or normal CPI.

  capture-mode:
    type: string
    required: false
    default: "snapshot"
    description: Continuous or single frame (snapshot) capture.
    enum: ["continuous", "snapshot"]

  fifo-rd-wmark:
    type: int
    required: false
    default: 0x08
    description: Output FIFO read (almost empty) watermark.
    enum: [4, 5, 6, 7, 8, 9, 10, 11, 12, 13, 14, 15, 16]

  fifo-wr-wmark:
    type: int
    required: false
    default: 0x18
    description: Output FIFO write (almost full) watermark.
    enum: [16, 17, 18, 19, 20, 21, 22, 23, 24, 25, 26, 27, 28]

  code-10-on-8:
    type: boolean
    description: Send 10-bit of data on 8-bit interface (data-mode).

  data-mask:
    type: string
    required: false
    default: "16-bit"
    description: Video data mask for 16-bit data-mode.
    enum: ["16-bit", "10-bit", "12-bit", "14-bit"]

  data-mode:
    type: string
    required: false
    default: "8-bit"
    description: Defines number of data pins from external camera sensor. 32-bit and 64-bit modes are only valid for MIPI-CSI.
    enum: ["1-bit", "2-bit", "4-bit", "8-bit", "16-bit", "32-bit", "64-bit"]

  inv-vsync-pol:
    type: int
    required: false
    default: 0
    description: Invert polarity of V-Sync Signal
    enum: [0, 1]

  inv-hsync-pol:
    type: int
    required: false
    default: 0
    description: Invert polarity of H-Sync Signal
    enum: [0, 1]

  inv-pclk-pol:
    type: int
    required: false
    default: 0
    description: Invert polarity of Pixel-Clock Signal
    enum: [0, 1]

  wait-vsync:
    type: boolean
    description: Start to capture video frame on the rising edge of V-Sync. If V-Sync and H-Sync are aligned, we can begin data capture without waiting for V-Sync rising edge; else we start data capture on the rising edge of V-Sync.

  vsync-en:
    type: boolean
    description: Capture video data when V-Sync as well as H-Sync is high. In absence of this property, data will be captured when only H-Sync is high.

  msb:
    type: boolean
    description: Camera sensor sends Most Significant Byte last based on data-mode type.

  csi-halt-en:
    type: boolean
    description: Enable MIPI-CSI halt function when FIFO is almost full.

child-binding:
  child-binding:
    child-binding:
      include: video-interfaces.yaml
      properties:
        reg:
          type: int
          enum:
            - 0 # CSI-2/Camera EP
            - 1 # Memory dump EP
            - 2 # ISP EP
```

## dts/bindings/video/aptina,mt9m114.yaml
```yaml
# Copyright (c) 2019, Linaro Limited
# Copyright 2024 NXP
#
# SPDX-License-Identifier: Apache-2.0

description: MT9M114 CMOS video sensor

compatible: "aptina,mt9m114"

include: [base.yaml, i2c-device.yaml]

properties:
  reset-gpios:
    type: phandle-array
    description: |
      The RESETn pin is asserted to disable the sensor causing a hard
      reset. This pin is an alias for the XSHUTDOWN pin in sensor schematics.
      The sensor receives this as an active-low signal.

child-binding:
  child-binding:
    include: video-interfaces.yaml
```

## dts/bindings/video/himax,hm0360.yaml
```yaml
# Copyright (C) 2025 Alif Semiconductor
# SPDX-License-Identifier: Apache-2.0

description: Himax HM0360 CMOS video sensor

compatible: "himax,hm0360"

include: [base.yaml, pinctrl-device.yaml, i2c-device.yaml]

properties:
  reset-gpios:
    type: phandle-array
    description: |
      The RESETn pin is asserted to disable the sensor causing a hard
      reset. This pin is alias to XSHUTDOWN pin in sensor schematics.
      The sensor receives this as an active-low signal.

  power-gpios:
    type: phandle-array
    description: |
      The Power Pin is asserted to enable the 1.2 V and 2.7 V signals needed
      by sensor. The sensor receives this as an active-high signal.

  xsleep-gpios:
    type: phandle-array
    description: |
      The XSLEEP Pin is asserted to put the sensor in Low power sleep mode.
      The sensor receives this as an active-low signal.
```

## dts/bindings/video/onnn,arx3a0.yaml
```yaml
# Copyright (C) 2024 Alif Semiconductor
# SPDX-License-Identifier: Apache-2.0

description: Onsemi ARX3A0 CMOS video sensor

compatible: "onnn,arx3a0"

include: [base.yaml, pinctrl-device.yaml, i2c-device.yaml]

properties:
  reset-gpios:
    type: phandle-array
    description: |
      The RESETn pin is asserted to disable the sensor causing a hard
      reset.  The sensor receives this as an active-low signal.

  power-gpios:
    type: phandle-array
    description: |
      The Power Pin is asserted to enable the 1.2 V, 1.8 V and 2.7 V signals
      needed by sensor. The sensor receives this as an active-high signal.

child-binding:
  child-binding:
    include: video-interfaces.yaml
```
