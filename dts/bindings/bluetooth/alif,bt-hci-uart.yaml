## dts/bindings/dma/alif,event-router.yaml
```yaml
# SPDX-FileCopyrightText: Copyright Alif Semiconductor
# SPDX-License-Identifier: Apache-2.0

description: |
  Alif Event Router (DMA Multiplexer) controller

  The Alif Event Router is a DMA multiplexer that routes peripheral DMA requests
  to a DMA controller. Each event router has 32 channels, where each channel can
  multiplex from 1-4 peripheral input sources (selected via dma-group 0-3).
  Event router channels map 1:1 to DMA controller peripheral requests.

  Event router clients use a two-cell specifier:
  a phandle to the event router plus two integer cells.

  Cell format:
    Cell 0 (channel): Encoded value containing physical DMA channel, dma_group, and handshake
      Bit layout: [reserved(19)][handshake(1)][dma_group(4)][channel(8)]
      - channel (bits 0-7): Physical DMA channel (0-255)
      - dma_group (bits 8-11): Input source selection (current hardware: 0-3, bits 8-9 only;
                                bits 10-11 reserved for future expansion)
      - handshake (bit 12): Handshaking enable (0=disable, 1=enable)
      - reserved (bits 13-31): Reserved for future use

    Cell 1 (periph): Peripheral request number

  Use the ALIF_DMA_ENCODE() macro for encoding cell 0:
    dmas = <&evtrtr0 ALIF_DMA_ENCODE(channel, dma_group, handshake) periph>;

  Example for Alif Ensemble (using DMA-PL330 controller):
    dma0: dma@49080000 {
        compatible = "arm,dma-pl330";
        reg = <0x49080000 0x1000>;
        dma-channels = <8>;
        #dma-cells = <2>;
        status = "okay";
    };

    evtrtr0: event-router@49035000 {
        compatible = "alif,event-router";
        reg = <0x49035000 0x100>;
        dma-controller = <&dma0>;
        channels = <32>;
        dma-groups = <4>;  /* Current hardware: 4 groups (0-3) */
        #dma-cells = <2>;
        status = "okay";
    };

  Example client (UART) using ALIF_DMA_ENCODE:
    #include <zephyr/dt-bindings/dma/alif_dma.h>

    uart4: uart@49022000 {
        compatible = "arm,pl011";
        dmas = <&evtrtr0 ALIF_DMA_ENCODE(0, 2, 1) 5>,   /* TX: ch=0, group=2, hs=on, periph=5 */
               <&evtrtr0 ALIF_DMA_ENCODE(1, 3, 1) 6>;   /* RX: ch=1, group=3, hs=on, periph=6 */
        dma-names = "tx", "rx";
    };

compatible: "alif,event-router"

include: base.yaml

properties:
  reg:
    required: true
    description: Event router register base address and size

  dma-controller:
    type: phandle
    required: true
    description: Phandle to the associated DMA controller

  channels:
    type: int
    required: true
    description: Number of event router channels (typically 32)

  dma-groups:
    type: int
    required: true
    description: |
      Number of DMA groups (peripheral input sources) per channel.
      Each channel can multiplex from this many peripheral inputs.

      Current hardware supports up to 4 groups (dma-groups = 4, valid values 0-3).
      The encoding reserves 4 bits (0-15) for future hardware expansion.

      Valid dma-group values in DMA specifier: 0 to (dma-groups - 1)

  "#dma-cells":
    type: int
    const: 2
    description: |
      Number of items to expect in a DMA specifier.
      This binding uses a two-cell format for Alif Event Router:
        Cell 0 (channel): Encoded value [reserved(19)][handshake(1)][dma_group(4)][channel(8)]
        Cell 1 (periph): Peripheral request number
      Use ALIF_DMA_ENCODE(channel, dma_group, handshake) macro to encode cell 0.

dma-cells:
  - channel
  - periph
```

## dts/bindings/dma/arm,dma-pl330.yaml
```yaml
# Copyright 2020 Broadcom
# SPDX-License-Identifier: Apache-2.0

description: |
  PL330 DMA Controller

  A phandle to the DMA controller plus "channel" integer cell specifying
  channel to be used for data transfer

  Example for pl330 DMA Controller
     pl330: pl330@48300000 {
                  compatible = "arm,dma-pl330";
                  ...
                  dma-channels = <8>;
                  #dma-cells = <1>;
            };

  Example using Interrupt
  The interrupt name should be used along with the interrupts.
  The driver fetches the enabled channels using the interrupt-names

    pl330: pl330@48300000 {
                compatible = "arm,dma-pl330";
                  ...
                interrupts = <0 3>, <1 3>, <32 3>;
                interrupt-names = "channel0", "channel1", "abort";
           };

  If PCIe EP client uses channel 0 for Tx DMA and channel 1 for Rx DMA
     pcie0_ep: pcie@4e100000 {
                  compatible = "brcm,iproc-pcie-ep";
                  ...
                  dmas = <&pl330 0>, <&pl330 1>;
                  dma-names = "txdma", "rxdma";
            };
compatible: "arm,dma-pl330"

include: dma-controller.yaml

properties:
  reg:
    required: true
  microcode:
    type: array
    description: microcode's physical memory address
  interrupts:
    description: optional
  "#dma-cells":
    const: 1

# Parameter syntax
dma-cells:
  - channel
```

## dts/bindings/ethernet/alif,ethernet.yaml
```yaml
# Copyright (C) 2025 Alif Semiconductor
# SPDX-License-Identifier: Apache-2.0

description: alif ethernet

compatible: "alif,ethernet"

include: [ethernet-controller.yaml, pinctrl-device.yaml]

properties:
  reg:
    required: true
  interrupts:
    required: true
  pinctrl-0:
    required: true
  pinctrl-names:
    required: true
  clocks:
    required: true
  local-mac-address:
    required: true
```

## dts/bindings/ethernet/realtek-rtl8201fr.yaml
```yaml
# Copyright (C) 2025 Alif Semiconductor
# SPDX-License-Identifier: Apache-2.0

description: Realtek(RTL8201FR) Ethernet PHY device

compatible: "realtek,rtl8201fr"

include: ethernet-phy.yaml

properties:
  phy_mode:
    type: string

    description: Select the PHY mode
    enum:
      - "PHY_AUTO_NEGOTIATE"
      - "PHY_FULL_DUPLEX"
      - "PHY_HALF_DUPLEX"

  phy_speed:
    type: string
    default: "PHY_SPEED_100M"
    description: Select the PHY speed
    enum:
      - "PHY_SPEED_10M"
      - "PHY_SPEED_100M"
```

## dts/bindings/flash_controller/alif,mram-flash-controller.yaml
```yaml
# Copyright (c) 2025 Alif Semiconductor
#
# SPDX-License-Identifier: Apache-2.0
description: Alif SoC MRAM flash controller

compatible: "alif,mram-flash-controller"

include: flash-controller.yaml
```

## dts/bindings/flash_controller/issi,xspi-flash-controller.yaml
```yaml
# Copyright (C) 2024 Alif Semiconductor.
# SPDX-License-Identifier: Apache-2.0

description: ISSI xSPI Flash controller

compatible: "issi,xspi-flash-controller"

include: flash-controller.yaml

#on-bus: ospi

properties:
  cs-gpios:
    type: phandle-array
    required: false
    description: Chip select GPIO

  erase-value:
    type: int
    description: block size to write
    required: true
    default: 256

  num-of-sector:
    type: int
    description: available sectors in the connected NOR Flash
    required: true

  page-size:
    type: int
    description: Page Size
    required: true

  sector-size:
    type: int
    description: number of bytes in each sector
    required: true

  write-block-size:
    type: int
    description: number of bytes in each sector
    required: true
```

## dts/bindings/gpio/snps,designware-gpio.yaml
```yaml
# Copyright (c) 2018 Synopsys, Inc. All rights reserved.
# SPDX-License-Identifier: Apache-2.0

description: Synopsys DesignWare GPIO node

compatible: "snps,designware-gpio"

include: [gpio-controller.yaml, pinctrl-device.yaml, base.yaml]

properties:
  reg:
    required: true

  "#gpio-cells":
    const: 2

  vbat-resume:
    type: boolean
    description: Vbat resume support

gpio-cells:
  - pin
  - flags
```

## dts/bindings/i2c/alif,lpi2c.yaml
```yaml
# Copyright (C) 2024 Alif Semiconductor.
# SPDX-License-Identifier: Apache-2.0

description: Alif LP-I2C node

compatible: "alif,lpi2c"

include: [base.yaml, i2c-controller.yaml, pinctrl-device.yaml]

properties:
  interrupts:
    required: true
```

## dts/bindings/i2c/gpio-i2c-mux.yaml
```yaml
# Copyright (C) 2025 Alif Semiconductor
# SPDX-License-Identifier: Apache-2.0

description: GPIO controlled SPDT switch based I2C mux.

compatible: "gpio-i2c-mux"

include: base.yaml

properties:
  "#address-cells":
    required: true
    const: 1
  "#size-cells":
    required: true
    const: 0

  ctrl-gpios:
    type: phandle-array
    required: true
    description: |
      The GPIO used to control the I2C Multiplexer.

  i2c-inst:
    type: phandle
    required: true
    description: I2C controller node to send commands through.

child-binding:
  compatible: "gpio-i2c-mux-channel"
  include: [i2c-controller.yaml]
```

## dts/bindings/i3c/snps,designware-i3c.yaml
```yaml
# Copyright (C) 2020 Samsung Electronics Co., Ltd.
# Copyright (C) 2023 Meta Platforms
# Copyright (C) 2025 Alif Semiconductor
# SPDX-License-Identifier: Apache-2.0

description: >
    This is a binding for the Synopsys I3C interface

compatible: "snps,designware-i3c"

include: [i3c-controller.yaml, pinctrl-device.yaml]

properties:
  clocks:
    required: true

  od-thigh-max-ns:
    type: int
    default: 41
    description: |
      Maximum high clock pulse length (ns) in Open-Drain mode.
      The default is value from Section 6.2 of the I3C
      Specifiction.

  od-tlow-min-ns:
    type: int
    default: 200
    description: |
      Minimum low clock pulse length (ns) in Open-Drain mode.
      The default is value from Section 6.2 of the I3C
      Specifiction.
  target-mode:
    type: boolean
    description:
      To act as target device
```

## dts/bindings/ieee802154/alif,ahi-ieee802154.yml
```yaml
# Copyright (c) 2023 Alif Semiconductor
# SPDX-License-Identifier: Apache-2.0

description: Alif IEEE 802.15.4 AHI RF node

compatible: "alif,ahi-ieee802154"

include: base.yaml
```
