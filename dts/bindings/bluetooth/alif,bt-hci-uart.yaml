## dts/bindings/bluetooth/alif,bt-hci-uart.yaml
```yaml
# Copyright (c) 2025 Alif Semiconductor
# SPDX-License-Identifier: Apache-2.0

description: Bluetooth HCI for Alif Balletto B1

compatible: "alif,bt-hci-uart"

include: bt-hci.yaml

properties:
  bt-hci-name:
    default: "BT Alif"
  bt-hci-bus:
    default: "uart"
```

## dts/bindings/can/cast,can.yaml
```yaml
# Copyright (C) 2024 Alif Semiconductor
# SPDX-License-Identifier: Apache-2.0

description: Cast CAN

include: [base.yaml, pinctrl-device.yaml]

compatible: "cast,can"

properties:
  reg:
    required: true

  reg-names:
    required: true

  interrupt-parent:
    required: true

  interrupts:
    required: true

  interrupt-names:
    required: true

  clocks:
    required: true
    description: Includes Clock Controller module

  clk-speed:
    type: int
    required: true
    description:  Input clock speed of CAN controller
```

## dts/bindings/clock/alif,axi-clk.yaml
```yaml
# Copyright (c) 2025 Alif Semiconductor
#
# SPDX-License-Identifier: Apache-2.0

description: |
    ALIF Semiconductor AXI clock configuration.

compatible: "alif,axi-clk"

include: [base.yaml]

properties:
  clock-frequency:
    required: true
    type: int
    description: AXI_CLK frequency
```

## dts/bindings/clock/alif,clock.yaml
```yaml
# Copyright (c) 2025 Alif Semiconductor
#
# SPDX-License-Identifier: Apache-2.0

description: |
    ALIF Semiconductor generic clock provider

compatible: "alif,clock"

include: [base.yaml]

properties:
  clock-frequency:
    type: int
    description: clock frequency Hz
```

## dts/bindings/clock/alif,clockctrl.yaml
```yaml
# Copyright (c) 2025 Alif Semiconductor
#
# SPDX-License-Identifier: Apache-2.0

description: |
  ALIF Semiconductor clock control unit.

  To specify the clocks in a peripheral, the standard clocks property needs
  to be used, e.g.:

    uart0: uart@xxx {
        ...
        /* cell encodes clock module, register offset and bit to configure */
        clocks = < &clock ALIF_UART0_SYST_PCLK >;
        ...
    }

  Predefined clock control cells are available in
  include/zephyr/dts-bindings/clock/alif_clock_control.h header files.

compatible: "alif,clockctrl"

include: [base.yaml, clock-controller.yaml]

properties:
  reg:
    description: register address
    required: true

  reg-names:
    required: true
    description: Name of each register space

  "#clock-cells":
    const: 1

clock-cells:
  - clkid
```

## dts/bindings/clock/alif,pll-clk.yaml
```yaml
# Copyright (c) 2025 Alif Semiconductor
#
# SPDX-License-Identifier: Apache-2.0

description: |
    ALIF Semiconductor PLL clock configuration.

compatible: "alif,pll-clk"

include: [base.yaml]

properties:
  clock-frequency:
    required: true
    type: int
    description: PLL_CLK1 frequency
```

## dts/bindings/comparator/alif,cmp.yaml
```yaml
# Copyright (c) 2025 Alif Semiconductor
# SPDX-License-Identifier: Apache-2.0

description: Alif Comparator

compatible: "alif,cmp"
include: [base.yaml, pinctrl-device.yaml]

properties:
  reg:
    required: true

  driver_instance:
    type: string
    required: true
    description: Selects the comparator hardware instance
    enum:
      - "CMP_INSTANCE_LP"
      - "CMP_INSTANCE_0"
      - "CMP_INSTANCE_1"
      - "CMP_INSTANCE_2"
      - "CMP_INSTANCE_3"

  positive_input:
    type: string
    required: true
    description: select input to the positive terminal of comparator
    enum:
      - "CMP_POS_IN0"
      - "CMP_POS_IN1"
      - "CMP_POS_IN2"
      - "CMP_POS_IN3"

  polarity_en:
    type: boolean
    description: This inverts the comparator results

  prescaler:
    type: int
    description: This register sets the clocking rate for filtering

  filter_taps:
    type: int
    description: set the filter taps

  negative_input:
    type: string
    required: true
    description: select input to the negative terminal of comparator
    enum:
      - "CMP_NEG_IN0"
      - "CMP_NEG_IN1"
      - "CMP_NEG_IN2"
      - "CMP_NEG_IN3"

  cmp-gpios:
    type: phandle-array
    description: |
      An array of chip select GPIOs to use. Each element
      in the array specifies a GPIO. The index in the array
      corresponds to the child node that the CS gpio controls.


  hysteresis_level:
    type: string
    required: true
    description: Select comparator hysteresis level, step size is 6mV
    enum:
      - "0mV"
      - "6mV"
      - "12mV"
      - "18mV"
      - "24mV"
      - "30mV"
      - "36mV"
      - "42mV"
```

## dts/bindings/counter/alif,utimer-counter.yaml
```yaml
# Copyright (c) 2025 Alif Semiconductor
#
# SPDX-License-Identifier: Apache-2.0

description: Alif UTIMER in counter mode

compatible: "alif,utimer-counter"

include: base.yaml
```

## dts/bindings/counter/snps,dw-apb-rtc.yaml
```yaml
# Copyright (c) 2023 Alif Semiconductor.
# SPDX-License-Identifier: Apache-2.0

description: Synopsys DesignWare RTC counter node

compatible: "snps,dw-apb-rtc"

include: base.yaml

properties:
  reg:
    required: true

  interrupts:
    required: true

  wrap-enable:
    type: boolean
    description: Wrap mode enable disable

  prescaler:
    type: int
    description: prescaler load value

  load-value:
    type: int
    description: counter load value

  clock-frequency:
    type: int
    description: counter clock frequency
```

## dts/bindings/crc/alif,alif-crc.yaml
```yaml
# Copyright (c) 2024, Alif Semiconductor
# SPDX-License-Identifier: Apache-2.0

description: Alif Cyclic Redundancy Check

compatible: "alif,alif-crc"
include: [base.yaml]

properties:
  reg:
    required: true

  crc-algo:
    type: string
    required: true
    description: Select CRC algorithm
    enum:
      - "crc8-ccitt"
      - "crc16"
      - "crc16-ccitt"
      - "crc32"
      - "crc32c"
```

## dts/bindings/dac/alif,alif_dac.yaml
```yaml
# Copyright (C) 2025 Alif Semiconductor
# SPDX-License-Identifier: Apache-2.0

description: Alif DAC controller

compatible: "alif,dac"

include: [base.yaml, pinctrl-device.yaml]

properties:
  reg:
    required: true

  twoscomp_enabled:
    type: boolean
    description: Enables conversion from two's complement signed input to
                 unsigned binary.

  bypass_enabled:
    type: boolean
    description: Enables DAC input bypass mode.

  bypass_val:
    type: int
    description: Value to be used when DAC bypass mode is enabled(0-0xFFF)

  output_current:
    type: string
    required: true
    description: Selects the DAC output current trim value.
    enum:
      -  "DAC_0UA_OUT_CUR"
      -  "DAC_100UA_OUT_CUR"
      -  "DAC_200UA_OUT_CUR"
      -  "DAC_300UA_OUT_CUR"
      -  "DAC_400UA_OUT_CUR"
      -  "DAC_500UA_OUT_CUR"
      -  "DAC_600UA_OUT_CUR"
      -  "DAC_700UA_OUT_CUR"
      -  "DAC_800UA_OUT_CUR"
      -  "DAC_900UA_OUT_CUR"
      -  "DAC_1000UA_OUT_CUR"
      -  "DAC_1100UA_OUT_CUR"
      -  "DAC_1200UA_OUT_CUR"
      -  "DAC_1300UA_OUT_CUR"
      -  "DAC_1400UA_OUT_CUR"
      -  "DAC_1500UA_OUT_CUR"

  capacitance:
    type: string
    required: true
    description: Selects DAC high-performance mode capacitance trim value.
    enum:
      -  "DAC_2PF_CAPACITANCE"
      -  "DAC_4PF_CAPACITANCE"
      -  "DAC_6PF_CAPACITANCE"
      -  "DAC_8PF_CAPACITANCE"
```

## dts/bindings/display/focuslcd,mw405.yaml
```yaml
# Copyright (C) 2024 Alif Semiconductor
# SPDX-License-Identifier: Apache-2.0

description: Focus-LCD E43GB-I-MW405-C Panel

compatible: "focuslcd,mw405"

include: [mipi-dsi-device.yaml, display-controller.yaml]

properties:
  reset-gpios:
    type: phandle-array
    description: |
      The RESETn pin is asserted to disable the sensor causing a hard reset.
      The sensor receives this as an active-low signal.

  bl-gpios:
    type: phandle-array
    description: |
      The BLn pin is asserted to control the backlight of the panel. The sensor
      receives this as an active-high signal.

  video-mode:
    type: string
    required: false
    enum:
      - "burst"
      - "nb-sync-pulse"
      - "nb-sync-events"
    description: |
      This property specifies whether the panel works in burst mode or
      non-burst mode.

  command-tx-mode:
    type: string
    required: false
    enum:
      - "low-power"
      - "high-speed"
    description: |
      This property specifies whether the DSI commands transmission is
      supported in Low-Power or High-Speed mode.
```

## dts/bindings/display/ilitek,ili9488-dsi.yaml
```yaml
# Copyright (c) 2024, Alif Semiconductor
# SPDX-License-Identifier: Apache-2.0

description: ILI9488 320x480 display controller accessed via DSI Interface

compatible: "ilitek,ili9488"

include: ["mipi-dsi-device.yaml", "ilitek,ili9xxx-common.yaml"]

properties:
  frmctr1:
    type: uint8-array
    default: [0xb0, 0x11]
    description:
      Frame rate control (in normal mode / full colors) (FRMCTR1) register value.

  disctrl:
    type: uint8-array
    default: [0x02, 0x02, 0x3b]
    description:
      Display function control (DISCTRL) register value. Note that changing
      default SS bit value (0) may interfere with display rotation.

  pwctrl1:
    type: uint8-array
    default: [0x0e, 0x0e]
    description:
      Power control 1 (PWCTRL1) register values.

  pwctrl2:
    type: uint8-array
    default: [0x43]
    description:
      Power control 2 (PWCTRL2) register values.

  vmctrl:
    type: uint8-array
    default: [0x00, 0x40, 0x00, 0x40]
    description:
      VCOM control (VMCTRL) register values.

  pgamctrl:
    type: uint8-array
    default: [
      0x0f,
      0x1f,
      0x1c,
      0x0b,
      0x0e,
      0x09,
      0x48,
      0x99,
      0x38,
      0x0a,
      0x14,
      0x06,
      0x11,
      0x09,
      0x00
    ]
    description:
      Positive gamma correction (PGAMCTRL) register values.

  ngamctrl:
    type: uint8-array
    default: [
      0x0f,
      0x36,
      0x2e,
      0x09,
      0x0a,
      0x04,
      0x46,
      0x66,
      0x37,
      0x06,
      0x10,
      0x04,
      0x24,
      0x20,
      0x00
    ]
    description:
      Negative gamma correction (NGAMCTRL) register values.

  reset-gpios:
    type: phandle-array
    description: |
      The RESETn pin is asserted to disable the sensor causing a hard reset.
      The sensor receives this as an active-low signal.

  bl-gpios:
    type: phandle-array
    description: |
      The BLn pin is asserted to control the backlight of the panel. The sensor
      receives this as an active-high signal.

  video-mode:
    type: string
    required: false
    enum:
      - "burst"
      - "nb-sync-pulse"
      - "nb-sync-events"
    description: |
      This property specifies whether the panel works in burst mode or
      non-burst mode.

  command-tx-mode:
    type: string
    required: false
    enum:
      - "low-power"
      - "high-speed"
    description: |
      This property specifies whether the DSI commands transmission is
      supported in Low-Power or High-Speed mode.
```

## dts/bindings/display/tes,cdc-2.1.yaml
```yaml
# Copyright (C) 2024 Alif Semiconductor
# SPDX-License-Identifier: Apache-2.0

description: TES CDC200 controller

compatible: "tes,cdc-2.1"

include: [display-controller.yaml, pinctrl-device.yaml]

properties:
  reg:
    required: true

  interrupts:
    required: true

  interrupt-names:
    required: true

  hfront-porch:
    type: int
    required: true
    description: Horizontal front porch in display clock cycles

  hback-porch:
    type: int
    required: true
    description: Horizontal back porch in display clock cycles

  hsync-len:
    type: int
    required: true
    description: HSYNC pulse width in display clock cycles

  vfront-porch:
    type: int
    required: true
    description: Vertical front porch in display clock cycles

  vback-porch:
    type: int
    required: true
    description: Vertical back porch in display clock cycles

  vsync-len:
    type: int
    required: true
    description: VSYNC pulse width in display clock cycles

  hsync-active:
    type: int
    required: true
    description:
      Horizontal synchronization pulse polarity.
      If HSYNC is active low, use 0,
      otherwise use 1.

  vsync-active:
    type: int
    required: true
    description:
      Vertical synchronization pulse polarity.
      If VSYNC is active low, use 0,
      otherwise use 1.

  de-active:
    type: int
    required: true
    description:
      Data Enable pulse polarity.
      If DE is active low, use 0,
      otherwise use 1.

  pixelclk-active:
    type: int
    required: true
    description:
      Pixel Clock pulse polarity.
      If PCLK is active low, use 0,
      otherwise use 1.

  enable-l1:
    type: int
    required: false
    default: 0
    description:
      Enablement status of layer 1.
    enum:
      - 0
      - 1

  enable-l2:
    type: int
    required: false
    default: 0
    description:
      Enablement status of layer 2.
    enum:
      - 0
      - 1

  pixel-fmt-l1:
    type: string
    required: false
    description: Pixel format for Layer 1.
    enum:
      - "argb-8888"
      - "rgb-888"
      - "rgb-565"
      - "rgba-8888"
      - "al-44"
      - "l-8"
      - "argb-1555"
      - "argb-4444"
      - "undefined"

  pixel-fmt-l2:
    type: string
    required: false
    description: Pixel format for Layer 2.
    enum:
      - "argb-8888"
      - "rgb-888"
      - "rgb-565"
      - "rgba-8888"
      - "al-44"
      - "l-8"
      - "argb-1555"
      - "argb-4444"
      - "undefined"

  def-back-color-l1:
    type: int
    required: false
    description: Default display background color - layer 1.

  def-back-color-l2:
    type: int
    required: false
    description: Default display background color - layer 2.

  bg-color:
    type: int
    required: false
    default: 0xffffff
    description: Default display Background layer color.

  win-x0-l1:
    type: int
    required: false
    default: 0
    description: Window X0 for Layer 1.

  win-y0-l1:
    type: int
    required: false
    default: 0
    description: Window Y0 for Layer 1.

  win-x1-l1:
    type: int
    description: Window X1 for Layer 1.

  win-y1-l1:
    type: int
    description: Window Y1 for Layer 1.

  win-x0-l2:
    type: int
    required: false
    default: 0
    description: Window X0 for Layer 2.

  win-y0-l2:
    type: int
    required: false
    default: 0
    description: Window Y0 for Layer 2.

  win-x1-l2:
    type: int
    description: Window X1 for Layer 2.

  win-y1-l2:
    type: int
    description: Window Y1 for Layer 2.

  blend-factor1-l1:
    type: int
    required: false
    default: 4
    description: Blend factor 1 for current layer color to be used for blending algorithm for layer 1.
    enum:
      - 4
      - 6

  blend-factor2-l1:
    type: int
    required: false
    default: 5
    description: Blend factor 2 for subjacent layer color to be used for blending algorithm for layer 1.
    enum:
      - 5
      - 7

  blend-factor1-l2:
    type: int
    required: false
    default: 6
    description: Blend factor 1 for current layer color to be used for blending algorithm for layer 2.
    enum:
      - 4
      - 6

  blend-factor2-l2:
    type: int
    required: false
    default: 7
    description: Blend factor 2 for subjacent layer color to be used for blending algorithm for layer 2.
    enum:
      - 5
      - 7

  const-alpha-l1:
    type: int
    required: false
    default: 0xff
    description: Constant alpha to be used for layer 1.

  const-alpha-l2:
    type: int
    required: false
    default: 0xff
    description: Constant alpha to be used for layer 2.

  clock-frequency:
    type: int
    description: |
      Pixel clock for display controller in Hz. Must be at least as large as:
      (height + vsync-len + vfront-porch + vback-porch) *
      (width + hsync-len + hfront-porch + hback-porch) *
      desired frame rate
```
