## soc/alif/ensemble/common/Kconfig
```kconfig
# Copyright (c) 2025 Alif Semiconductor
#
# SPDX-License-Identifier: Apache-2.0

config RTSS_HE
	bool "RTSS_HE core"
	help
	  Enable RTSS_HE core.

config RTSS_HP
	bool "RTSS_HP core"
	help
	  Enable RTSS_HP core.

config APSS
	bool "APSS core"
	help
	  Enable APSS core.

config ALIF_HWSEM_INIT_PRIORITY
	int "HWSEM Init priority"
	depends on ALIF_HWSEM
	default 50
	help
	  Hardware Semaphore driver initialization priority.

config SOC_SUPPORT_ARM_MHUV2
	bool "SoC support communication through Arm MHUv2"
	depends on SOC_FAMILY_ENSEMBLE
	select IPM
	select ARM_MHUV2
	help
	  SoC support communication through Arm MHUv2	  

config USE_ALIF_HAL_UTIMER
	bool "UTIMER ll driver access"
	default n
	help
	  Enables UTIMER LL driver on Alif SoCs.

config USE_ALIF_HAL_ANALOG
	bool "Enable Alif HAL Analog support"
	default n
	help
	  Enables access to Alif HAL analog layer(ADC, DAC, CMP)

config SPI_DW_ENABLE
	bool "SPI DW"
	default y
	depends on SPI
	help
	  Enable Designware SPI driver.
	select SPI_DW

if RTSS_HP && !USE_DT_CODE_PARTITION
config FLASH_LOAD_OFFSET
	default 0x200000
endif # RTSS_HP && !USE_DT_CODE_PARTITION

config ROM_START_OFFSET
	default 0x800 if BOOTLOADER_MCUBOOT

if COUNTER_SNPS_DW
config LPTIMER0_OUTPUT_TOGGLE
	bool "LPTimer0 Output Toggle"
	help
	  Enable lptimer 0 output toggle.

config LPTIMER0_EXT_CLK_FREQ
	int "LPTimer0 External clock source Frequency value"
	default 0
	help
	  Provide lptimer 0 clock frequency for external clock source.

config LPTIMER1_OUTPUT_TOGGLE
	bool "LPTimer1 Output Toggle"
	help
	  Enable lptimer 1 output toggle.

config LPTIMER1_EXT_CLK_FREQ
	int "LPTimer1 External clock source Frequency value"
	default 0
	help
	  Provide lptimer 1 clock frequency for external clock source.

config LPTIMER2_OUTPUT_TOGGLE
	bool "LPTimer2 Output Toggle"
	help
	  Enable lptimer 2 output toggle.

config LPTIMER2_EXT_CLK_FREQ
	int "LPTimer2 External clock source Frequency value"
	default 0
	help
	  Provide lptimer 2 clock frequency for external clock source.

config LPTIMER3_OUTPUT_TOGGLE
	bool "LPTimer3 Output Toggle"
	help
	  Enable lptimer 3 output toggle.

config LPTIMER3_EXT_CLK_FREQ
	int "LPTimer3 External clock source Frequency value"
	default 0
	help
	  Provide lptimer 3 clock frequency for external clock source.
endif # COUNTER_SNPS_DW
```

## soc/alif/ensemble/e1c/Kconfig
```kconfig
# Copyright (c) 2026 Alif Semiconductor
#
# SPDX-License-Identifier: Apache-2.0

config SOC_AE1C1F4051920HH0_RTSS_HE
	select RTSS_HE

config SOC_AE1C1F4051920PH0_RTSS_HE
	select RTSS_HE

config SOC_AE1C1F40519205H0_RTSS_HE
	select RTSS_HE

config SOC_AE1C1F1041010HH0_RTSS_HE
	select RTSS_HE

config SOC_AE1C1F1041010PH0_RTSS_HE
	select RTSS_HE

config SOC_AE1C1F10410105H0_RTSS_HE
	select RTSS_HE
```

## soc/alif/ensemble/e1c/Kconfig.defconfig.ae1c1f1041010ph0_rtss_he
```kconfig
# Copyright (c) 2025 Alif Semiconductor
#
# SPDX-License-Identifier: Apache-2.0

if SOC_AE1C1F1041010PH0_RTSS_HE

config NUM_IRQS
	default 480

config SYS_CLOCK_HW_CYCLES_PER_SEC
	default 160000000

endif # SOC_AE1C1F1041010PH0_RTSS_HE
```

## soc/alif/ensemble/e1c/Kconfig.defconfig.ae1c1f4051920hh0_rtss_he
```kconfig
# Copyright (c) 2026 Alif Semiconductor
#
# SPDX-License-Identifier: Apache-2.0

if SOC_AE1C1F4051920HH0_RTSS_HE

config NUM_IRQS
	default 480

config SYS_CLOCK_HW_CYCLES_PER_SEC
	default 160000000

endif # SOC_AE1C1F4051920HH0_RTSS_HE
```

## soc/alif/ensemble/e1c/Kconfig.soc
```kconfig
# Copyright (c) 2025 Alif Semiconductor
#
# SPDX-License-Identifier: Apache-2.0

config SOC_SERIES_E1C
	bool
	select SOC_FAMILY_ENSEMBLE

config SOC_SERIES
	default "e1c" if SOC_SERIES_E1C

config SOC_AE1C1F4051920HH
	bool
	select SOC_SERIES_E1C
	help
	  Alif Ensemble E1C

config SOC_AE1C1F4051920HH_RTSS_HE
	bool
	select SOC_AE1C1F4051920HH

config SOC
	default "ae1c1f4051920hh" if SOC_AE1C1F4051920HH
```

## soc/alif/ensemble/e3/Kconfig
```kconfig
# Copyright (c) 2025 Alif Semiconductor
#
# SPDX-License-Identifier: Apache-2.0

config SOC_AE302F80F55D5XX_RTSS_HE
	select RTSS_HE

config SOC_AE302F80F55D5XX_RTSS_HP
	select RTSS_HP
```

## soc/alif/ensemble/e3/Kconfig.defconfig.ae302f40c1537xxx_rtss_he
```kconfig
# Copyright (c) 2026 Alif Semiconductor
#
# SPDX-License-Identifier: Apache-2.0

if SOC_AE302F40C1537XXX_RTSS_HE

config NUM_IRQS
	default 480

config SYS_CLOCK_HW_CYCLES_PER_SEC
	default 160000000

endif #SOC_AE302F40C1537XXX_RTSS_HE
```

## soc/alif/ensemble/e3/Kconfig.defconfig.ae302f40c1537xxx_rtss_hp
```kconfig
# Copyright (c) 2026 Alif Semiconductor
#
# SPDX-License-Identifier: Apache-2.0

if SOC_AE302F40C1537XXX_RTSS_HP

config NUM_IRQS
	default 480

config SYS_CLOCK_HW_CYCLES_PER_SEC
	default 400000000

endif #SOC_AE302F40C1537XXX_RTSS_HP
```

## soc/alif/ensemble/e3/Kconfig.defconfig.ae302f80f55d5xx_rtss_hp
```kconfig
# Copyright (c) 2025 Alif Semiconductor
#
# SPDX-License-Identifier: Apache-2.0

if SOC_AE302F80F55D5XX_RTSS_HP

config NUM_IRQS
	default 480

config SYS_CLOCK_HW_CYCLES_PER_SEC
	default 400000000

endif #SOC_AE302F80F55D5XX_RTSS_HP
```

## soc/alif/ensemble/e3/Kconfig.soc
```kconfig
# Copyright (c) 2025 Alif Semiconductor
#
# SPDX-License-Identifier: Apache-2.0

config SOC_SERIES_E3
	bool
	select SOC_FAMILY_ENSEMBLE

config SOC_SERIES
	default "e3" if SOC_SERIES_E3

config SOC_AE302F80F55D5XX
	bool
	select SOC_SERIES_E3
	help
	  Alif Ensemble E3

config SOC_AE302F80F55D5XX_RTSS_HE
	bool
	select SOC_AE302F80F55D5XX

config SOC_AE302F80F55D5XX_RTSS_HP
	bool
	select SOC_AE302F80F55D5XX

config SOC
	default "ae302f80f55d5xx" if SOC_AE302F80F55D5XX
```

## soc/alif/ensemble/e4/Kconfig.soc
```kconfig
# Copyright (c) 2025 Alif Semiconductor
#
# SPDX-License-Identifier: Apache-2.0

config SOC_SERIES_E4
	bool
	select SOC_FAMILY_ENSEMBLE

config SOC_SERIES
	default "e4" if SOC_SERIES_E4

config SOC_AE402FA0E5597XX0
	bool
	select SOC_SERIES_E4
	help
	  Alif Ensemble E4

config SOC_AE402FA0E5597XX0_RTSS_HE
	bool
	select SOC_AE402FA0E5597XX0

config SOC_AE402FA0E5597XX0_RTSS_HP
	bool
	select SOC_AE402FA0E5597XX0

config SOC
	default "ae402fa0e5597xx0" if SOC_AE402FA0E5597XX0
```

## soc/alif/ensemble/e5/Kconfig.defconfig
```kconfig
# Copyright (c) 2026 Alif Semiconductor
#
# SPDX-License-Identifier: Apache-2.0

if SOC_SERIES_E5
rsource "Kconfig.defconfig.*"
endif # SOC_SERIES_E5
```

## soc/alif/ensemble/e5/Kconfig.defconfig.ae512f80f55d5xx_rtss_he
```kconfig
# Copyright (c) 2026 Alif Semiconductor
#
# SPDX-License-Identifier: Apache-2.0

if SOC_AE512F80F55D5XX_RTSS_HE

config NUM_IRQS
	default 480

config SYS_CLOCK_HW_CYCLES_PER_SEC
	default 160000000

endif #SOC_AE512F80F55D5XX_RTSS_HE
```

## soc/alif/ensemble/e5/Kconfig.soc
```kconfig
# Copyright (c) 2026 Alif Semiconductor
#
# SPDX-License-Identifier: Apache-2.0

config SOC_SERIES_E5
	bool
	select SOC_FAMILY_ENSEMBLE

config SOC_SERIES
	default "e5" if SOC_SERIES_E5

config SOC_AE512F80F55D5XX
	bool
	select SOC_SERIES_E5
	help
	  Alif Ensemble E5

config SOC_AE512F80F55D5XX_RTSS_HE
	bool
	select SOC_AE512F80F55D5XX

config SOC_AE512F80F55D5XX_RTSS_HP
	bool
	select SOC_AE512F80F55D5XX

config SOC
	default "ae512f80f55d5xx" if SOC_AE512F80F55D5XX
```

## soc/alif/ensemble/e7/Kconfig
```kconfig
# Copyright (c) 2025 Alif Semiconductor
#
# SPDX-License-Identifier: Apache-2.0

config SOC_AE722F80F55D5XX_M55_HE
	select RTSS_HE

config SOC_AE722F80F55D5XX_M55_HP
	select RTSS_HP
```

## soc/alif/ensemble/e7/Kconfig.defconfig
```kconfig
# Copyright (c) 2025 Alif Semiconductor
#
# SPDX-License-Identifier: Apache-2.0

if SOC_SERIES_E7
rsource "Kconfig.defconfig.*"
endif # SOC_SERIES_E7
```

## soc/alif/ensemble/e7/Kconfig.defconfig.ae722f80f55d5xx_apss
```kconfig
# Copyright (c) 2025 Alif Semiconductor
#
# SPDX-License-Identifier: Apache-2.0

if SOC_AE722F80F55D5XX_APSS

config NUM_IRQS
	default 480

endif #SOC_AE722F80F55D5XX_APSS
```

## soc/alif/ensemble/e7/Kconfig.defconfig.ae722f80f55d5xx_m55_he
```kconfig
# Copyright (c) 2025 Alif Semiconductor
#
# SPDX-License-Identifier: Apache-2.0

if SOC_AE722F80F55D5XX_M55_HE

config NUM_IRQS
	default 480

config SYS_CLOCK_HW_CYCLES_PER_SEC
	default 160000000

endif #SOC_AE722F80F55D5XX_M55_HE
```

## soc/alif/ensemble/e7/Kconfig.soc
```kconfig
# Copyright (c) 2025 Alif Semiconductor
#
# SPDX-License-Identifier: Apache-2.0

config SOC_SERIES_E7
	bool
	select SOC_FAMILY_ENSEMBLE

config SOC_SERIES
	default "e7" if SOC_SERIES_E7

config SOC_AE722F80F55D5XX
	bool
	select SOC_SERIES_E7
	help
	  Alif Ensemble E7

config SOC_AE722F80F55D5XX_RTSS_HE
	bool
	select SOC_AE722F80F55D5XX

config SOC_AE722F80F55D5XX_RTSS_HP
	bool
	select SOC_AE722F80F55D5XX

config SOC
	default "ae722f80f55d5xx" if SOC_AE722F80F55D5XX
```

## soc/alif/ensemble/e8/Kconfig
```kconfig
# Copyright (c) 2025 Alif Semiconductor
#
# SPDX-License-Identifier: Apache-2.0

config SOC_SERIES_E8
		select ENSEMBLE_GEN2

config SOC_AE822FA0E5597XX0_RTSS_HE
		select RTSS_HE

config SOC_AE822FA0E5597XX0_RTSS_HP
		select RTSS_HP

config SOC_AE822FA0E5597XX0_APSS
		select APSS

config ANALOG_ALIASING
	bool "Enable Analog Aliasing"
	help
	  Enable the analog aliasing feature for peripherals.
```

## soc/alif/ensemble/e8/Kconfig.defconfig.ae822fa0e5597xx0_apss
```kconfig
# Copyright (c) 2025 Alif Semiconductor
#
# SPDX-License-Identifier: Apache-2.0

if SOC_AE822FA0E5597XX0_APSS

config NUM_IRQS
	default 480

endif # SOC_AE822FA0E5597XX0_APSS
```

## soc/alif/ensemble/e8/Kconfig.soc
```kconfig
# Copyright (c) 2025 Alif Semiconductor
#
# SPDX-License-Identifier: Apache-2.0

config SOC_SERIES_E8
	bool
	select SOC_FAMILY_ENSEMBLE

config SOC_SERIES
	default "e8" if SOC_SERIES_E8

config SOC_AE822FA0E5597XX0
	bool
	select SOC_SERIES_E8
	help
	  Alif Ensemble E8

config SOC_AE822FA0E5597XX0_RTSS_HE
	bool
	select SOC_AE822FA0E5597XX0

config SOC_AE822FA0E5597XX0_RTSS_HP
	bool
	select SOC_AE822FA0E5597XX0

config SOC
	default "ae822fa0e5597xx0" if SOC_AE822FA0E5597XX0
```

## soc/arm/alif_balletto/b1/Kconfig.defconfig.b1_dk_rtss_he_a5
```kconfig
# Copyright (c) 2024 Alif Semiconductor
#
# SPDX-License-Identifier: Apache-2.0

if SOC_B1_DK_RTSS_HE_A5

config SOC
	default "Balletto"

config NUM_IRQS
	default 480

config SYS_CLOCK_HW_CYCLES_PER_SEC
	default 160000000

endif # SOC_B1_DK_RTSS_HE_A5
```

## soc/arm/alif_balletto/b1/Kconfig.defconfig.series
```kconfig
# Copyright (c) 2024 Alif Semiconductor
#
# SPDX-License-Identifier: Apache-2.0

if SOC_SERIES_BALLETTO_B1

config SOC_SERIES
	default "b1"

config ROM_START_OFFSET
	default 0x800 if BOOTLOADER_MCUBOOT

# Disable null pointer exception detection by default for Balletto B1.
# The Ceva Waves BLE ROM patcher dereferences address 0x00000000 (ITCM base)
# when no patch is present (__ble_patch_info_start weak symbol resolves to NULL).
# Enabling MPU-based null pointer detection would trap this access and cause a fault.
choice NULL_POINTER_EXCEPTION_DETECTION
	default NULL_POINTER_EXCEPTION_DETECTION_NONE
endchoice

source "soc/arm/alif_balletto/b1/Kconfig.defconfig.b*"

endif # SOC_SERIES_BALLETTO_B1
```

## soc/arm/alif_balletto/b1/Kconfig.soc
```kconfig
# Copyright (c) 2024 Alif Semiconductor
#
# SPDX-License-Identifier: Apache-2.0

choice
	prompt "Alif Balletto Family Selection"
	depends on SOC_SERIES_BALLETTO_B1

config SOC_B1_DK_RTSS_HE
	bool "SOC_B1_RTSS_HE"
	select RTSS_HE
	select CPU_CORTEX_M55
	select SOC_SERIES_BALLETTO
	select CPU_HAS_ARM_MPU
	select CPU_CORTEX_M_HAS_SYSTICK
	select CPU_HAS_FPU
	select ARMV8_M_DSP
	select ARMV8_1_M_MVEI
	select ARMV8_1_M_MVEF
	select BUILD_NO_GAP_FILL
	select CPU_HAS_ARM_SAU
	select ARM_SECURE_FIRMWARE if DISPLAY
	select HAS_ALIF_BLE_802154_LINK_LAYER
	select HAS_ALIF_BLE_ROM_IMAGE


config SOC_B1_FPGA_RTSS_HE
	bool "SOC_B1_RTSS_HE"
	select RTSS_HE
	select CPU_CORTEX_M55
	select SOC_SERIES_BALLETTO
	select CPU_HAS_ARM_MPU
	select CPU_CORTEX_M_HAS_SYSTICK
	select CPU_HAS_FPU
	select ARMV8_M_DSP
	select ARMV8_1_M_MVEI
	select ARMV8_1_M_MVEF
	select HAS_ALIF_BLE_802154_LINK_LAYER
	select HAS_ALIF_BLE_ROM_IMAGE

endchoice

config SOC_SERIES_BALLETTO
	bool "Alif Balletto Series"

if (PM || POWEROFF)
config PM_RTSS
	bool
	default y if (RTSS_HE)
	help
		Enable Power Management for RTSS cores

endif
```
