## soc/arm/alif_balletto/common/Kconfig.soc
```kconfig
# Copyright (c) 2024 Alif Semiconductor
#
# SPDX-License-Identifier: Apache-2.0

config RTSS_HE
	bool "RTSS_HE core"
	help
	  Enable RTSS_HE core.

config HAS_ALIF_BLE_802154_LINK_LAYER
	bool
	default y
	help
	  Device has BLE and 802154 Link Layers

if HAS_ALIF_BLE_802154_LINK_LAYER
choice ALIF_BLE_802154_LINK_LAYER_VERSION
	prompt "Chooce ROM code version"
	default ALIF_BLE_802154_LINK_LAYER_V1_0

	config ALIF_BLE_802154_LINK_LAYER_V1_0
		bool "ROM code version 1.0"
	config ALIF_BLE_802154_LINK_LAYER_V1_2
		bool "ROM code version 1.2"
endchoice
endif

config HAS_ALIF_BLE_ROM_IMAGE
	bool
	help
	  Device has BLE HOST and LC3 ROM code

if HAS_ALIF_BLE_ROM_IMAGE
choice ALIF_BLE_ROM_IMAGE_VERSION
	prompt "Chooce ROM code version"
	default ALIF_BLE_ROM_IMAGE_V1_0

	config ALIF_BLE_ROM_IMAGE_V1_0
		bool "ROM code version 1.0"
	config ALIF_BLE_ROM_IMAGE_V1_2
		bool "ROM code version 1.2"
endchoice
endif

config HAS_ALIF_SE_SERVICES
	bool
	default y
	help
	  Device has Secure Enclave services

config HAS_ALIF_POWER_MANAGER
	bool
	depends on HAS_ALIF_SE_SERVICES
	default y
	help
	  Device has Alif Power Manager services

config ARM_MHUV2_INIT_PRIORITY
	int "MHUv2 Init priority"
	depends on ARM_MHUV2
	default 40
	help
	  MHUv2 driver initialization priority.

config ALIF_HWSEM_INIT_PRIORITY
	int "HWSEM Init priority"
	depends on ALIF_HWSEM
	default 50
	help
	  Hardware Semaphore driver initialization priority.

config SOC_SUPPORT_ARM_MHUV2
	bool "SoC support communication through Arm MHUv2"
	select IPM
	select ARM_MHUV2
	help
	  SoC support communication through Arm MHUv2

config SPI_DW_ENABLE
	bool "SPI DW"
	default y
	depends on SPI
	help
	  Enable Designware SPI driver.
	select SPI_DW

if COUNTER_SNPS_DW
config LPTIMER0_OUTPUT_TOGGLE
	bool "LPTimer0 Output Toggle"
	help
	  Enable lptimer 0 output toggle.

config LPTIMER0_EXT_CLK_FREQ
	int "LPTimer0 Ext-clock source Frequency value"
	default 0
	help
	  Provide lptimer 0 clock frequency for external clock source.

config LPTIMER1_OUTPUT_TOGGLE
	bool "LPTimer1 Output Toggle"
	help
	  Enable  lptimer 1 output toggle.

config LPTIMER1_EXT_CLK_FREQ
	int "LPTimer1 Ext-clock source Frequency value"
	default 0
	help
	  Provide lptimer 1 clock frequency for external clock source.
endif # COUNTER_SNPS_DW

choice BT_HCI_BUS_TYPE
	default BT_ALIF
endchoice

choice BT_RECV_CONTEXT
	default BT_RECV_BLOCKING
endchoice

# Use HW entropy for seed Xoshiro128 pseudo random generator
choice RNG_GENERATOR_CHOICE
	default XOSHIRO_RANDOM_GENERATOR
endchoice

# Use HW entropy for seed CTR-DRBG
choice CSPRNG_GENERATOR_CHOICE
	default CTR_DRBG_CSPRNG_GENERATOR
endchoice

config FLASH_SIZE
	default $(dt_node_reg_size_int,$(dt_nodelabel_path,itcm),0,K) if !XIP

config FLASH_BASE_ADDRESS
	default $(dt_node_reg_addr_hex,$(dt_nodelabel_path,itcm))     if !XIP

config  NONSECURE0_REGION
	string
	default "NS" if ARM_SECURE_FIRMWARE && $(dt_nodelabel_enabled,ns)
	help
	    Provide config Non-Secure region
```

## soc/arm/alif_ensemble/Kconfig
```kconfig
# Copyright (c) 2024 Alif Semiconductor
#
# SPDX-License-Identifier: Apache-2.0

config SOC_FAMILY_ENSEMBLE
	bool "Alif Ensemble family of SoC"
	select HAS_SEGGER_RTT
	select HAS_ALIF_SE_SERVICES

if SOC_FAMILY_ENSEMBLE

config SOC_FAMILY
	string
	default "alif_ensemble"

source "soc/arm/alif_ensemble/*/Kconfig.soc"
endif # SOC_FAMILY_ENSEMBLE
```

## soc/arm/alif_ensemble/common/Kconfig.soc
```kconfig
# Copyright (c) 2024 Alif Semiconductor
#
# SPDX-License-Identifier: Apache-2.0
config RTSS_HE
	bool "RTSS_HE core"
	help
	  Enable RTSS_HE core.

config RTSS_HP
	bool "RTSS_HP core"
	help
	  Enable RTSS_HP core.

config ALIF_HWSEM_INIT_PRIORITY
	int "HWSEM Init priority"
	depends on ALIF_HWSEM
	default 50
	help
	  Hardware Semaphore driver initialization priority.

config SOC_SUPPORT_ARM_MHUV2
	bool "SoC support communication through Arm MHUv2"
	depends on SOC_FAMILY_ENSEMBLE
	select IPM
	select ARM_MHUV2
	help
	  SoC support communication through Arm MHUv2

config SPI_DW_ENABLE
	bool "SPI DW"
	default y
	depends on SPI
	help
	  Enable Designware SPI driver.
	select SPI_DW

if COUNTER_SNPS_DW
config LPTIMER0_OUTPUT_TOGGLE
	bool "LPTimer0 Output Toggle"
	help
	  Enable lptimer 0 output toggle.

config LPTIMER0_EXT_CLK_FREQ
	int "LPTimer0 Ext-clock source Frequency value"
	default 0
	help
	  Provide lptimer 0 clock frequency for external clock source.

config LPTIMER1_OUTPUT_TOGGLE
	bool "LPTimer1 Output Toggle"
	help
	  Enable  lptimer 1 output toggle.

config LPTIMER1_EXT_CLK_FREQ
	int "LPTimer1 Ext-clock source Frequency value"
	default 0
	help
	  Provide lptimer 1 clock frequency for external clock source.
endif # COUNTER_SNPS_DW

config FLASH_SIZE
	default $(dt_node_reg_size_int,$(dt_nodelabel_path,itcm),0,K)  if !XIP

config FLASH_BASE_ADDRESS
	default $(dt_node_reg_addr_hex,$(dt_nodelabel_path,itcm))      if !XIP

if RTSS_HP && !USE_DT_CODE_PARTITION
config FLASH_LOAD_OFFSET
	default 0x200000
endif

config ROM_START_OFFSET
	default 0x800 if BOOTLOADER_MCUBOOT

config  NONSECURE0_REGION
	string
	default "NON-SECURE0" if $(dt_nodelabel_enabled,ns)
	help
	    Provide config Non-Secure region

config  SRAM0_REGION
	string
	default "SRAM0" if $(dt_nodelabel_enabled,sram0)
	help
	    Provide config SRAM0 region

config  SRAM1_REGION
	string
	default "SRAM1" if $(dt_nodelabel_enabled,sram1)
	help
	    Provide config SRAM1 region

config OSPI0_XIP_REGION
	string
	default "ospi0" if $(dt_nodelabel_enabled,ospi0)
	help
	    Configure OSPI0 XIP memory mapped region name

config OSPI1_XIP_REGION
	string
	default "ospi1" if $(dt_nodelabel_enabled,ospi1)
	help
	    Configure OSPI1 XIP memory mapped region name

config USE_ALIF_HAL_UTIMER
	bool "UTIMER ll driver access"
	default n
	help
	  Enables UTIMER LL driver on Alif SoCs.
```

## soc/arm/alif_ensemble/e1c/Kconfig.soc
```kconfig
# Copyright (c) 2024 Alif Semiconductor
#
# SPDX-License-Identifier: Apache-2.0

choice
	prompt "Alif Ensemble Family Selection"
	depends on SOC_SERIES_ENSEMBLE_E1C

config SOC_E1C_DK_RTSS_HE
	bool "SOC_E1C_RTSS_HE"
	select RTSS_HE
	select CPU_CORTEX_M55
	select CPU_HAS_ARM_MPU
	select CPU_CORTEX_M_HAS_SYSTICK
	select CPU_HAS_FPU
	select ARMV8_M_DSP
	select ARMV8_1_M_MVEI
	select ARMV8_1_M_MVEF
	select BUILD_NO_GAP_FILL
	select CPU_HAS_ARM_SAU
endchoice

config SOC_SERIES_ENSEMBLE
	bool "Alif Ensemble Series"


if (PM || POWEROFF)

config PM_RTSS
	bool
	default y if (RTSS_HE)
	help
		Enable Power Management for RTSS cores

endif
```

## soc/arm/alif_ensemble/e3/Kconfig.series
```kconfig
# Copyright (c) 2024 Alif Semiconductor
#
# SPDX-License-Identifier: Apache-2.0

config SOC_SERIES_ENSEMBLE_E3
	bool "Alif Ensemble E3 MCU Series"
	select ARM
	select SOC_FAMILY_ENSEMBLE
	select BUILD_NO_GAP_FILL
	select BUILTIN_STACK_GUARD
	select CPU_HAS_CUSTOM_FIXED_SOC_MPU_REGIONS
	select PLATFORM_SPECIFIC_INIT
	select HAS_PM
	select HAS_POWEROFF
	help
	  Enable support for Alif Ensemble MCU and MPU series
```

## soc/arm/alif_ensemble/e7/Kconfig.defconfig.series
```kconfig
# Copyright (c) 2024 Alif Semiconductor
#
# SPDX-License-Identifier: Apache-2.0

if SOC_SERIES_ENSEMBLE_E7

config SOC_SERIES
	default "e7"

config SD_BUFFER_SECTION
	string "Alif Non Secure Section Name for card internal buffer"
	default ".alif_ns"

config SDHC_DESCRIPTOR_SECTION
	string "Alif Non Secure Section Name for SDHC Descriptor"
	default ".alif_ns"

source "soc/arm/alif_ensemble/e7/Kconfig.defconfig.e*"

endif # SOC_SERIES_ENSEMBLE_E7
```

## soc/arm/alif_ensemble/e7/Kconfig.soc
```kconfig
# Copyright (c) 2024 Alif Semiconductor
#
# SPDX-License-Identifier: Apache-2.0

choice
	prompt "Alif Ensemble Family Selection"
	depends on SOC_SERIES_ENSEMBLE_E7

config SOC_E7_DK_RTSS_HE
	bool "SOC_E7_DK_RTSS_HE"
	select RTSS_HE
	select CPU_CORTEX_M55
	select CPU_HAS_ARM_MPU
	select CPU_CORTEX_M_HAS_SYSTICK
	select CPU_HAS_FPU
	select ARMV8_M_DSP
	select ARMV8_1_M_MVEI
	select ARMV8_1_M_MVEF
	select BUILD_NO_GAP_FILL
	select CPU_HAS_ARM_SAU

config SOC_E7_DK_RTSS_HP
	bool "SOC_E7_DK_RTSS_HP"
	select RTSS_HP
	select CPU_CORTEX_M55
	select CPU_HAS_ARM_MPU
	select CPU_CORTEX_M_HAS_SYSTICK
	select CPU_HAS_FPU
	select ARMV8_M_DSP
	select ARMV8_1_M_MVEI
	select ARMV8_1_M_MVEF
	select BUILD_NO_GAP_FILL
	select CPU_HAS_ARM_SAU
	select ARM_SECURE_FIRMWARE

endchoice

config SOC_SERIES_ENSEMBLE
	bool "Alif Ensemble Series"

if (PM || POWEROFF)

config PM_RTSS
	bool
	default y if (RTSS_HE || RTSS_HP)
	help
		Enable Power Management for RTSS cores

endif

if COUNTER_SNPS_DW
config LPTIMER2_OUTPUT_TOGGLE
	bool "LPTimer2 Output Toggle"
	help
	  Enable lptimer 2 output toggle.

config LPTIMER2_EXT_CLK_FREQ
	int "LPTimer2 Ext-clock source Frequency value"
	default 0
	help
	  Provide lptimer 2 clock frequency for external clock source.

config LPTIMER3_OUTPUT_TOGGLE
	bool "LPTimer3 Output Toggle"
	help
	  Enable lptimer 3 output toggle.

config LPTIMER3_EXT_CLK_FREQ
	int "LPTimer3 Ext-clock source Frequency value"
	default 0
	help
	  Provide lptimer 3 clock frequency for external clock source.
endif # COUNTER_SNPS_DW
```
